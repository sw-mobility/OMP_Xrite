AUTOSAR XML (schema 00050)
package /ara/com/secoc/deployments
  user defined service interface deployment verification_status_deployment: service-interface=VerificationStatus
    user defined event deployment VerificationStatus: event=VerificationStatus
  user defined service interface deployment verification_status_configuration_by_dataId_deployment: service-interface=VerificationStatusConfigurationByDataId
    user defined method deployment VerifyStatusOverride: method=VerifyStatusOverride
  user defined service interface deployment verification_status_configuration_by_freshnessId_deployment: service-interface=VerificationStatusConfigurationByFreshnessId
    user defined method deployment VerifyStatusOverride: method=VerifyStatusOverride
package /ara/com/secoc/instances
  provided user defined service instance ProvidedVerificationStatus: service-interface-deployment=verification_status_deployment
  provided user defined service instance ProvidedVerificationStatusConfigurationByDataId: service-interface-deployment=verification_status_configuration_by_dataId_deployment
  provided user defined service instance ProvidedVerificationStatusConfigurationByFreshnessId: service-interface-deployment=verification_status_configuration_by_freshnessId_deployment
