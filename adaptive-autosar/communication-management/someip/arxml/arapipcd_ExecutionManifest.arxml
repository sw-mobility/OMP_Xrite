AUTOSAR XML (schema 00050)
package /RB/VRTE/Executables
  executable arapipcd: reporting-behavior=REPORTS-EXECUTION-STATE
package /RB/VRTE/Processes
  process Arapipcd_A: executable=arapipcd, state-dependent-startup-config{function-group-state=MachineFG.Startup, startup-config=arapipcd_StartupConfigSet_arapipcd_StartupConfig}
  process Arapipcd_B: executable=arapipcd, state-dependent-startup-config{function-group-state=MachineFG.Startup, startup-config=arapipcd_B_StartupConfigSet_arapipcd_B_StartupConfig}
package /RB/VRTE/StartupConfigSets
  startup config arapipcd_StartupConfigSet_arapipcd_StartupConfig: timeout={enter-timeout-value=100.0, exit-timeout-value=100.0}
    environment-variables:
      key=LD_LIBRARY_PATH, value=/lib:/usr/lib:/opt/vrte/lib
      key=PIPC_PREALLOCATE_THREADS, value=ON
      key=DLT_PIPE_DIR, value=/opt/vrte/tmp/dlt
      key=ECUCFG_ENV_VAR_ROOTFOLDER, value=/opt/vrte/usr/etc/ecu-cfg/processes/arapipcd
  startup config arapipcd_B_StartupConfigSet_arapipcd_B_StartupConfig: timeout={enter-timeout-value=100.0, exit-timeout-value=100.0}
    environment-variables:
      key=LD_LIBRARY_PATH, value=/lib:/usr/lib:/opt/vrte/lib
      key=PIPC_PREALLOCATE_THREADS, value=ON
      key=DLT_PIPE_DIR, value=/opt/vrte/tmp/dlt
      key=ECUCFG_ENV_VAR_ROOTFOLDER, value=/opt/vrte/usr/etc/ecu-cfg/processes/arapipcd
package /RB/VRTE/ProcessToMachineMappings
  process to machine mapping set arapipcd_ExecutionManifest_ProcessToMachineMappingSet
    process to machine mapping RouDi_Machine_A_Mapping: machine=Machine_A, process=Arapipcd_A
    process to machine mapping RouDi_B_Machine_B_Mapping: machine=Machine_B, process=Arapipcd_B
package /RB/VRTE/DltContexts
  dlt context arapipcd_A: context-id=PIPC
  dlt context arapipcd_B: context-id=PIPC
package /RB/VRTE/DltContextToPortPrototypeMappings
  dlt log sink to port prototype mapping arapipcd_A_Arapipcd_A_dltMapping: dlt-context=arapipcd_A, dlt-log-sink=comd_Remote, process=Arapipcd_A
  dlt log sink to port prototype mapping arapipcd_B_Arapipcd_B_dltMapping: dlt-context=arapipcd_B, dlt-log-sink=comd_Remote, process=Arapipcd_B
package /RB/VRTE/DltApplicationToProcessMappings
  dlt application to process mapping arapipcd_A_DltApplicationToProcessMapping: dlt-application=COM_A_DltApp, process=Arapipcd_A
  dlt application to process mapping arapipcd_B_DltApplicationToProcessMapping: dlt-application=COM_B_DltApp, process=Arapipcd_B
