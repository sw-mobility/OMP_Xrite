AUTOSAR XML (schema 00050)
package /FunctionGroupSets
  function group set FunctionGroupSet_0
    function-groups:
      mode declaration group prototype MachineFG: type=MachineFG
