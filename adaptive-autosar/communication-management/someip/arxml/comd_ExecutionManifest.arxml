AUTOSAR XML (schema 00050)
package /RB/VRTE/Executables
  executable com_sipgateway: reporting-behavior=REPORTS-EXECUTION-STATE
    root sw component prototype com_sipgateway_RootSwComponent: application-type=SecOCAppProvider
package /RB/VRTE/Processes
  process comd_A: executable=com_sipgateway, state-dependent-startup-config{function-group-state=MachineFG.Startup, startup-config=comd_StartupConfigSet_comd_StartupConfig}
  process comd_B: executable=com_sipgateway, state-dependent-startup-config{function-group-state=MachineFG.Startup, startup-config=comd_B_StartupConfigSet_comd_B_StartupConfig}
package /RB/VRTE/StartupConfigSets
  startup config comd_StartupConfigSet_comd_StartupConfig: timeout={enter-timeout-value=100.0, exit-timeout-value=100.0}
    environment-variables:
      key=LD_LIBRARY_PATH, value=/lib:/usr/lib:/opt/vrte/lib
      key=ECUCFG_ENV_VAR_ROOTFOLDER, value=/opt/vrte/rb-com/etc/ecu-cfg
      key=DLT_PIPE_DIR, value=/opt/vrte/tmp/dlt
  startup config comd_B_StartupConfigSet_comd_B_StartupConfig: timeout={enter-timeout-value=100.0, exit-timeout-value=100.0}
    environment-variables:
      key=LD_LIBRARY_PATH, value=/lib:/usr/lib:/opt/vrte/lib
      key=ECUCFG_ENV_VAR_ROOTFOLDER, value=/opt/vrte/rb-com/etc/ecu-cfg
      key=DLT_PIPE_DIR, value=/opt/vrte/tmp/dlt
package /RB/VRTE/ProcessToMachineMappings
  process to machine mapping set comd_ExecutionManifest_ProcessToMachineMappingSet
    process to machine mapping comd_Machine_A_Mapping: machine=Machine_A, process=comd_A
    process to machine mapping comd_B_Machine_B_Mapping: machine=Machine_B, process=comd_B
package /RB/VRTE/DltLogSinks
  dlt log sink comd_Remote: category=DLT_LOGSINK_REMOTE, default-log-threshold=VERBOSE
package /RB/VRTE/DltContexts
  5 x dlt context:
    COM_B_DltContext: context-id=SIGW
    comd_A_DltContext: context-id=pSOM
    comd_B_DltContext: context-id=pSOM
    ipc_A_DltContext: context-id=PIPC
    ipc_B_DltContext: context-id=PIPC
package /RB/VRTE/DltContextToPortPrototypeMappings
  4 x dlt log sink to port prototype mapping, all with dlt-log-sink=comd_Remote:
    comd_DltContext_comd_A_dltMapping: dlt-context=comd_A_DltContext, process=comd_A
    comd_B_DltContext_comd_B_dltMapping: dlt-context=comd_B_DltContext, process=comd_B
    ipc_A_DltContext_comd_A_dltMapping: dlt-context=ipc_A_DltContext, process=comd_A
    ipc_B_DltContext_comd_B_dltMapping: dlt-context=ipc_B_DltContext, process=comd_B
package /RB/VRTE/DltApplicationToProcessMappings
  dlt application to process mapping comd_DltAppProcessMapping: dlt-application=COM_A_DltApp, process=comd_A
  dlt application to process mapping comd_B_DltApplicationMapping: dlt-application=COM_B_DltApp, process=comd_B
