AUTOSAR XML (schema 00050)
package /RB/VRTE/Executables
  executable DLT: reporting-behavior=REPORTS-EXECUTION-STATE
package /RB/VRTE/Processes
  process DLT_A: executable=DLT, state-dependent-startup-config{function-group-state=[MachineFG.Restart, MachineFG.Shutdown, MachineFG.Startup], startup-config=DLT_StartupConfig}
  process DLT_B: executable=DLT, state-dependent-startup-config{function-group-state=[MachineFG.Restart, MachineFG.Shutdown, MachineFG.Startup, MachineFG.Verify], startup-config=DLT_B_StartupConfig}
package /RB/VRTE/StartupConfigs
  startup config DLT_StartupConfig: process-arguments=[-c, /opt/vrte/usr/etc/dlt_a.conf, -t, /opt/vrte/tmp/dlt], timeout={enter-timeout-value=100.0, exit-timeout-value=100.0}
    environment-variables:
      key=LD_LIBRARY_PATH, value=/lib:/usr/lib:/opt/vrte/lib
      key=ECUCFG_ENV_VAR_ROOTFOLDER, value=/opt/vrte/dev-aap-dlt/etc/ecu-cfg
  startup config DLT_B_StartupConfig: process-arguments=[-c, /opt/vrte/usr/etc/dlt_b.conf, -t, /opt/vrte/tmp/dlt], timeout={enter-timeout-value=100.0, exit-timeout-value=100.0}
    environment-variables:
      key=LD_LIBRARY_PATH, value=/lib:/usr/lib:/opt/vrte/lib
      key=ECUCFG_ENV_VAR_ROOTFOLDER, value=/opt/vrte/dev-aap-dlt/etc/ecu-cfg
package /RB/VRTE/ProcessToMachineMappings
  process to machine mapping set DLT_ExecutionManifest_ProcessToMachineMappingSet
    process to machine mapping DLT_A_Machine_A_Mapping: machine=Machine_A, process=DLT_A
    process to machine mapping DLT_B_Machine_B_Mapping: machine=Machine_B, process=DLT_B
package /RB/VRTE/DltLogSinks
  dlt log sink EXM_Remote: category=DLT_LOGSINK_REMOTE, default-log-threshold=INFO
  dlt log sink EXM_Console: category=DLT_LOGSINK_CONSOLE, default-log-threshold=INFO
