AUTOSAR XML (schema 00050)
package /ara/com/secoc/mappings
  6 x service instance to port prototype mapping:
    ProvidedVerificationStatusMapping_A: port-prototype=com_sipgateway_RootSwComponent.pp_VerificationStatus, process=comd_A, service-instance=ProvidedVerificationStatus
    ProvidedVerificationStatusConfigurationByDataIdMapping_A: port-prototype=com_sipgateway_RootSwComponent.pp_VerificationStatusConfigurationByDataId, process=comd_A, service-instance=ProvidedVerificationStatusConfigurationByDataId
    ProvidedVerificationStatusConfigurationByFreshnessIdMapping_A: port-prototype=com_sipgateway_RootSwComponent.pp_VerificationStatusConfigurationByFreshnessId, process=comd_A, service-instance=ProvidedVerificationStatusConfigurationByFreshnessId
    ProvidedVerificationStatusMapping_B: port-prototype=com_sipgateway_RootSwComponent.pp_VerificationStatus, process=comd_B, service-instance=ProvidedVerificationStatus
    ProvidedVerificationStatusConfigurationByDataIdMapping_B: port-prototype=com_sipgateway_RootSwComponent.pp_VerificationStatusConfigurationByDataId, process=comd_B, service-instance=ProvidedVerificationStatusConfigurationByDataId
    ProvidedVerificationStatusConfigurationByFreshnessIdMapping_B: port-prototype=com_sipgateway_RootSwComponent.pp_VerificationStatusConfigurationByFreshnessId, process=comd_B, service-instance=ProvidedVerificationStatusConfigurationByFreshnessId
