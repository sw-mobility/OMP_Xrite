AUTOSAR XML (schema 00050)
package /CommunicationClusters
  ethernet cluster EthernetCluster_0
    ethernet physical channel EthernetPhysicalChannel_0
      4 x network endpoint:
        NetworkEndpoint_A: network-endpoint-addresses=ipv-4-configuration={ipv-4-address=${PUBLISHER_IP}, ipv-4-address-source=FIXED, network-mask=255.255.0.0}
        Multicast_A: network-endpoint-addresses=ipv-4-configuration={ip-address-keep-behavior=STORE-PERSISTENTLY, ipv-4-address=224.244.224.245, network-mask=255.255.0.0}
        Multicast_B: network-endpoint-addresses=ipv-4-configuration={ip-address-keep-behavior=STORE-PERSISTENTLY, ipv-4-address=224.244.224.245, network-mask=255.255.0.0}
        NetworkEndpoint_B: network-endpoint-addresses=ipv-4-configuration={ipv-4-address=${SUBSCRIBER_IP}, network-mask=255.255.0.0}
