AUTOSAR XML (schema 00050)
package /RB/VRTE/Executables
  executable Publisher: reporting-behavior=REPORTS-EXECUTION-STATE
    root sw component prototype Publisher_RootSwComponent: application-type=Publisher_Component
package /RB/VRTE/Processes
  process Publisher_Process: executable=Publisher, state-dependent-startup-config{function-group-state=MachineFG.Startup, startup-config=Publisher_StartupConfig}
package /RB/VRTE/StartupConfigs
  startup config Publisher_StartupConfig: termination-behavior=PROCESS-IS-SELF-TERMINATING, timeout={enter-timeout-value=100.0, exit-timeout-value=100.0}
    environment-variables:
      key=LD_LIBRARY_PATH, value=/lib:/usr/lib:/opt/vrte/lib
      key=ECUCFG_ENV_VAR_ROOTFOLDER, value=/opt/vrte/usr/etc/ecu-cfg/processes/Publisher
      key=DLT_PIPE_DIR, value=/opt/vrte/tmp/dlt
package /RB/VRTE/ProcessToMachineMappings
  process to machine mapping set Publisher_ExecutionManifest_ProcessToMachineMappingSet
    process to machine mapping Publisher_Machine_A_Mapping: machine=Machine_A, process=Publisher_Process
package /RB/VRTE/DltContexts
  dlt context PUB: context-id=PUB
  dlt context PUB_IPC: context-id=PIPC
package /RB/VRTE/DltContextToPortPrototypeMappings
  dlt log sink to port prototype mapping PUB_Publisher_Process_dltMapping: dlt-context=PUB, dlt-log-sink=[Publisher_Console, Publisher_Remote], process=Publisher_Process
  dlt log sink to port prototype mapping PUB_IPC_Publisher_Process_dltMapping: dlt-context=PUB_IPC, dlt-log-sink=comd_Remote, process=Publisher_Process
package /RB/VRTE/DltApplicationToProcessMappings
  dlt application to process mapping Publisher_DltApplicationMapping: dlt-application=PUB_DltApp, process=Publisher_Process
package /RB/VRTE/DltLogSinks
  dlt log sink Publisher_Console: category=DLT_LOGSINK_CONSOLE, default-log-threshold=INFO
  dlt log sink Publisher_Remote: category=DLT_LOGSINK_REMOTE, default-log-threshold=VERBOSE
