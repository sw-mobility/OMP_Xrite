AUTOSAR XML (schema 00050)
package /SoftwareClusterDesigns
  software cluster design SoftwareClusterDesign_1: intended-target-machine=MachineDesign_B, sub-software-cluster=SoftwareClusterDesign_1
