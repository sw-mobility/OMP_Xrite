AUTOSAR XML (schema 00050)
package /SoftwareClusters
  software cluster SoftwareCluster_0: category=PLATFORM_CORE, claimed-function-group=MachineFG, contained-process=[comd_A, Arapipcd_A, DLT_A, rb_exmd_A, Publisher_Process], design=SoftwareClusterDesign_0, module-instantiation=LogAndTraceInstatiation_A, vendor-id=11, vendor-signature=CryptoServiceCertificate_0, version=1.0.0-alpha+001
  crypto service certificate CryptoServiceCertificate_0
