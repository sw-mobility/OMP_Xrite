AUTOSAR XML (schema 00050)
package /pst/com
  service interface VehicleControlService
    namespaces:
      symbol props pst_1: symbol=pst
      symbol props com_2: symbol=com
    events:
      data VehicleSpeed: type=VehicleSpd
    field ParkingBrakeStatus: type=PrkBrkSta, has-getter=true, has-notifier=true, has-setter=true
    methods:
      operation getEvDriveReadyStatus
        arg m_ev_drv_rdy_sta_req: type=EvDrvRdySta_Req, direction=IN
        arg m_ev_drv_rdy_sta_resp: type=EvDrvRdySta_Resp, direction=OUT
  4 x std cpp implementation data type, all with category=TYPE_REFERENCE, type-emitter=TYPE_EMITTER_ARA:
    VehicleSpd: type-reference=int16_t
    EvDrvRdySta_Req: type-reference=uint8_t
    EvDrvRdySta_Resp: type-reference=uint8_t
    PrkBrkSta: type-reference=uint8_t
  adaptive application sw component type Publisher_Component  # definition of software components in the application design
    provide port PPort: provided-interface=VehicleControlService
  adaptive application sw component type Subscriber_Component
    require port RPort: required-interface=VehicleControlService
