AUTOSAR XML (schema 00050)
package /RB/VRTE/Executables
  executable exm: reporting-behavior=REPORTS-EXECUTION-STATE
package /RB/VRTE/Processes
  process rb_exmd_A: executable=exm, function-cluster-affiliation=EXECUTION_MANAGEMENT
  process rb_exmd_B: executable=exm, function-cluster-affiliation=EXECUTION_MANAGEMENT
package /RB/VRTE/DltContexts
  dlt context exm_A_DltContext: context-id=EXM
  dlt context exm_B_DltContext: context-id=EXM
package /RB/VRTE/DltContextToPortPrototypeMappings
  dlt log sink to port prototype mapping exm_A_DltContext_exm_A_dltMapping: dlt-context=exm_A_DltContext, dlt-log-sink=[EXM_Remote, EXM_Console], process=rb_exmd_A
  dlt log sink to port prototype mapping exm_B_DltContext_exm_B_dltMapping: dlt-context=exm_B_DltContext, dlt-log-sink=[EXM_Remote, EXM_Console], process=rb_exmd_B
package /RB/VRTE/DltApplicationToProcessMappings
  dlt application to process mapping exm_A_DltApplicationToProcessMapping: dlt-application=EXM_A_DltApp, process=rb_exmd_A
  dlt application to process mapping exm_B_DltApplicationToProcessMapping: dlt-application=EXM_B_DltApp, process=rb_exmd_B
package /RB/VRTE/ProcessToMachineMappings
  process to machine mapping set exm_ExecutionManifest_ProcessToMachineMappingSet
    process to machine mapping rb_exmd_B_Machine_A_Mapping: machine=Machine_A, process=rb_exmd_A
    process to machine mapping rb_exmd_B_Machine_B_Mapping: machine=Machine_B, process=rb_exmd_B
