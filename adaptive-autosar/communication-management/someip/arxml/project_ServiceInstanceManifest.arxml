AUTOSAR XML (schema 00050)
package /RB/VRTE/ServiceInterfaceDeployments
  someip service interface deployment VehicleControlService_Deployment: service-interface=VehicleControlService, service-interface-id=256, service-interface-version={major-version=1, minor-version=0}
    someip event deployment VehicleSpeed: event=VehicleSpeed, event-id=1, transport-protocol=UDP
    someip field deployment ParkingBrakeStatus: field=ParkingBrakeStatus
      get getParkingBrakeStatus: method-id=3, transport-protocol=UDP
      notifier notifyParkingBrakeStatus: event-id=2, transport-protocol=UDP
      set setParkingBrakeStauts: method-id=4, transport-protocol=UDP
    someip method deployment getEvDriveReadyStatus: method=getEvDriveReadyStatus, method-id=1, transport-protocol=UDP
    someip event group VehicleControlService_SomeipEventGroup: event-group-id=1, event=VehicleSpeed
    someip event group VehicleControlService_Deployment_SomeipEventGroup: event-group-id=2, event=notifyParkingBrakeStatus
package /RB/VRTE/ServiceInstances
  provided someip service instance MachineDesign_A_PSSI: service-interface-deployment=VehicleControlService_Deployment, sd-server-config=MachineDesign_A_SSDSSIC_4, service-instance-id=1
    someip provided event group MachineDesign_A_PSSI_VehicleControlService_Deployment_SomeipEventGroup: event-group=VehicleControlService_Deployment_SomeipEventGroup, multicast-threshold=100
    someip provided event group MachineDesign_A_PSSI_VehicleControlService_SomeipEventGroup: event-group=VehicleControlService_SomeipEventGroup, multicast-threshold=100
  required someip service instance MachineDesign_B_RSSI: service-interface-deployment=VehicleControlService_Deployment, required-minor-version=0, required-service-instance-id=1, sd-client-config=MachineDesign_B_SSDCSIC_5, version-driven-find-behavior=MINIMUM-MINOR-VERSION
    someip required event group MachineDesign_B_RSSI_VehicleControlService_SomeipEventGroup: event-group=VehicleControlService_SomeipEventGroup, sd-client-event-group-timing-config=MachineDesign_B_RSSI_VehicleControlService_SomeipEventGroup_SomeipSdClientEventGroupTimingConfig
    someip required event group MachineDesign_B_RSSI_VehicleControlService_Deployment_SomeipEventGroup: event-group=VehicleControlService_Deployment_SomeipEventGroup, sd-client-event-group-timing-config=MachineDesign_B_RSSI_VehicleControlService_Deployment_SomeipEventGroup_SomeipSdClientEventGroupTimingConfig
package /RB/VRTE/SomeipSdTimingConfigs
  someip sd server service instance config MachineDesign_A_SSDSSIC_4: initial-offer-behavior={initial-delay-max-value=1.0, initial-delay-min-value=0.1, initial-repetitions-base-delay=2.0, initial-repetitions-max=5}, offer-cyclic-delay=5.0, request-response-delay={max-value=3.0, min-value=0.1}, service-offer-time-to-live=100
  someip sd client service instance config MachineDesign_B_SSDCSIC_5: initial-find-behavior={initial-delay-max-value=1.0, initial-delay-min-value=0.1, initial-repetitions-base-delay=2.0, initial-repetitions-max=8}, service-find-time-to-live=1000
package /RB/VRTE/ServiceInstanceToMachineMappings
  someip service instance to machine mapping MachineDesign_A_SSITMM_4: communication-connector=MachineDesign_A_ECC, service-instance=MachineDesign_A_PSSI, udp-port=MachineDesign_A_SSITMM_udpPort_44300
  someip service instance to machine mapping MachineDesign_B_SSITMM_5: communication-connector=MachineDesign_B_ECC, service-instance=MachineDesign_B_RSSI, udp-port=MachineDesign_B_SSITMM_5_udpPort_44500
package /RB/VRTE/SomeipSdClientEventGroupTimingConfigs
  someip sd client event group timing config MachineDesign_B_RSSI_Event_ComplexCOM_SomeipEventGroup_SomeipSdClientEventGroupTimingConfig: time-to-live=100
  someip sd client event group timing config MachineDesign_B_RSSI_VehicleControlService_Deployment_SomeipEventGroup_SomeipSdClientEventGroupTimingConfig: time-to-live=100
  someip sd client event group timing config MachineDesign_B_RSSI_VehicleControlService_SomeipEventGroup_SomeipSdClientEventGroupTimingConfig: time-to-live=100
package /RB/VRTE/ServiceInstanceToPortPrototypeMappings
  service instance to port prototype mapping MachineDesign_A_PSSI_PPort: port-prototype=Publisher_RootSwComponent.PPort, process=Publisher_Process, service-instance=MachineDesign_A_PSSI
  service instance to port prototype mapping MachineDesign_B_RSSI_RPort: port-prototype=Subscriber_RootSwComponent.RPort, process=Subscriber_Process, service-instance=MachineDesign_B_RSSI
