AUTOSAR XML (schema 00050)
package /SoftwareClusters
  software cluster SoftwareCluster_1: category=PLATFORM_CORE, claimed-function-group=MachineFG, contained-process=[comd_B, Arapipcd_B, Subscriber_Process, DLT_B, rb_exmd_B], design=SoftwareClusterDesign_1, module-instantiation=LogAndTraceInstatiation_B, vendor-id=11, vendor-signature=CryptoServiceCertificate_1, version=1.0.0-alpha+001
  crypto service certificate CryptoServiceCertificate_1
