AUTOSAR XML (schema 00050)
package /SoftwareClusterDesigns
  software cluster design SoftwareClusterDesign_0: intended-target-machine=MachineDesign_A, sub-software-cluster=SoftwareClusterDesign_0
