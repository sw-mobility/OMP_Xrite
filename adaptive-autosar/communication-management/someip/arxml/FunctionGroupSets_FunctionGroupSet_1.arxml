AUTOSAR XML (schema 00050)
package /FunctionGroupSets
  function group set FunctionGroupSet_1
    function-groups:
      mode declaration group prototype MachineFG: type=MachineFG
