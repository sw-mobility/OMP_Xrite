AUTOSAR XML (schema 00050)
package /MachineDesigns
  machine design MachineDesign_B: service-discovery-configs=someip-service-discovery={multicast-sd-ip-address=Multicast_B, someip-service-discovery-port=30490}
    ethernet communication connector MachineDesign_B_ECC: unicast-network-endpoint=NetworkEndpoint_B
      ap application endpoint MachineDesign_B_SSITMM_5_udpPort_44500: tp-configuration=udp-tp=udp-tp-port=port-number=44500
