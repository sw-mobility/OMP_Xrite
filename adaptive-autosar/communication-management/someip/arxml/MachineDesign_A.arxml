AUTOSAR XML (schema 00050)
package /MachineDesigns
  machine design MachineDesign_A: service-discovery-configs=someip-service-discovery={multicast-sd-ip-address=Multicast_A, someip-service-discovery-port=30490}
    ethernet communication connector MachineDesign_A_ECC: unicast-network-endpoint=NetworkEndpoint_A
      ap application endpoint MachineDesign_A_SSITMM_udpPort_44300: tp-configuration=udp-tp=udp-tp-port=port-number=44300
