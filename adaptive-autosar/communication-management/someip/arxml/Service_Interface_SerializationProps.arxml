AUTOSAR XML (schema 00050)
package /etas/com/Service_Interface/TransformationPropsSets
  transformation props set transformationPropsSet
    ap someip transformation props SerProps_Event: byte-order=big-endian
    ap someip transformation props SerProps_Method: byte-order=big-endian
    ap someip transformation props SerProps_Field: byte-order=big-endian
package /etas/com/Service_Interface/TransformationPropsToServiceInterfaceElementMappings
  transformation props to service interface element mapping SerialiserMapping_SerProps_Event: event=VehicleSpeed, transformation-props=SerProps_Event
  transformation props to service interface element mapping SerialiserMapping_SerProps_Method: method=getEvDriveReadyStatus, transformation-props=SerProps_Method
  transformation props to service interface element mapping SerialiserMapping_SerProps_Field: field=ParkingBrakeStatus, transformation-props=SerProps_Field
