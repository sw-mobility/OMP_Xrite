AUTOSAR XML (schema 00050)
package /ModeDeclarationGroups
  mode declaration group MachineFG: initial-mode=Off
    5 x mode:
      Off
      Restart
      Shutdown
      Startup
      Verify
