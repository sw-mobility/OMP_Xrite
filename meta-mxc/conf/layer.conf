## meta-mxc/conf/layer.conf
```bitbake
# We have a conf and classes directory, add to BBPATH
BBPATH .= ":${LAYERDIR}"

# We have recipes-* directories, add to BBFILES
BBFILES += "${LAYERDIR}/recipes-*/*/*.bb \
	${LAYERDIR}/recipes-*/*/*.bbappend \
	${LAYERDIR}/recipes-*/*/*/*.bb \
	${LAYERDIR}/recipes-*/*/*/*.bbappend \
	${LAYERDIR}/recipes-*/*/*/*/*.bb \
	${LAYERDIR}/recipes-*/*/*/*/*.bbappend \
	${LAYERDIR}/recipes-*/*/*/*/*/*.bb \
	${LAYERDIR}/recipes-*/*/*/*/*/*.bbappend \
"

BBFILE_COLLECTIONS += "mxc"
BBFILE_PATTERN_mxc = "^${LAYERDIR}/"
BBFILE_PRIORITY_mxc = "13"
LAYERSERIES_COMPAT_mxc = "dunfell kirkstone scarthgap"

LAYERDEPENDS_mxc = "meta-arago-distro \
	core \
	meta-ti-bsp \
	meta-ti-extras \
	openembedded-layer \
	meta-initramfs \
	meta-aws \
"

PREFERRED_VERSION_xen ?= "4.17+stable%"
PREFERRED_VERSION_xen-tools ?= "4.17+stable%"
```
