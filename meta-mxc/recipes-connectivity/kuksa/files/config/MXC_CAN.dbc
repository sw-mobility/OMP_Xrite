VERSION ""

NS_ :

BS_:

BU_: MXC CGW

BO_ 3221225472 VECTOR__INDEPENDENT_SIG_MSG: 0 Vector__XXX
 SG_ DATC_PeEwpRPMReq : 0|8@1+ (20,0) [0|0] "" Vector__XXX
 SG_ DATC_AlvCnt1Val : 0|8@1+ (1,0) [0|0] "" Vector__XXX
 SG_ DATC_RadFanReq_Duty : 0|8@1+ (1,0) [0|0] "%" Vector__XXX
 SG_ DATC_OutTempSnsrVal : 0|8@1+ (0.5,-40) [0|0] "��" Vector__XXX
 SG_ DATC_DfgSw : 0|2@1+ (1,0) [0|0] "" Vector__XXX
 SG_ DATC_BattChlrVlv_FltCode : 0|2@1+ (1,0) [0|0] "" Vector__XXX
 SG_ DATC_BattEvapVlvSta : 0|2@1+ (1,0) [0|0] "" Vector__XXX
 SG_ DATC_BattEvapVlv_FltCode : 0|2@1+ (1,0) [0|0] "" Vector__XXX
 SG_ DATC_BattEwpOpReq : 0|8@1+ (30,0) [0|0] "rpm" Vector__XXX
 SG_ DATC_BlwrLvl : 0|4@1+ (1,0) [0|0] "" Vector__XXX
 SG_ DATC_AAFOpenReq : 0|3@1+ (1,0) [0|0] "" Vector__XXX
 SG_ DATC_ManufacturerTyp : 0|3@1+ (1,0) [0|0] "" Vector__XXX
 SG_ DATC_AcnCompTyp : 0|3@1+ (1,0) [0|0] "flag" Vector__XXX
 SG_ DATC_AcnReq : 0|2@1+ (1,0) [0|0] "" Vector__XXX
 SG_ DATC_BlwSta : 0|2@1+ (1,0) [0|0] "" Vector__XXX
 SG_ DATC_BlwMaxSta : 0|2@1+ (1,0) [0|0] "" Vector__XXX
 SG_ DATC_SrvLmpReq : 0|2@1+ (1,0) [0|0] "" Vector__XXX
 SG_ DATC_AcnECompOpSta : 0|2@1+ (1,0) [0|0] "flag" Vector__XXX
 SG_ DATC_AcnCompFltSta : 0|2@1+ (1,0) [0|0] "flag" Vector__XXX
 SG_ DATC_RrDfgOpSta : 0|2@1+ (1,0) [0|0] "flag" Vector__XXX
 SG_ DATC_HVCompIntlkSta : 0|2@1+ (1,0) [0|0] "flag" Vector__XXX
 SG_ DATC_HVIntDischrgLkReq : 0|2@1+ (1,0) [0|0] "flag" Vector__XXX
 SG_ DATC_AcnECompMaxReqPwrVal : 0|10@1+ (20,0) [0|0] "W" Vector__XXX
 SG_ DATC_AcnECompCnsmptPwrVal : 0|10@1+ (20,0) [0|0] "W" Vector__XXX
 SG_ DATC_MainRlyOffReq : 0|2@1+ (1,0) [0|0] "flag" Vector__XXX
 SG_ BCM_Crc7Val : 0|8@1+ (1,0) [0|0] "" Vector__XXX
 SG_ BCM_AlvCnt7Val : 0|4@1+ (1,0) [0|0] "" Vector__XXX
 SG_ Lamp_HiPrioHzrdReq : 0|3@1+ (1,0) [0|0] "" Vector__XXX
 SG_ Lamp_LoPrioHzrdReq : 0|3@1+ (1,0) [0|0] "" Vector__XXX
 SG_ Lamp_DedicatedDrlOnReq : 0|2@1+ (1,0) [0|0] "" Vector__XXX
 SG_ Lamp_IntTailLmpOnReq : 0|2@1+ (1,0) [0|0] "" Vector__XXX
 SG_ Lamp_ExtrnlTailLmpOnReq : 0|2@1+ (1,0) [0|0] "" Vector__XXX
 SG_ Lamp_HdLmpLoOnReq : 0|2@1+ (1,0) [0|0] "" Vector__XXX
 SG_ Lamp_HdLmpHiOnReq : 0|2@1+ (1,0) [0|0] "" Vector__XXX
 SG_ Lamp_AvTailLmpSta : 0|2@1+ (1,0) [0|0] "" Vector__XXX
 SG_ BCM_Crc9Val : 0|8@1+ (1,0) [0|0] "" Vector__XXX
 SG_ BCM_AlvCnt9Val : 0|4@1+ (1,0) [0|0] "" Vector__XXX
 SG_ Lamp_AutoLtSnsrNightSta : 0|2@1+ (1,0) [0|0] "" Vector__XXX
 SG_ Lamp_AutoLtSnsrHorVal : 0|10@1+ (1,0) [0|0] "" Vector__XXX
 SG_ FR_RDR_Crc1Val : 0|16@1+ (1,0) [0|0] "" Vector__XXX
 SG_ FR_RDR_AlvCnt1Val : 0|8@1+ (1,0) [0|0] "" Vector__XXX
 SG_ FR_RDR_FCAEquipSta : 0|2@1+ (1,0) [0|0] "" Vector__XXX
 SG_ FR_RDR_FCA_Plus_Sta : 0|3@1+ (1,0) [0|0] "" Vector__XXX
 SG_ FR_RDR_SCCEquipSta : 0|2@1+ (1,0) [0|0] "" Vector__XXX
 SG_ FR_RDR_FailInfoSta : 0|3@1+ (1,0) [0|0] "" Vector__XXX
 SG_ FR_RDR_CodingSta : 0|2@1+ (1,0) [0|0] "" Vector__XXX
 SG_ FR_RDR_ACANMonSta : 0|2@1+ (1,0) [0|0] "" Vector__XXX
 SG_ FR_RDR_HDAEquipSta : 0|2@1+ (1,0) [0|0] "" Vector__XXX
 SG_ ICU_Crc2Val : 0|8@1+ (1,0) [0|0] "" Vector__XXX
 SG_ ICU_AlvCnt2Val : 0|4@1+ (1,0) [0|0] "" Vector__XXX
 SG_ Autocut_DlvryModSta : 0|2@1+ (1,0) [0|0] "" Vector__XXX
 SG_ DoorLock_AsstDrUnLkSta : 0|2@1+ (1,0) [0|0] "" Vector__XXX
 SG_ Warn_DrvDrSwSta : 0|2@1+ (1,0) [0|0] "" Vector__XXX
 SG_ DoorLock_RrLftDrUnLkSta : 0|2@1+ (1,0) [0|0] "" Vector__XXX
 SG_ DoorLock_RrRtDrUnLkSta : 0|2@1+ (1,0) [0|0] "" Vector__XXX
 SG_ ICU_GearPosRConfirmSta : 0|2@1+ (1,0) [0|0] "" Vector__XXX
 SG_ Warn_AsstDrSwSta : 0|2@1+ (1,0) [0|0] "" Vector__XXX
 SG_ Warn_AsstStBltSwSta : 0|2@1+ (1,0) [0|0] "" Vector__XXX
 SG_ Warn_BrkFldSwSta : 0|2@1+ (1,0) [0|0] "" Vector__XXX
 SG_ Warn_DrvStBltSwSta : 0|2@1+ (1,0) [0|0] "" Vector__XXX
 SG_ Warn_HoodSwSta : 0|2@1+ (1,0) [0|0] "" Vector__XXX
 SG_ Warn_PassStOccSta : 0|2@1+ (1,0) [0|0] "" Vector__XXX
 SG_ Warn_RrCtrStBltSwSta : 0|2@1+ (1,0) [0|0] "" Vector__XXX
 SG_ Warn_RrLftDrSwSta : 0|2@1+ (1,0) [0|0] "" Vector__XXX
 SG_ Warn_RrLftStBltSwSta : 0|2@1+ (1,0) [0|0] "" Vector__XXX
 SG_ Warn_RrRtDrSwSta : 0|2@1+ (1,0) [0|0] "" Vector__XXX
 SG_ Warn_RrRtStBltSwSta : 0|2@1+ (1,0) [0|0] "" Vector__XXX
 SG_ Warn_HoodSwMemorySta : 0|2@1+ (1,0) [0|0] "" Vector__XXX
 SG_ Warn_WshrFldSwSta : 0|2@1+ (1,0) [0|0] "" Vector__XXX
 SG_ ICU_Haptic_OPT : 0|2@1+ (1,0) [0|0] "" Vector__XXX
 SG_ ICU_Crc10Val : 0|8@1+ (1,0) [0|0] "" Vector__XXX
 SG_ ICU_AlvCnt10Val : 0|4@1+ (1,0) [0|0] "" Vector__XXX
 SG_ ICU_BS2SoC : 0|8@1+ (1,0) [0|0] "" Vector__XXX
 SG_ ICU_BS2NCap : 0|8@1+ (1,0) [0|0] "" Vector__XXX
 SG_ ICU_BS2OpnCirVol : 0|12@1+ (0.001,10) [0|0] "" Vector__XXX
 SG_ ICU_BS2_FSOC : 0|1@1+ (1,0) [0|0] "" Vector__XXX
 SG_ ICU_BS2_FSOH : 0|1@1+ (1,0) [0|0] "" Vector__XXX
 SG_ ICU_BS2_FSOF : 0|1@1+ (1,0) [0|0] "" Vector__XXX
 SG_ ICU_BS2_FQSTAT : 0|1@1+ (1,0) [0|0] "" Vector__XXX
 SG_ ICU_BS2SoH : 0|8@1+ (1,0) [0|0] "" Vector__XXX
 SG_ ICU_BS2SoF : 0|8@1+ (0.05,0) [0|0] "" Vector__XXX
 SG_ ICU_Crc4Val : 0|8@1+ (1,0) [0|0] "" Vector__XXX
 SG_ ICU_AlvCnt4Val : 0|4@1+ (1,0) [0|0] "" Vector__XXX
 SG_ ExtLamp_TrnSigLmpLftBlnkngSta : 0|2@1+ (1,0) [0|0] "" Vector__XXX
 SG_ ExtLamp_TrnSigLmpRtBlnkngSta : 0|2@1+ (1,0) [0|0] "" Vector__XXX
 SG_ ExtLamp_ExtrnlTailLmpSta : 0|2@1+ (1,0) [0|0] "" Vector__XXX
 SG_ ExtLamp_HzrdSwSta : 0|2@1+ (1,0) [0|0] "" Vector__XXX
 SG_ ExtLamp_RrFgLmpSta : 0|2@1+ (1,0) [0|0] "" Vector__XXX
 SG_ IntLamp_InlTailLmpSta : 0|2@1+ (1,0) [0|0] "" Vector__XXX
 SG_ Lamp_TrnSigLmpLftOnReq : 0|2@1+ (1,0) [0|0] "" Vector__XXX
 SG_ Lamp_TrnSigLmpRtOnReq : 0|2@1+ (1,0) [0|0] "" Vector__XXX
 SG_ ICU_Crc5Val : 0|8@1+ (1,0) [0|0] "" Vector__XXX
 SG_ ICU_AlvCnt5Val : 0|4@1+ (1,0) [0|0] "" Vector__XXX
 SG_ Trunk_TrnkInReleaseSwSta : 0|2@1+ (1,0) [0|0] "" Vector__XXX
 SG_ Trunk_TrnkTlgtOutReleaseSwSta : 0|2@1+ (1,0) [0|0] "" Vector__XXX
 SG_ Trunk_TrnkTlgtSwSta : 0|2@1+ (1,0) [0|0] "" Vector__XXX
 SG_ Trunk_GlvBxTrnkLkSwSta : 0|2@1+ (1,0) [0|0] "" Vector__XXX
 SG_ Trunk_OpnDiagSetSta : 0|2@1+ (1,0) [0|0] "" Vector__XXX
 SG_ USM_OneTouchTrnSigFuncSta : 0|3@1+ (1,0) [0|0] "" Vector__XXX
 SG_ DoorLock_DrvDrUnLkSta : 0|2@1+ (1,0) [0|0] "" Vector__XXX
 SG_ DoorLock_LkOutSta : 0|2@1+ (1,0) [0|0] "" Vector__XXX
 SG_ TwoTrnUnLkOptTyp : 0|2@1+ (1,0) [0|0] "" Vector__XXX
 SG_ Defog_DfgrRlySta : 0|2@1+ (1,0) [0|0] "" Vector__XXX
 SG_ C_CrashUnlockState : 0|2@1+ (1,0) [0|0] "" Vector__XXX
 SG_ CF_Gway_ADrLOptInfo : 0|3@1+ (1,0) [0|0] "" Vector__XXX
 SG_ ICU_Crc7Val : 0|8@1+ (1,0) [0|0] "" Vector__XXX
 SG_ ICU_ADASHapticAutoOnSetReq : 0|2@1+ (1,0) [0|0] "" Vector__XXX
 SG_ ICU_AlvCnt7Val : 0|4@1+ (1,0) [0|0] "" Vector__XXX
 SG_ SEA_ActvSta : 0|2@1+ (1,0) [0|0] "" Vector__XXX
 SG_ ChildLock_ActnFlSta : 0|2@1+ (1,0) [0|0] "" Vector__XXX
 SG_ USM_AutoDrLkReq : 0|3@1+ (1,0) [0|0] "" Vector__XXX
 SG_ USM_AutoDrUnLkReq : 0|3@1+ (1,0) [0|0] "" Vector__XXX
 SG_ USM_HapticCurrentSta : 0|2@1+ (1,0) [0|0] "" Vector__XXX
 SG_ USM_TwoTrnUnLkCurrentSta : 0|2@1+ (1,0) [0|0] "" Vector__XXX
 SG_ ICU_Crc15Val : 0|8@1+ (1,0) [0|0] "" Vector__XXX
 SG_ ICU_AlvCnt15Val : 0|4@1+ (1,0) [0|0] "" Vector__XXX
 SG_ OBCWakeupDrUnlock : 0|2@1+ (1,0) [0|0] "%" Vector__XXX
 SG_ OBCWakeupDrLock : 0|2@1+ (1,0) [0|0] "" Vector__XXX
 SG_ ICU_Crc6Val : 0|8@1+ (1,0) [0|0] "" Vector__XXX
 SG_ ICU_AlvCnt6Val : 0|4@1+ (1,0) [0|0] "" Vector__XXX
 SG_ Lamp_RrTrnSigLmpLftOpnSta : 0|2@1+ (1,0) [0|0] "" Vector__XXX
 SG_ Lamp_RrTrnSigLmpRtOpnSta : 0|2@1+ (1,0) [0|0] "" Vector__XXX
 SG_ Lamp_FrTrnSigLmpLftOpnSta : 0|2@1+ (1,0) [0|0] "" Vector__XXX
 SG_ Lamp_FrTrnSigLmpRtOpnSta : 0|2@1+ (1,0) [0|0] "" Vector__XXX
 SG_ ESC_Crc3Val : 0|16@1+ (1,0) [0|0] "" Vector__XXX
 SG_ ESC_FCA_ActvSta : 0|2@1+ (1,0) [0|0] "" Vector__XXX
 SG_ ESC_DBS_ActvSta : 0|2@1+ (1,0) [0|0] "" Vector__XXX
 SG_ ESC_RccaSta : 0|2@1+ (1,0) [0|0] "" Vector__XXX
 SG_ ESC_PcaSta : 0|2@1+ (1,0) [0|0] "" Vector__XXX
 SG_ ESC_DiffBrkFuncSta : 0|2@1+ (1,0) [0|0] "" Vector__XXX
 SG_ ESC_BcaRPlusSta : 0|2@1+ (1,0) [0|0] "" Vector__XXX
 SG_ ESC_RspaSta : 0|4@1+ (1,0) [0|0] "" Vector__XXX
 SG_ ESC_RspaCanFlFlag : 0|2@1+ (1,0) [0|0] "" Vector__XXX
 SG_ ESC_RspaDclActv : 0|2@1+ (1,0) [0|0] "" Vector__XXX
 SG_ ESC_RspaStandStill : 0|2@1+ (1,0) [0|0] "" Vector__XXX
 SG_ ESC_AlvCnt3Val : 0|8@1+ (1,0) [0|0] "" Vector__XXX
 SG_ MCB_ReqBrkAck : 0|2@1+ (1,0) [0|0] "" Vector__XXX
 SG_ MCB_CtlSta : 0|1@1+ (1,0) [0|0] "" Vector__XXX
 SG_ MCB_DefSta : 0|1@1+ (1,0) [0|0] "" Vector__XXX
 SG_ ESC_LsdLimMod : 0|1@1+ (1,0) [0|0] "" Vector__XXX
 SG_ ESC_LsdOpn : 0|3@1+ (1,0) [0|0] "" Vector__XXX
 SG_ ESC_LsdTqLim : 0|16@1+ (1,0) [0|0] "Nm" Vector__XXX
 SG_ SCC_TqIntrvntnVal : 0|8@1+ (0.390625,0) [0|0] "%" Vector__XXX
 SG_ ESC_VehAccelVal : 0|11@1+ (0.01,-10.23) [0|0] "m/s^2" Vector__XXX
 SG_ ESC_AccelBasisVal : 0|11@1+ (0.01,-10.23) [0|0] "m/s^2" Vector__XXX
 SG_ SCC_OptTyp : 0|2@1+ (1,0) [0|0] "" Vector__XXX
 SG_ SCC_EnblReq : 0|2@1+ (1,0) [0|0] "" Vector__XXX
 SG_ SCC_TqReq : 0|2@1+ (1,0) [0|0] "" Vector__XXX
 SG_ SCC_ReqLimSta : 0|2@1+ (1,0) [0|0] "" Vector__XXX
 SG_ ESC_StdStillVal : 0|2@1+ (1,0) [0|0] "" Vector__XXX
 SG_ ESC_BrkLtReq : 0|2@1+ (1,0) [0|0] "" Vector__XXX
 SG_ ESC_DclEnblReq : 0|2@1+ (1,0) [0|0] "" Vector__XXX
 SG_ ESC_DrvOvrdSta : 0|2@1+ (1,0) [0|0] "" Vector__XXX
 SG_ ESC_DrvBrkSta : 0|2@1+ (1,0) [0|0] "" Vector__XXX
 SG_ ESC_DrvBrkActvSta : 0|2@1+ (1,0) [0|0] "" Vector__XXX
 SG_ ESC_PrkBrkActvSta : 0|2@1+ (1,0) [0|0] "" Vector__XXX
 SG_ FCA_EquipSta : 0|2@1+ (1,0) [0|0] "" Vector__XXX
 SG_ FCA_AvlblSta : 0|2@1+ (1,0) [0|0] "" Vector__XXX
 SG_ Diagnostics_for_PCTool_RES_Byte0 : 0|8@1+ (1,0) [0|0] "" Vector__XXX
 SG_ Diagnostics_for_PCTool_RES_Byte2 : 0|8@1+ (1,0) [0|0] "" Vector__XXX
 SG_ Diagnostics_for_PCTool_RES_Byte3 : 0|8@1+ (1,0) [0|0] "" Vector__XXX
 SG_ Diagnostics_for_PCTool_RES_Byte4 : 0|8@1+ (1,0) [0|0] "" Vector__XXX
 SG_ Diagnostics_for_PCTool_RES_Byte5 : 0|8@1+ (1,0) [0|0] "" Vector__XXX
 SG_ Diagnostics_for_PCTool_RES_Byte6 : 0|8@1+ (1,0) [0|0] "" Vector__XXX
 SG_ Diagnostics_for_PCTool_RES_Byte7 : 0|8@1+ (1,0) [0|0] "" Vector__XXX
 SG_ Diagnostics_for_PCTool_RES_Byte1 : 0|8@1+ (1,0) [0|0] "" Vector__XXX
 SG_ ADAS_PRK_Crc1Val : 0|16@1+ (1,0) [0|0] "" Vector__XXX
 SG_ ADAS_PRK_AlvCnt1Val : 0|8@1+ (1,0) [0|0] "" Vector__XXX
 SG_ PCA_SysSta : 0|3@1+ (1,0) [0|0] "" Vector__XXX
 SG_ PCA_EquipSta : 0|3@1+ (1,0) [0|0] "" Vector__XXX
 SG_ PCA_WrngLvlSta : 0|3@1+ (1,0) [0|0] "" Vector__XXX
 SG_ PCA_WrngSndCtrSta : 0|2@1+ (1,0) [0|0] "" Vector__XXX
 SG_ PCA_WrngSndLftSta : 0|2@1+ (1,0) [0|0] "" Vector__XXX
 SG_ PCA_WrngSndRtSta : 0|2@1+ (1,0) [0|0] "" Vector__XXX
 SG_ PCA_BrkReq : 0|2@1+ (1,0) [0|0] "" Vector__XXX
 SG_ PCA_EpbReq : 0|2@1+ (1,0) [0|0] "" Vector__XXX
 SG_ PCA_DclTrgtVal : 0|4@1+ (0.04,0) [0|0] "g" Vector__XXX
 SG_ PCA_DgrSta : 0|3@1+ (1,0) [0|0] "" Vector__XXX
 SG_ ADAS_PRK_PDW_SwIndOnReq : 0|2@1+ (1,0) [0|0] "" Vector__XXX
 SG_ ADAS_PRK_PDW_OptTyp : 0|3@1+ (1,0) [0|0] "" Vector__XXX
 SG_ ADAS_PRK_PDW_AutoOn_USM : 0|2@1+ (1,0) [0|0] "" Vector__XXX
 SG_ ESC_Crc1Val : 0|16@1+ (1,0) [0|0] "" Vector__XXX
 SG_ TCS_GearShftCharacteristicVal : 0|2@1+ (1,0) [0|0] "" Vector__XXX
 SG_ TCS_ManufacturerVal : 0|2@1+ (1,0) [0|0] "" Vector__XXX
 SG_ TCS_TqIntrvntnVal : 0|8@1+ (0.390625,0) [0|0] "%" Vector__XXX
 SG_ MSR_TqIntrvntnVal : 0|8@1+ (0.390625,0) [0|0] "%" Vector__XXX
 SG_ TCS_SlwTqIntrvntnVal : 0|8@1+ (0.390625,0) [0|0] "%" Vector__XXX
 SG_ ESC_CylPrsrVal : 0|12@1+ (0.1,0) [0|0] "Bar" Vector__XXX
 SG_ ESC_CylPrsrSta : 0|2@1+ (1,0) [0|0] "" Vector__XXX
 SG_ ESC_CylPrsrDiagSta : 0|2@1+ (1,0) [0|0] "" Vector__XXX
 SG_ ESC_CylPrsrFlagSta : 0|2@1+ (1,0) [0|0] "" Vector__XXX
 SG_ ESC_VsmActvSta : 0|2@1+ (1,0) [0|0] "" Vector__XXX
 SG_ ESC_VsmDfctvSta : 0|2@1+ (1,0) [0|0] "" Vector__XXX
 SG_ ESC_VsmCtrlModSta : 0|3@1+ (1,0) [0|0] "" Vector__XXX
 SG_ ESC_AlvCnt1Val : 0|8@1+ (1,0) [0|0] "" Vector__XXX
 SG_ ESC_StrTqReq : 0|12@1+ (0.01,-20.48) [0|0] "Nm" Vector__XXX
 SG_ ESC_LongAccelOffstCalibPrmtr : 0|9@1+ (0.001,-0.255) [0|0] "g" Vector__XXX
 SG_ ESC_IMURstStaAck : 0|1@1+ (1,0) [0|0] "" Vector__XXX
 SG_ AVH_Sta : 0|2@1+ (1,0) [0|0] "" Vector__XXX
 SG_ LDM_Sta : 0|2@1+ (1,0) [0|0] "" Vector__XXX
 SG_ EPB_ActvReq : 0|2@1+ (1,0) [0|0] "" Vector__XXX
 SG_ EPB_StaReq : 0|2@1+ (1,0) [0|0] "" Vector__XXX
 SG_ ECD_ActvSta : 0|2@1+ (1,0) [0|0] "" Vector__XXX
 SG_ AVH_CluDis : 0|8@1+ (1,0) [0|0] "" Vector__XXX
 SG_ AVH_AlrmReq : 0|2@1+ (1,0) [0|0] "" Vector__XXX
 SG_ AVH_ActvStaLmpDis : 0|2@1+ (1,0) [0|0] "" Vector__XXX
 SG_ AVH_LmpDis : 0|3@1+ (1,0) [0|0] "" Vector__XXX
 SG_ AWD_CrdnShftTqLimVal : 0|16@1+ (1,0) [0|0] "Nm" Vector__XXX
 SG_ AWD_CltchDtyLimVal : 0|8@1+ (0.390625,0) [0|0] "%" Vector__XXX
 SG_ AWD_TransmsnTqLimModSta : 0|2@1+ (1,0) [0|0] "" Vector__XXX
 SG_ AWD_RrWhlDtyLimReq : 0|2@1+ (1,0) [0|0] "" Vector__XXX
 SG_ AWD_FastOpnCrdnShftCltchReq : 0|2@1+ (1,0) [0|0] "" Vector__XXX
 SG_ TCS_LmpSta : 0|2@1+ (1,0) [0|0] "" Vector__XXX
 SG_ TCS_OffLmpSta : 0|2@1+ (1,0) [0|0] "" Vector__XXX
 SG_ ESC_OffTempSta : 0|2@1+ (1,0) [0|0] "" Vector__XXX
 SG_ DBC_WrngLmpSta : 0|2@1+ (1,0) [0|0] "" Vector__XXX
 SG_ DBC_FuncLmpSta : 0|2@1+ (1,0) [0|0] "" Vector__XXX
 SG_ DBC_ClusterDis : 0|2@1+ (1,0) [0|0] "" Vector__XXX
 SG_ ESC_BrkCtrlSta : 0|2@1+ (1,0) [0|0] "" Vector__XXX
 SG_ TCS_Sta : 0|4@1+ (1,0) [0|0] "" Vector__XXX
 SG_ ESC_Sta : 0|4@1+ (1,0) [0|0] "" Vector__XXX
 SG_ TCS_PreActvSta : 0|2@1+ (1,0) [0|0] "" Vector__XXX
 SG_ DBC_Sta : 0|4@1+ (1,0) [0|0] "" Vector__XXX
 SG_ TCS_TqFlag : 0|1@1+ (1,0) [0|0] "" Vector__XXX
 SG_ MSR_TqFlag : 0|1@1+ (1,0) [0|0] "" Vector__XXX
 SG_ HAC_Sta : 0|4@1+ (1,0) [0|0] "" Vector__XXX
 SG_ TCS_SlwTqFlag : 0|1@1+ (1,0) [0|0] "" Vector__XXX
 SG_ TCS_Req : 0|2@1+ (1,0) [0|0] "" Vector__XXX
 SG_ MSR_FuncReq : 0|2@1+ (1,0) [0|0] "" Vector__XXX
 SG_ RWS_GST_Byte0 : 0|8@1+ (1,0) [0|0] "" Vector__XXX
 SG_ RWS_GST_Byte2 : 0|8@1+ (1,0) [0|0] "" Vector__XXX
 SG_ RWS_GST_Byte3 : 0|8@1+ (1,0) [0|0] "" Vector__XXX
 SG_ RWS_GST_Byte4 : 0|8@1+ (1,0) [0|0] "" Vector__XXX
 SG_ RWS_GST_Byte5 : 0|8@1+ (1,0) [0|0] "" Vector__XXX
 SG_ RWS_GST_Byte6 : 0|8@1+ (1,0) [0|0] "" Vector__XXX
 SG_ RWS_GST_Byte7 : 0|8@1+ (1,0) [0|0] "" Vector__XXX
 SG_ RWS_GST_Byte1 : 0|8@1+ (1,0) [0|0] "" Vector__XXX
 SG_ BCM_Crc10Val : 0|8@1+ (1,0) [0|0] "" Vector__XXX
 SG_ BCM_AlvCnt10Val : 0|4@1+ (1,0) [0|0] "" Vector__XXX
 SG_ Wiper_PrkngPosSta : 0|2@1+ (1,0) [0|0] "" Vector__XXX
 SG_ Wiper_RainSnsrOptionTyp : 0|2@1+ (1,0) [0|0] "" Vector__XXX
 SG_ Wiper_RainSnsrSta : 0|4@1+ (1,0) [0|0] "" Vector__XXX
 SG_ BCM_SolSnsrRtOutVoltVal : 0|8@1+ (4.72441,0) [0|0] "" Vector__XXX
 SG_ BCM_SolSnsrLftOutVoltVal : 0|8@1+ (4.72441,0) [0|0] "" Vector__XXX
 SG_ BCM_GearPosPSta : 0|2@1+ (1,0) [0|0] "" Vector__XXX
 SG_ BCM_SunRoofOpnSta : 0|2@1+ (1,0) [0|0] "" Vector__XXX
 SG_ Diagnostics_for_PCTool_REQ_Byte0 : 0|8@1+ (1,0) [0|0] "" Vector__XXX
 SG_ Diagnostics_for_PCTool_REQ_Byte2 : 0|8@1+ (1,0) [0|0] "" Vector__XXX
 SG_ Diagnostics_for_PCTool_REQ_Byte3 : 0|8@1+ (1,0) [0|0] "" Vector__XXX
 SG_ Diagnostics_for_PCTool_REQ_Byte4 : 0|8@1+ (1,0) [0|0] "" Vector__XXX
 SG_ Diagnostics_for_PCTool_REQ_Byte5 : 0|8@1+ (1,0) [0|0] "" Vector__XXX
 SG_ Diagnostics_for_PCTool_REQ_Byte6 : 0|8@1+ (1,0) [0|0] "" Vector__XXX
 SG_ Diagnostics_for_PCTool_REQ_Byte7 : 0|8@1+ (1,0) [0|0] "" Vector__XXX
 SG_ Diagnostics_for_PCTool_REQ_Byte1 : 0|8@1+ (1,0) [0|0] "" Vector__XXX
 SG_ GST_RWS_Byte0 : 0|8@1+ (1,0) [0|0] "" Vector__XXX
 SG_ GST_RWS_Byte2 : 0|8@1+ (1,0) [0|0] "" Vector__XXX
 SG_ GST_RWS_Byte3 : 0|8@1+ (1,0) [0|0] "" Vector__XXX
 SG_ GST_RWS_Byte4 : 0|8@1+ (1,0) [0|0] "" Vector__XXX
 SG_ GST_RWS_Byte5 : 0|8@1+ (1,0) [0|0] "" Vector__XXX
 SG_ GST_RWS_Byte6 : 0|8@1+ (1,0) [0|0] "" Vector__XXX
 SG_ GST_RWS_Byte7 : 0|8@1+ (1,0) [0|0] "" Vector__XXX
 SG_ GST_RWS_Byte1 : 0|8@1+ (1,0) [0|0] "" Vector__XXX
 SG_ ADAS_PRK_Crc2Val : 0|16@1+ (1,0) [0|0] "" Vector__XXX
 SG_ ADAS_PRK_AlvCnt2Val : 0|8@1+ (1,0) [0|0] "" Vector__XXX
 SG_ PA_ModDis : 0|3@1+ (1,0) [0|0] "" Vector__XXX
 SG_ PA_ModSelSeqDis : 0|3@1+ (1,0) [0|0] "" Vector__XXX
 SG_ PA_HmiStaDis : 0|8@1+ (1,0) [0|0] "" Vector__XXX
 SG_ PA_FrLftWrngDis : 0|3@1+ (1,0) [0|0] "" Vector__XXX
 SG_ PA_FrCtrWrngDis : 0|3@1+ (1,0) [0|0] "" Vector__XXX
 SG_ PA_FrRtWrngDis : 0|3@1+ (1,0) [0|0] "" Vector__XXX
 SG_ PA_RrLftWrngDis : 0|3@1+ (1,0) [0|0] "" Vector__XXX
 SG_ PA_RrCtrWrngDis : 0|3@1+ (1,0) [0|0] "" Vector__XXX
 SG_ PA_RrRtWrngDis : 0|3@1+ (1,0) [0|0] "" Vector__XXX
 SG_ PA_BpAlrmReq : 0|5@1+ (1,0) [0|0] "" Vector__XXX
 SG_ PA_AlrmVlmLvlReq : 0|3@1+ (1,0) [0|0] "" Vector__XXX
 SG_ PA_AlrmVlmDeratingReq : 0|2@1+ (1,0) [0|0] "" Vector__XXX
 SG_ PA_FrWrngAlrmReq : 0|2@1+ (1,0) [0|0] "" Vector__XXX
 SG_ PA_RrWrngAlrmReq : 0|2@1+ (1,0) [0|0] "" Vector__XXX
 SG_ PA_FrLftWrngAlrmReq : 0|2@1+ (1,0) [0|0] "" Vector__XXX
 SG_ PA_FrCtrWrngAlrmReq : 0|2@1+ (1,0) [0|0] "" Vector__XXX

CM_ SG_ 3221225472 DATC_PeEwpRPMReq "DATC_PeEwpRpmRequest";
CM_ SG_ 3221225472 DATC_AlvCnt1Val "DATC_AliveCounter1Value";
CM_ SG_ 3221225472 DATC_RadFanReq_Duty "This signal indicates Request cooling fan speed to cool HVAC System (Duty)";
CM_ SG_ 3221225472 DATC_OutTempSnsrVal "DATC_OutsideTemperatureSensorValue";
CM_ SG_ 3221225472 DATC_DfgSw "DATC_DefogSwitch";
CM_ SG_ 3221225472 DATC_BattChlrVlv_FltCode "Battery Chiller Filt Code";
CM_ SG_ 3221225472 DATC_BattEvapVlvSta "BATTERY COOL V/V (EVAP) STATUS";
CM_ SG_ 3221225472 DATC_BattEvapVlv_FltCode "BATTERY COOL V/V (EVAP) FltCode";
CM_ SG_ 3221225472 DATC_BattEwpOpReq "Battery EWP Operating Request";
CM_ SG_ 3221225472 DATC_ManufacturerTyp "DATC_ManufacturerType";
CM_ SG_ 3221225472 DATC_AcnCompTyp "DATC_AirconCompressorType";
CM_ SG_ 3221225472 DATC_AcnReq "DATC_AirconRequest";
CM_ SG_ 3221225472 DATC_BlwSta "DATC_BlowerStatus";
CM_ SG_ 3221225472 DATC_BlwMaxSta "DATC_BlowerMaxStatus";
CM_ SG_ 3221225472 DATC_SrvLmpReq "DATC_ServiceLampRequest";
CM_ SG_ 3221225472 DATC_AcnECompOpSta "DATC_AirconElectricCompressorOperationStatus";
CM_ SG_ 3221225472 DATC_AcnCompFltSta "DATC_AirconElectricCompressorFaultStatus";
CM_ SG_ 3221225472 DATC_RrDfgOpSta "DATC_RearDefogOperatingState";
CM_ SG_ 3221225472 DATC_HVCompIntlkSta "DATC_HighVoltageCompressorInterlockStatus";
CM_ SG_ 3221225472 DATC_HVIntDischrgLkReq "DATC_HighVoltageInterlockDischargeRequest";
CM_ SG_ 3221225472 DATC_AcnECompMaxReqPwrVal "DATC_AirconElectricalCompressorMaximumRequestPowerValue";
CM_ SG_ 3221225472 DATC_AcnECompCnsmptPwrVal "DATC_AirconElectricalCompressorConsumptionPowerValue";
CM_ SG_ 3221225472 DATC_MainRlyOffReq "DATC_MainRelayoffRequest";
CM_ SG_ 3221225472 BCM_Crc7Val "BCM_CyclicRedundancyCheck7Value";
CM_ SG_ 3221225472 BCM_AlvCnt7Val "BCM_AliveCounter7Value";
CM_ SG_ 3221225472 Lamp_HiPrioHzrdReq "Lamp_HighPriorityHazardRequest ##2G##BCM - BCMmsg19 - C_HazardFromBCMHigh";
CM_ SG_ 3221225472 Lamp_LoPrioHzrdReq "Lamp_LowPriorityHazardStatus ##2G##BCM - BCMmsg19 - C_HazardfromBCMLow";
CM_ SG_ 3221225472 Lamp_DedicatedDrlOnReq "Lamp_DedicatedDrlOnRequest ##2G##BCM - BCMmsg19 - C_DedicatedDRLOn";
CM_ SG_ 3221225472 Lamp_IntTailLmpOnReq "Lamp_InternalTailLampOnRequest ##2G##BCM - BCMmsg19 - C_IntTailOn";
CM_ SG_ 3221225472 Lamp_ExtrnlTailLmpOnReq "Lamp_ExternalTailLampOnRequest ##2G##BCM - BCMmsg19 - C_ExtTailOn";
CM_ SG_ 3221225472 Lamp_HdLmpLoOnReq "Lamp_HeadLampLowOnRequest ##2G##BCM - BCMmsg19 - C_HLpLowOn";
CM_ SG_ 3221225472 Lamp_HdLmpHiOnReq "Lamp_HeadLampHighOnRequest ##2G##BCM - BCMmsg19 - C_HLpHighOn";
CM_ SG_ 3221225472 Lamp_AvTailLmpSta "Lamp_AvTailLampStatus ##2G##BCM - BCMmsg18 - C_AvTail";
CM_ SG_ 3221225472 BCM_Crc9Val "BCM_CyclicRedundancyCheck9Value";
CM_ SG_ 3221225472 BCM_AlvCnt9Val "BCM_AliveCounter9Value";
CM_ SG_ 3221225472 Lamp_AutoLtSnsrNightSta "Lamp_AutoLightSensorNightStatus ##2G##BCM - BCMmsg24 - C_AutolightValue";
CM_ SG_ 3221225472 Lamp_AutoLtSnsrHorVal "Lamp_AutoLightSensorHorValue ##2G##BCM - BCMmsg24 - C_AutolightSensorHorState";
CM_ SG_ 3221225472 FR_RDR_Crc1Val "FR_RDR_CyclicRedundancyCheck1Value";
CM_ SG_ 3221225472 FR_RDR_AlvCnt1Val "FR_RDR_AliveCounter1Value";
CM_ SG_ 3221225472 FR_RDR_FCAEquipSta "FR_RDR_FCA_Equipment ##2G##FCA - FRT_RADAR11 - CF_FCA_Equip_Front_Radar";
CM_ SG_ 3221225472 FR_RDR_FCA_Plus_Sta "���� ī�޶� �� ���� ���̴� ǻ�� Ʈ���� �̿��Ͽ� FCA-Car Ÿ���� ���� ���� �Ǵ� �� FCA-Car/Ped/Cyc+�ý��ۿ� �����ϴ� FCA-Car Ÿ�� ����/���� ���� ȸ�� �Ұ��� ���� �Ǵ�";
CM_ SG_ 3221225472 FR_RDR_SCCEquipSta "SCC_EquipmentStatus ##2G##SCC -SCC13 - SCC_Equip";
CM_ SG_ 3221225472 FR_RDR_FailInfoSta "Failure state of FR_RDR Sensor/ECU";
CM_ SG_ 3221225472 FR_RDR_CodingSta "Coding state of FR_RDR";
CM_ SG_ 3221225472 FR_RDR_ACANMonSta "A-CANFD network monitoring result";
CM_ SG_ 3221225472 FR_RDR_HDAEquipSta "FR_RDR_HDA_Equipment ##2G##FCA - FRT_RADAR11 - CF_HDA_Equip_Front_Radar";
CM_ SG_ 3221225472 ICU_Crc2Val "ICU_CyclicRedundancyCheck2Value";
CM_ SG_ 3221225472 ICU_AlvCnt2Val "ICU_AliveCounter2Value";
CM_ SG_ 3221225472 Autocut_DlvryModSta "Autocut_DeliveryModeStatus ##2G## -  - C_SJBDeliveryMode,CF_Gway_SJBDeliveryMode";
CM_ SG_ 3221225472 DoorLock_AsstDrUnLkSta "DoorLock_AssistDoorUnLockStatus ##2G## -  - C_AstUnlockState,DoorLock_AsstDrUnLkSta";
CM_ SG_ 3221225472 Warn_DrvDrSwSta "DoorLock_DriverDoorSwitchStatus ##2G## -  - C_DrvDrSw,CF_Gway_DrvDrSw,Warn_DrvDrSwSta";
CM_ SG_ 3221225472 DoorLock_RrLftDrUnLkSta "DoorLock_RearLeftDoorUnLockStatus ##2G## -  - C_RLUnlockState,DoorLock_RrLftDrUnLkSta";
CM_ SG_ 3221225472 DoorLock_RrRtDrUnLkSta "DoorLock_RearRightDoorUnLockStatus ##2G## -  - C_RRUnlockState,DoorLock_RrRtDrUnLkSta";
CM_ SG_ 3221225472 ICU_GearPosRConfirmSta "Output_b_GearBoxRPosition_500msConfirmed";
CM_ SG_ 3221225472 Warn_AsstDrSwSta "Warn_AssistDoorSwitchStatus ##2G## -  - C_AstDrSw,CF_Gway_AstDrSw,Warn_AsstDrSwSta";
CM_ SG_ 3221225472 Warn_AsstStBltSwSta "Warn_AssistSeatBeltSwitchStatus ##2G## -  - C_AstSeatBeltSw,CF_Gway_AstSeatBeltSw";
CM_ SG_ 3221225472 Warn_BrkFldSwSta "Warn_BrakeFluidSwitchStatus ##2G## -  - C_BrakeFluidSw,CF_Gway_BrakeFluidSw";
CM_ SG_ 3221225472 Warn_DrvStBltSwSta "Warn_DriverSeatbeltSwitchStatus ##2G## -  - C_DrvSeatBeltSw,CF_Gway_DrvSeatBeltSw";
CM_ SG_ 3221225472 Warn_HoodSwSta "Warn_HoodSwitchStatus ##2G## -  - C_HoodSw,CF_Gway_HoodSw";
CM_ SG_ 3221225472 Warn_PassStOccSta "Warn_PassengerSeatOccupyStatus ##2G## -  - C_SBRMatSw";
CM_ SG_ 3221225472 Warn_RrCtrStBltSwSta "Warn_RearCenterSeatBeltSwitchStatus ##2G## -  - C_RCSeatBeltSw";
CM_ SG_ 3221225472 Warn_RrLftDrSwSta "Warn_RearLeftDoorSwitchStatus ##2G## -  - C_RLDrSw,CF_Gway_RLDrSw,Warn_RrLftDrSwSta";
CM_ SG_ 3221225472 Warn_RrLftStBltSwSta "Warn_RearLeftSeatBeltSwitchStatus ##2G## -  - C_RLSeatBeltSw";
CM_ SG_ 3221225472 Warn_RrRtDrSwSta "Warn_RearRightDoorSwitchStatus ##2G## -  - C_RRDrSw,CF_Gway_RRDrSw,Warn_RrRtDrSwSta";
CM_ SG_ 3221225472 Warn_RrRtStBltSwSta "Warn_RearRightSeatBeltSwitchStatus ##2G## -  - C_RRSeatBeltSw";
CM_ SG_ 3221225472 Warn_HoodSwMemorySta "Warn_HoodSwitchMemoryStatus ##2G## -  - CF_Hoodsw_memory,C_HoodSwMemory";
CM_ SG_ 3221225472 Warn_WshrFldSwSta "Washer Fluid Switch Signal ##2G## -  - CF_Gway_WasherFluidSw";
CM_ SG_ 3221225472 ICU_Haptic_OPT "Steering Wheel Haptic Warning Option Infomation ##2G## -  - C_ICU_Haptic_OPT";
CM_ SG_ 3221225472 ICU_Crc10Val "ICU_CyclicRedundancyCheck10Value";
CM_ SG_ 3221225472 ICU_AlvCnt10Val "ICU_AliveCounter10Value";
CM_ SG_ 3221225472 ICU_BS2SoC "This signal is battery State of Charge as calculated by battery sensor. ##2G## -  - BS2_SOC,Batt_SoC";
CM_ SG_ 3221225472 ICU_BS2NCap "Nominal capacity ##2G## -  - BS2_CNOM";
CM_ SG_ 3221225472 ICU_BS2OpnCirVol "Last open circuit voltage ##2G## -  - BS2_OCV";
CM_ SG_ 3221225472 ICU_BS2_FSOC "Fault State of SOC";
CM_ SG_ 3221225472 ICU_BS2_FSOH "Fault State of SOH";
CM_ SG_ 3221225472 ICU_BS2_FSOF "Fault State of SOF";
CM_ SG_ 3221225472 ICU_BS2_FQSTAT "State of quiescent current";
CM_ SG_ 3221225472 ICU_BS2SoH "This signal is battery State of Health(SOH) as calculated by battery sensor. ##2G## -  - BAT_SOH";
CM_ SG_ 3221225472 ICU_BS2SoF "This signal is battery State of Function(SOF) as calculated by battery sensor. ##2G## -  - BAT_SOF";
CM_ SG_ 3221225472 ICU_Crc4Val "ICU_CyclicRedundancyCheck4Value";
CM_ SG_ 3221225472 ICU_AlvCnt4Val "ICU_AliveCounter4Value";
CM_ SG_ 3221225472 ExtLamp_TrnSigLmpLftBlnkngSta "ExtLamp_TurnSignalLampLeftBlinkingStatus ##2G## -  - CF_Gway_TurnSigLh,C_TSigLhAct";
CM_ SG_ 3221225472 ExtLamp_TrnSigLmpRtBlnkngSta "ExtLamp_TurnSignalLampRightBlinkingStatus ##2G## -  - CF_Gway_TurnSigRh,C_TSigRhAct";
CM_ SG_ 3221225472 ExtLamp_ExtrnlTailLmpSta "ExtLamp_ExternalTailLampStatus ##2G## -  - C_ExtTailAct,CF_Gway_ExtTailAct";
CM_ SG_ 3221225472 ExtLamp_HzrdSwSta "ExtLamp_HazardSwitchStatus ##2G## -  - C_HazardSw,CF_Gway_HazardSw";
CM_ SG_ 3221225472 ExtLamp_RrFgLmpSta "ExtLamp_RearFogLampStatus ##2G## -  - C_RearFogAct,CF_Gway_RearFogAct";
CM_ SG_ 3221225472 IntLamp_InlTailLmpSta "IntLamp_InternalTailLampStatus ##2G## -  - C_IntTailAct,CF_Gway_IntTailAct";
CM_ SG_ 3221225472 Lamp_TrnSigLmpLftOnReq "Lamp_TurnSignalLampLeftOnRequest ##2G## -  - Lamp_TsigLmpFrtLftOnReq";
CM_ SG_ 3221225472 Lamp_TrnSigLmpRtOnReq "Lamp_TurnSignalLampRightOnRequest ##2G## -  - Lamp_TSigLmpRtLftOnReq";
CM_ SG_ 3221225472 ICU_Crc5Val "ICU_CyclicRedundancyCheck5Value";
CM_ SG_ 3221225472 ICU_AlvCnt5Val "ICU_AliveCounter5Value";
CM_ SG_ 3221225472 Trunk_TrnkInReleaseSwSta "Trunk_TrunkInnerReleaseSwitchStatus ##2G## -  - C_TrunkInnerReleaseSw";
CM_ SG_ 3221225472 Trunk_TrnkTlgtOutReleaseSwSta "Trunk_TrunkTailgateOutReleaseSwitchStatus ##2G## -  - C_TrunkTgOtrReleaseSW";
CM_ SG_ 3221225472 Trunk_TrnkTlgtSwSta "Trunk_TrunkTailgateSwitchStatus ##2G## -  - C_TrunkTgSw,CF_Gway_TrunkTgSw,Trunk_TrnkTlgtSwSta";
CM_ SG_ 3221225472 Trunk_GlvBxTrnkLkSwSta "Trunk_GloveBoxTrunkLockSwitchStatus ##2G## -  - C_GloveBoxTrunkLockSw";
CM_ SG_ 3221225472 Trunk_OpnDiagSetSta "Trunk_OpenDiagnosticSettingStatus ##2G## -  - C_TrunkOpenDiagSet";
CM_ SG_ 3221225472 USM_OneTouchTrnSigFuncSta "USM_OneTouchTurnSignalFunctionStatus ##2G## -  - CF_Gway_OTTurnRValue,C_OTTurnRValue";
CM_ SG_ 3221225472 DoorLock_DrvDrUnLkSta "DoorLock_DriverDoorUnLockStatus ##2G## -  - C_DrvUnlockState,CF_Gway_DrvUnlockState";
CM_ SG_ 3221225472 DoorLock_LkOutSta "DoorLock_LockOutputStatus ##2G## -  - C_LockUnlockOutState";
CM_ SG_ 3221225472 TwoTrnUnLkOptTyp "USM_TwoTurnUnlockOptionType ##2G## -  - C_TTUnlockOption";
CM_ SG_ 3221225472 Defog_DfgrRlySta "Defog_DefoggerRelayStatus ##2G## -  - C_DefoggerRly,CF_Gway_DefoggerRly";
CM_ SG_ 3221225472 C_CrashUnlockState "Crash Unlock Active State";
CM_ SG_ 3221225472 CF_Gway_ADrLOptInfo "vehicle option information for auto door lock/unlock USM";
CM_ SG_ 3221225472 ICU_Crc7Val "ICU_CyclicRedundancyCheck7Value";
CM_ SG_ 3221225472 ICU_ADASHapticAutoOnSetReq "Haptic warning activation state for warning of the driver assist system";
CM_ SG_ 3221225472 ICU_AlvCnt7Val "ICU_AliveCounter7Value";
CM_ SG_ 3221225472 SEA_ActvSta "SEA_ActivationStatus ##2G## -  - C_SEAActivated";
CM_ SG_ 3221225472 ChildLock_ActnFlSta "ChildLock_ActuationFailedStatus ##2G## -  - C_ChildLockFail";
CM_ SG_ 3221225472 USM_AutoDrLkReq "USM_AutoDoorLockRequest ##2G## -  - CF_Gway_ADrLRValue";
CM_ SG_ 3221225472 USM_AutoDrUnLkReq "USM_AutoDoorUnLockRequest ##2G## -  - CF_Gway_ADrURValue";
CM_ SG_ 3221225472 USM_HapticCurrentSta "Haptic USM R-Value";
CM_ SG_ 3221225472 USM_TwoTrnUnLkCurrentSta "USM_TwoTurnUnlockCurrentStatus ##2G## -  - CF_Gway_TTUnlockRValue";
CM_ SG_ 3221225472 ICU_Crc15Val "ICU_CyclicRedundancyCheck15Value";
CM_ SG_ 3221225472 ICU_AlvCnt15Val "ICU_AliveCounter15Value";
CM_ SG_ 3221225472 OBCWakeupDrUnlock "This signal is for OBC wake-up";
CM_ SG_ 3221225472 OBCWakeupDrLock "This signal is for OBC wake-up";
CM_ SG_ 3221225472 ICU_Crc6Val "ICU_CyclicRedundancyCheck6Value";
CM_ SG_ 3221225472 ICU_AlvCnt6Val "ICU_AliveCounter6Value";
CM_ SG_ 3221225472 Lamp_RrTrnSigLmpLftOpnSta "Lamp_RearTurnSignalLampLeftOpenStatus ##2G## -  - C_RearTSIGLhOpenSts";
CM_ SG_ 3221225472 Lamp_RrTrnSigLmpRtOpnSta "Lamp_RearTurnSignalLampRightOpenStatus ##2G## -  - C_RearTSIGRhOpenSts";
CM_ SG_ 3221225472 Lamp_FrTrnSigLmpLftOpnSta "Lamp_FrontTurnSignalLampLeftOpenStatus ##2G## -  - C_FrontTSIGLhOpenSts";
CM_ SG_ 3221225472 Lamp_FrTrnSigLmpRtOpnSta "Lamp_FrontTurnSignalLampRightOpenStatus ##2G## -  - C_FrontTSIGRhOpenSts";
CM_ SG_ 3221225472 ESC_Crc3Val "ESC_CyclicRedundancyCheck3Value";
CM_ SG_ 3221225472 ESC_FCA_ActvSta "Status of control for FCA control request flag";
CM_ SG_ 3221225472 ESC_DBS_ActvSta "ESC_DBS_ActvSta ##2G## ESC - TCS11 - DBS_ACK";
CM_ SG_ 3221225472 ESC_RccaSta "ESC_RccaStatus ##2G##ESC - ESP11 - ESP_RCCA_STAT";
CM_ SG_ 3221225472 ESC_PcaSta "ESC_PcaStatus";
CM_ SG_ 3221225472 ESC_DiffBrkFuncSta "ESC_DifferentialBrakeFunctionStatus ##2G##ESC - TCS13 - DF_BF_STAT";
CM_ SG_ 3221225472 ESC_BcaRPlusSta "ESC_BcaRPlusStatus";
CM_ SG_ 3221225472 ESC_RspaSta "ESC_RspaStatus ##2G##ESC - ESP11 - ESP_RSPA_STAT";
CM_ SG_ 3221225472 ESC_RspaCanFlFlag "##2G##ESC - ESP11 - ESC_RspaCanfailflag";
CM_ SG_ 3221225472 ESC_RspaDclActv "##2G##ESC - ESP11 - ESC_RSPA_DEC_ACT";
CM_ SG_ 3221225472 ESC_RspaStandStill "##2G##ESC - ESP11 - ESC_RSPA_STANDSTILL";
CM_ SG_ 3221225472 ESC_AlvCnt3Val "ESC_AliveCounter3Value";
CM_ SG_ 3221225472 MCB_ReqBrkAck "Acknowledge Status for MCB Brake Request";
CM_ SG_ 3221225472 MCB_CtlSta "Status for MCB Activation";
CM_ SG_ 3221225472 MCB_DefSta "Status for MCB defect";
CM_ SG_ 3221225472 ESC_LsdLimMod "eLSD torque limit mode ##2G##ESC - ESP_LSD11 - LSD_LIM_MODE";
CM_ SG_ 3221225472 ESC_LsdOpn "eLSD clutch open mode ##2G##ESC - ESP_LSD11 - LSD_OPEN";
CM_ SG_ 3221225472 ESC_LsdTqLim "value of the torquel limit of eLSD ##2G##ESC - ESP_LSD11 - LSD_TQC_LIM";
CM_ SG_ 3221225472 SCC_TqIntrvntnVal "SCC_TorqueInterventionValue ##2G##ESC - TCS13 - TQI_ACC";
CM_ SG_ 3221225472 ESC_VehAccelVal "ESC_VehicleAccelerationValue ##2G##ESC - TCS13 - ACCEL_REF_ACC";
CM_ SG_ 3221225472 ESC_AccelBasisVal "ESC_AccelerationBasisValue ##2G##ESC - TCS13 - aBasis";
CM_ SG_ 3221225472 SCC_OptTyp "SCC_OptionType ##2G##ESC - TCS13 - ACC_EQUIP";
CM_ SG_ 3221225472 SCC_EnblReq "SCC_EnableRequest ##2G##ESC - TCS13 - ACCEnable";
CM_ SG_ 3221225472 SCC_TqReq "SCC_TorqueRequest ##2G##ESC - TCS13 - ACC_REQ";
CM_ SG_ 3221225472 SCC_ReqLimSta "SCC_RequestLimitedStatus ##2G##ESC - TCS13 - ACCReqLim";
CM_ SG_ 3221225472 ESC_StdStillVal "ESC_StandStillValue ##2G##ESC - TCS13 - StandStill";
CM_ SG_ 3221225472 ESC_BrkLtReq "ESC_BrakeLightRequest ##2G##ESC - TCS13 - BrakeLight";
CM_ SG_ 3221225472 ESC_DclEnblReq "ESC_DecelerationEnableRequest ##2G##ESC - TCS13 - DCEnable";
CM_ SG_ 3221225472 ESC_DrvOvrdSta "ESC_OverrideRequest ##2G##ESC - TCS13 - DriverOverride";
CM_ SG_ 3221225472 ESC_DrvBrkSta "ESC_DriverBrakingStatus ##2G##ESC - TCS13 - CF_DriBkeStat";
CM_ SG_ 3221225472 ESC_DrvBrkActvSta "ESC_DriverBrakingActiveStatus ##2G##ESC - TCS13 - DriverBraking";
CM_ SG_ 3221225472 ESC_PrkBrkActvSta "ESC_ParkingBrakeActiveStatus ##2G##ESC - TCS13 - PBRAKE_ACT";
CM_ SG_ 3221225472 FCA_EquipSta "FCA_EquipmentStatus ##2G##ESC - TCS13 - FCA_EQUIP";
CM_ SG_ 3221225472 FCA_AvlblSta "VSM_AvailableStatus ##2G##ESC - TCS13 - CF_VSM_Avail";
CM_ SG_ 3221225472 ADAS_PRK_Crc1Val "ADAS_PRK_CyclicRedundancyCheck1Value";
CM_ SG_ 3221225472 ADAS_PRK_AlvCnt1Val "ADAs_PRK_AliveCounter1Value";
CM_ SG_ 3221225472 PCA_SysSta "PCA_SystemStatus";
CM_ SG_ 3221225472 PCA_EquipSta "PCA_EquipmentStatus";
CM_ SG_ 3221225472 PCA_WrngLvlSta "PCA_WarningLevelStatus";
CM_ SG_ 3221225472 PCA_WrngSndCtrSta "PCA_WarningSoundCenterStatus";
CM_ SG_ 3221225472 PCA_WrngSndLftSta "PCA_WarningSoundLeftStatus";
CM_ SG_ 3221225472 PCA_WrngSndRtSta "PCA_WarningSoundRightStatus";
CM_ SG_ 3221225472 PCA_BrkReq "PCA_BrakeRequest";
CM_ SG_ 3221225472 PCA_EpbReq "PCA_EPBRequest";
CM_ SG_ 3221225472 PCA_DclTrgtVal "PCA_DecelerationTargetValue";
CM_ SG_ 3221225472 PCA_DgrSta "PCA_DegreeStatus";
CM_ SG_ 3221225472 ESC_Crc1Val "ESC_CyclicRedundancyCheck1Value";
CM_ SG_ 3221225472 TCS_GearShftCharacteristicVal "TCS_GearShiftCharacteristicValue ##2G##ESC - TCS11 - TCS_GSC";
CM_ SG_ 3221225472 TCS_ManufacturerVal "TCS_ManufacturerInformationValue ##2G##ESC - TCS11 - TCS_MFRN";
CM_ SG_ 3221225472 TCS_TqIntrvntnVal "TCS_TorqueInterventionValue ##2G##ESC - TCS11 - TQI_TCS";
CM_ SG_ 3221225472 MSR_TqIntrvntnVal "MSR_TorqueInterventionValue ##2G##ESC - TCS11 - TQI_MSR";
CM_ SG_ 3221225472 TCS_SlwTqIntrvntnVal "TCS_SlowTorqueInterventionValue ##2G##ESC - TCS11 - TQI_SLW_TCS";
CM_ SG_ 3221225472 ESC_CylPrsrVal "ESC_CylinderPressureValue ##2G##ESC - ESP12 - CYL_PRES";
CM_ SG_ 3221225472 ESC_CylPrsrSta "ESC_CylinderPressureStatus ##2G##ESC - ESP12 - CYL_PRES_STAT";
CM_ SG_ 3221225472 ESC_CylPrsrDiagSta "ESC_CylinderPressureDiagnosisStatus ##2G##ESC - ESP12 - CYL_PRESS_DIAG";
CM_ SG_ 3221225472 ESC_CylPrsrFlagSta "ESC_CylinderPressureFlagStatus ##2G##ESC - ESP12 - CYL_PRES_FLAG";
CM_ SG_ 3221225472 ESC_VsmActvSta "ESC_VsmActiveStatus ##2G##ESC - VSM11 - CF_Esc_Act";
CM_ SG_ 3221225472 ESC_VsmDfctvSta "ESC_VsmDefectiveStatus ##2G##ESC - VSM11 - CF_Esc_Def";
CM_ SG_ 3221225472 ESC_VsmCtrlModSta "ESC_VsmControlModeStatus ##2G##ESC - VSM11 - CF_Esc_CtrMode";
CM_ SG_ 3221225472 ESC_AlvCnt1Val "ESC_AliveCounter1Value";
CM_ SG_ 3221225472 ESC_StrTqReq "ESC_SteeringTorqueReqeust ##2G##ESC - VSM11 - CR_Esc_StrTqReq";
CM_ SG_ 3221225472 ESC_LongAccelOffstCalibPrmtr "Longitudinal Acceleration Offset Calibration Parameter";
CM_ SG_ 3221225472 ESC_IMURstStaAck "IMU Reset Status Acknowledge";
CM_ SG_ 3221225472 AVH_Sta "AVH_Status ##2G##ESC - ESP11 - AVH_STAT";
CM_ SG_ 3221225472 LDM_Sta "LDM_Status ##2G##ESC - ESP11 - LDM_STAT";
CM_ SG_ 3221225472 EPB_ActvReq "EPB_ActiveRequest ##2G##ESC - ESP11 - REQ_EPB_ACT";
CM_ SG_ 3221225472 EPB_StaReq "EPB_StatusRequest ##2G##ESC - ESP11 - REQ_EPB_STAT";
CM_ SG_ 3221225472 ECD_ActvSta "ECD_ActiveStatus ##2G##ESC - ESP11 - ECD_ACT";
CM_ SG_ 3221225472 AVH_CluDis "AVH_ClusterDisplay ##2G##ESC - TCS15 - AVH_CLU";
CM_ SG_ 3221225472 AVH_AlrmReq "AVH_AlarmRequest ##2G##ESC - TCS15 - AVH_ALARM";
CM_ SG_ 3221225472 AVH_ActvStaLmpDis "AVH_ActiveStatusLampDisplay ##2G##ESC - TCS15 - AVH_I_LAMP";
CM_ SG_ 3221225472 AVH_LmpDis "AVH_LampDisplay ##2G##ESC - TCS15 - AVH_LAMP";
CM_ SG_ 3221225472 AWD_CrdnShftTqLimVal "AWD_CardanShaftTorqueLimitValue ##2G##ESC - ESP11 - 4WD_TQC_LIM";
CM_ SG_ 3221225472 AWD_CltchDtyLimVal "AWD_ClutchDutyLimitValue ##2G##ESC - ESP11 - 4WD_CLU_LIM";
CM_ SG_ 3221225472 AWD_TransmsnTqLimModSta "AWD_TransmissionTorqueLimitModeStatus ##2G##ESC - ESP11 - 4WD_LIM_MODE";
CM_ SG_ 3221225472 AWD_RrWhlDtyLimReq "AWD_RearWheelDutyLimitRequest ##2G##ESC - ESP11 - 4WD_LIM_REQ";
CM_ SG_ 3221225472 AWD_FastOpnCrdnShftCltchReq "AWD_FastOpenCardanShaftClutchRequest ##2G##ESC - ESP11 - 4WD_OPEN";
CM_ SG_ 3221225472 TCS_LmpSta "TCS_LampStatus ##2G##ESC - TCS15 - TCS_LAMP";
CM_ SG_ 3221225472 TCS_OffLmpSta "TCS_OffLampStatus ##2G##ESC - TCS15 - TCS_OFF_LAMP";
CM_ SG_ 3221225472 ESC_OffTempSta "ESC_OffStepStatus ##2G##ESC - TCS15 - ESC_Off_Step";
CM_ SG_ 3221225472 DBC_WrngLmpSta "DBC_WarningLampStatus ##2G##ESC - TCS15 - DBC_W_LAMP";
CM_ SG_ 3221225472 DBC_FuncLmpSta "DBC_FuncitonLampStatus ##2G##ESC - TCS15 - DBC_F_LAMP";
CM_ SG_ 3221225472 DBC_ClusterDis "DBC Pop-up Signal for Deactivation";
CM_ SG_ 3221225472 ESC_BrkCtrlSta "ESC_BrakeControlStatus ##2G##ESC - TCS11 - CF_Esc_BrkCtl";
CM_ SG_ 3221225472 TCS_Sta "Status of TCS Function";
CM_ SG_ 3221225472 ESC_Sta "Status of ESC Function";
CM_ SG_ 3221225472 TCS_PreActvSta "TCS_PreActiveStatus ##2G##ESC - TCS13 - Pre_TCS_CTL";
CM_ SG_ 3221225472 DBC_Sta "Status of DBC Function";
CM_ SG_ 3221225472 TCS_TqFlag "Flag indicating positive or negative TCS Intervention";
CM_ SG_ 3221225472 MSR_TqFlag "Flag indicating positive or negative MSR Intervention";
CM_ SG_ 3221225472 HAC_Sta "Status of HAC Function";
CM_ SG_ 3221225472 TCS_SlwTqFlag "Flag indicating positive or negative SLOW TCS Intervention";
CM_ SG_ 3221225472 TCS_Req "TCS_Request ##2G##ESC - TCS11 - TCS_REQ";
CM_ SG_ 3221225472 MSR_FuncReq "MSR_FunctionRequest ##2G##ESC - TCS11 - MSR_C_REQ";
CM_ SG_ 3221225472 BCM_Crc10Val "BCM_CyclicRedundancyCheck10Value";
CM_ SG_ 3221225472 BCM_AlvCnt10Val "BCM_AliveCounter10Value";
CM_ SG_ 3221225472 Wiper_PrkngPosSta "Wiper_ParkingPositionStatus ##2G##BCM - BCMmsg22 - C_WiperParkPosition";
CM_ SG_ 3221225472 Wiper_RainSnsrOptionTyp "Wiper_RainSensorOptionType ##2G##BCM - BCMmsg24 - C_RainSnsOption";
CM_ SG_ 3221225472 Wiper_RainSnsrSta "Wiper_RainSensorStatus ##2G##BCM - BCMmsg24 - C_RainSnsState";
CM_ SG_ 3221225472 BCM_SolSnsrRtOutVoltVal "BCM_SolarSensorRightOutputVoltageValue ##2G##BCM - BCMmsg24 - C_PhotosensorRH";
CM_ SG_ 3221225472 BCM_SolSnsrLftOutVoltVal "BCM_SolarSensorLeftOutputVoltageValue ##2G##BCM - BCMmsg24 - C_PhotosensorLH";
CM_ SG_ 3221225472 BCM_GearPosPSta "BCM_GearPositionPStatus ##2G##BCM - BCMmsg17 - C_PpositiOn";
CM_ SG_ 3221225472 BCM_SunRoofOpnSta "BCM_SunRoofOpenStatus ##2G##BCM - BCMmsg20 - C_SunRoofOpenState";
CM_ SG_ 3221225472 ADAS_PRK_Crc2Val "ADAS_PRK_CyclicRedundancyCheck2Value";
CM_ SG_ 3221225472 ADAS_PRK_AlvCnt2Val "ADAS_PRK_AliveCounter2Value";
CM_ SG_ 3221225472 PA_ModDis "PA_ModeDisplay";
CM_ SG_ 3221225472 PA_ModSelSeqDis "PA_ModeSelectionSequenceDisplay";
CM_ SG_ 3221225472 PA_HmiStaDis "PA_HmiStateDisplay";
CM_ SG_ 3221225472 PA_FrLftWrngDis "PA_FrontLeftWarningDisplay";
CM_ SG_ 3221225472 PA_FrCtrWrngDis "PA_FrontCenterWarningDisplay";
CM_ SG_ 3221225472 PA_FrRtWrngDis "PA_FrontRightWarningDisplay";
CM_ SG_ 3221225472 PA_RrLftWrngDis "PA_RearLeftWarningDisplay";
CM_ SG_ 3221225472 PA_RrCtrWrngDis "PA_RearCenterWarningDisplay";
CM_ SG_ 3221225472 PA_RrRtWrngDis "PA_RearRightWarningDisplay";
CM_ SG_ 3221225472 PA_BpAlrmReq "PA_BeepAlarmRequest";
CM_ SG_ 3221225472 PA_AlrmVlmLvlReq "PA_AlarmVolumeLevelRequest";
CM_ SG_ 3221225472 PA_AlrmVlmDeratingReq "PA_AlarmVolumeDeratingRequest";
CM_ SG_ 3221225472 PA_FrWrngAlrmReq "PA_FrontWarningAlarmRequest";
CM_ SG_ 3221225472 PA_RrWrngAlrmReq "PA_RearWarningAlarmRequest";
CM_ SG_ 3221225472 PA_FrLftWrngAlrmReq "PA_FrontLeftWarningAlarmRequest";
CM_ SG_ 3221225472 PA_FrCtrWrngAlrmReq "PA_FrontCenterWarningAlarmRequest";
BA_DEF_ BO_  "GenMsgEVName" STRING ;
BA_DEF_ BO_  "UsrMsgIDSforwardDeviation" INT 0 100;
BA_DEF_ BO_  "UsrMsgIDSbackwardDeviation" INT 50 1000;
BA_DEF_ BO_  "GenMsgCycleTime" INT 0 2000;
BA_DEF_ BO_  "GenMsgStartDelayTime" INT 0 2000;
BA_DEF_ BO_  "GenMsgSendType" ENUM  "Cyclic","NoMsgSendType";
BA_DEF_ BO_  "GenMsgCycleTimeFast" INT 0 500;
BA_DEF_ BO_  "GenMsgDelayTime" INT 0 20;
BA_DEF_ BO_  "GenMsgILSupport" ENUM  "No","Yes";
BA_DEF_ BO_  "GenMsgNrOfRepetition" INT 0 3;
BA_DEF_ BO_  "VFrameFormat" ENUM  "StandardCAN","ExtendedCAN","reserved","reserved","reserved","reserved","reserved","reserved","reserved","reserved","reserved","reserved","reserved","reserved","StandardCAN_FD","ExtendedCAN_FD";
BA_DEF_ SG_  "UserSigValidity" ENUM  "B+","ACC","IG","IG1","IG2","IG3","IG1 or IG2","IG1 or IG3","Undef";
BA_DEF_ SG_  "UsrSigPurpose" ENUM  "Undef","FN","DIAG","DIAG(Req)","DIAG(Res)","DIAG(Phy)","DEV","CCP(Req)","CCP(Res)","NM","TP";
BA_DEF_ SG_  "GenSigStartValue" INT 0 1215752192;
BA_DEF_ SG_  "NetworkRequest" ENUM  "Yes","No";
BA_DEF_ SG_  "NetworkRequestHoldingTime" INT 0 65535;
BA_DEF_ SG_  "Description" STRING ;
BA_DEF_ SG_  "Version" STRING ;
BA_DEF_ SG_  "GenSigEnvVarType" ENUM  "Int","Float","Undef";
BA_DEF_ SG_  "GenSigSendType" ENUM  "Cyclic","OnWrite","OnWriteWithRepetition","OnChange","OnChangeWithRepetition","IfActive","IfActiveWithRepetition","NoSigSendType","OnChangeAndIfActive","OnChangeAndIfActiveWithRepetition";
BA_DEF_ SG_  "GwSigLatencyTime" INT 0 65536;
BA_DEF_ SG_  "GwSigMissingSourceType" ENUM  "Undef","OldValue","DefaultValue","InitialValue";
BA_DEF_ SG_  "NWM-WakeupAllowed" ENUM  "<n.a.>";
BA_DEF_ SG_  "RoutingFactor" INT 1 1215752192;
BA_DEF_REL_ BU_SG_REL_  "GenSigTimeoutTime" INT 0 7000;
BA_DEF_DEF_  "GenMsgEVName" "@Signame";
BA_DEF_DEF_  "UsrMsgIDSforwardDeviation" 10;
BA_DEF_DEF_  "UsrMsgIDSbackwardDeviation" 100;
BA_DEF_DEF_  "GenMsgCycleTime" 200;
BA_DEF_DEF_  "GenMsgStartDelayTime" 0;
BA_DEF_DEF_  "GenMsgSendType" "NoMsgSendType";
BA_DEF_DEF_  "GenMsgCycleTimeFast" 40;
BA_DEF_DEF_  "GenMsgDelayTime" 20;
BA_DEF_DEF_  "GenMsgILSupport" "Yes";
BA_DEF_DEF_  "GenMsgNrOfRepetition" 3;
BA_DEF_DEF_  "VFrameFormat" "StandardCAN";
BA_DEF_DEF_  "UserSigValidity" "IG";
BA_DEF_DEF_  "UsrSigPurpose" "FN";
BA_DEF_DEF_  "GenSigStartValue" 0;
BA_DEF_DEF_  "NetworkRequest" "No";
BA_DEF_DEF_  "NetworkRequestHoldingTime" 0;
BA_DEF_DEF_  "Description" "";
BA_DEF_DEF_  "Version" "";
BA_DEF_DEF_  "GenSigEnvVarType" "Undef";
BA_DEF_DEF_  "GenSigSendType" "NoSigSendType";
BA_DEF_DEF_  "GwSigLatencyTime" 40;
BA_DEF_DEF_  "GwSigMissingSourceType" "Undef";
BA_DEF_DEF_  "NWM-WakeupAllowed" "<n.a.>";
BA_DEF_DEF_  "RoutingFactor" 1;
BA_DEF_DEF_REL_ "GenSigTimeoutTime" 500;
BA_ "Version" SG_ 3221225472 DATC_PeEwpRPMReq "17.11.00";
BA_ "RoutingFactor" SG_ 3221225472 DATC_PeEwpRPMReq 5;
BA_ "UserSigValidity" SG_ 3221225472 DATC_PeEwpRPMReq 3;
BA_ "Description" SG_ 3221225472 DATC_PeEwpRPMReq "This signal indicates Cooling For High V Component (for A/C or Heatpump)

����� �ð�����, �������� �̿��� �����ÿ�";
BA_ "Version" SG_ 3221225472 DATC_AlvCnt1Val "18.11.08";
BA_ "RoutingFactor" SG_ 3221225472 DATC_AlvCnt1Val 5;
BA_ "UserSigValidity" SG_ 3221225472 DATC_AlvCnt1Val 7;
BA_ "Description" SG_ 3221225472 DATC_AlvCnt1Val "For the first transmission request for a data element the counter shall be initialized with 0 and shall be incremented by 1 for every subsequent send request. 

When the counter reaches the maximum value(0xFF), then it shall restart with 0 for the next s";
BA_ "Version" SG_ 3221225472 DATC_RadFanReq_Duty "18.09.01";
BA_ "RoutingFactor" SG_ 3221225472 DATC_RadFanReq_Duty 5;
BA_ "UserSigValidity" SG_ 3221225472 DATC_RadFanReq_Duty 5;
BA_ "Description" SG_ 3221225472 DATC_RadFanReq_Duty "This signal indicates Request cooling fan speed to cool HVAC System (Duty)";
BA_ "Version" SG_ 3221225472 DATC_OutTempSnsrVal "17.11.00";
BA_ "RoutingFactor" SG_ 3221225472 DATC_OutTempSnsrVal 5;
BA_ "UserSigValidity" SG_ 3221225472 DATC_OutTempSnsrVal 7;
BA_ "Description" SG_ 3221225472 DATC_OutTempSnsrVal "Actual temperature of Ambient Sensor via an A/D converter; converted into degrees

centigrade (��).

This is raw data of ambient sensor; just transferred from Ambient Sensor Voltage.";
BA_ "Version" SG_ 3221225472 DATC_DfgSw "17.11.00";
BA_ "RoutingFactor" SG_ 3221225472 DATC_DfgSw 5;
BA_ "UserSigValidity" SG_ 3221225472 DATC_DfgSw 7;
BA_ "Description" SG_ 3221225472 DATC_DfgSw "This signal indicates whether FRONT DEF switch is selected or not.";
BA_ "Version" SG_ 3221225472 DATC_BattChlrVlv_FltCode "18.09.00";
BA_ "RoutingFactor" SG_ 3221225472 DATC_BattChlrVlv_FltCode 5;
BA_ "UserSigValidity" SG_ 3221225472 DATC_BattChlrVlv_FltCode 3;
BA_ "Description" SG_ 3221225472 DATC_BattChlrVlv_FltCode "Battery Chiller Filt Code";
BA_ "Version" SG_ 3221225472 DATC_BattEvapVlvSta "18.09.00";
BA_ "RoutingFactor" SG_ 3221225472 DATC_BattEvapVlvSta 5;
BA_ "UserSigValidity" SG_ 3221225472 DATC_BattEvapVlvSta 5;
BA_ "Description" SG_ 3221225472 DATC_BattEvapVlvSta "BATTERY COOL V/V (EVAP) STATUS";
BA_ "Version" SG_ 3221225472 DATC_BattEvapVlv_FltCode "18.09.00";
BA_ "RoutingFactor" SG_ 3221225472 DATC_BattEvapVlv_FltCode 5;
BA_ "UserSigValidity" SG_ 3221225472 DATC_BattEvapVlv_FltCode 5;
BA_ "Description" SG_ 3221225472 DATC_BattEvapVlv_FltCode "BATTERY COOL V/V (EVAP) FltCode";
BA_ "Version" SG_ 3221225472 DATC_BattEwpOpReq "18.12.03";
BA_ "RoutingFactor" SG_ 3221225472 DATC_BattEwpOpReq 5;
BA_ "UserSigValidity" SG_ 3221225472 DATC_BattEwpOpReq 5;
BA_ "Description" SG_ 3221225472 DATC_BattEwpOpReq "This signal requests the operation of BATT EWP for heat recovery technique.";
BA_ "Version" SG_ 3221225472 DATC_BlwrLvl "18.10.06";
BA_ "RoutingFactor" SG_ 3221225472 DATC_BlwrLvl 5;
BA_ "UserSigValidity" SG_ 3221225472 DATC_BlwrLvl 7;
BA_ "Description" SG_ 3221225472 DATC_BlwrLvl "This signal indicates step of Front blower operation .";
BA_ "Version" SG_ 3221225472 DATC_AAFOpenReq "19.06.03";
BA_ "RoutingFactor" SG_ 3221225472 DATC_AAFOpenReq 5;
BA_ "UserSigValidity" SG_ 3221225472 DATC_AAFOpenReq 7;
BA_ "Description" SG_ 3221225472 DATC_AAFOpenReq "Open Reqest Active Air Flap(AAF) before Compressor max rpm";
BA_ "Version" SG_ 3221225472 DATC_ManufacturerTyp "17.11.00";
BA_ "RoutingFactor" SG_ 3221225472 DATC_ManufacturerTyp 5;
BA_ "UserSigValidity" SG_ 3221225472 DATC_ManufacturerTyp 3;
BA_ "Description" SG_ 3221225472 DATC_ManufacturerTyp "This signal FATC_ID identifies FATC Maker.";
BA_ "Version" SG_ 3221225472 DATC_AcnCompTyp "17.11.00";
BA_ "RoutingFactor" SG_ 3221225472 DATC_AcnCompTyp 5;
BA_ "UserSigValidity" SG_ 3221225472 DATC_AcnCompTyp 3;
BA_ "Description" SG_ 3221225472 DATC_AcnCompTyp "Heater Control(FATC/MTC) information generated by HVAC Compressor type.";
BA_ "Version" SG_ 3221225472 DATC_AcnReq "17.11.00";
BA_ "RoutingFactor" SG_ 3221225472 DATC_AcnReq 5;
BA_ "UserSigValidity" SG_ 3221225472 DATC_AcnReq 7;
BA_ "Description" SG_ 3221225472 DATC_AcnReq "This signal indicates A/C request switch by FATC

This signal occurs when A/C switch(button) is selected either manually or automatically.

EMS decides the torque compensation value to avoid torque shortage while A/C on";
BA_ "Version" SG_ 3221225472 DATC_BlwSta "17.11.00";
BA_ "RoutingFactor" SG_ 3221225472 DATC_BlwSta 5;
BA_ "UserSigValidity" SG_ 3221225472 DATC_BlwSta 7;
BA_ "Description" SG_ 3221225472 DATC_BlwSta "This signal indicates HVAC blower motor operation condition.

The signal is used for EMS to decide PTC on or manage battery level.";
BA_ "Version" SG_ 3221225472 DATC_BlwMaxSta "17.11.00";
BA_ "RoutingFactor" SG_ 3221225472 DATC_BlwMaxSta 5;
BA_ "UserSigValidity" SG_ 3221225472 DATC_BlwMaxSta 7;
BA_ "Description" SG_ 3221225472 DATC_BlwMaxSta "This signal indicates that FATC operates HVAC blower by maximum speed.";
BA_ "Version" SG_ 3221225472 DATC_SrvLmpReq "19.08.04";
BA_ "RoutingFactor" SG_ 3221225472 DATC_SrvLmpReq 5;
BA_ "UserSigValidity" SG_ 3221225472 DATC_SrvLmpReq 7;
BA_ "Description" SG_ 3221225472 DATC_SrvLmpReq "This signal indicates request of service Lamp";
BA_ "Version" SG_ 3221225472 DATC_AcnECompOpSta "17.11.00";
BA_ "RoutingFactor" SG_ 3221225472 DATC_AcnECompOpSta 5;
BA_ "UserSigValidity" SG_ 3221225472 DATC_AcnECompOpSta 7;
BA_ "Version" SG_ 3221225472 DATC_AcnCompFltSta "17.11.00";
BA_ "RoutingFactor" SG_ 3221225472 DATC_AcnCompFltSta 5;
BA_ "UserSigValidity" SG_ 3221225472 DATC_AcnCompFltSta 7;
BA_ "Version" SG_ 3221225472 DATC_RrDfgOpSta "17.11.00";
BA_ "RoutingFactor" SG_ 3221225472 DATC_RrDfgOpSta 5;
BA_ "UserSigValidity" SG_ 3221225472 DATC_RrDfgOpSta 3;
BA_ "Version" SG_ 3221225472 DATC_HVCompIntlkSta "17.11.00";
BA_ "RoutingFactor" SG_ 3221225472 DATC_HVCompIntlkSta 5;
BA_ "UserSigValidity" SG_ 3221225472 DATC_HVCompIntlkSta 7;
BA_ "Version" SG_ 3221225472 DATC_HVIntDischrgLkReq "17.11.00";
BA_ "RoutingFactor" SG_ 3221225472 DATC_HVIntDischrgLkReq 5;
BA_ "UserSigValidity" SG_ 3221225472 DATC_HVIntDischrgLkReq 7;
BA_ "Description" SG_ 3221225472 DATC_HVIntDischrgLkReq "This signal indicates forced discharge request when HV PTC Interlock or E-Compressor Interlock is open.";
BA_ "Version" SG_ 3221225472 DATC_AcnECompMaxReqPwrVal "19.08.04";
BA_ "RoutingFactor" SG_ 3221225472 DATC_AcnECompMaxReqPwrVal 5;
BA_ "UserSigValidity" SG_ 3221225472 DATC_AcnECompMaxReqPwrVal 7;
BA_ "Description" SG_ 3221225472 DATC_AcnECompMaxReqPwrVal "0....20440[W] = 00H...3FEH (PH)= 20 * (HEX)[W]";
BA_ "Version" SG_ 3221225472 DATC_AcnECompCnsmptPwrVal "19.08.04";
BA_ "RoutingFactor" SG_ 3221225472 DATC_AcnECompCnsmptPwrVal 5;
BA_ "UserSigValidity" SG_ 3221225472 DATC_AcnECompCnsmptPwrVal 7;
BA_ "Description" SG_ 3221225472 DATC_AcnECompCnsmptPwrVal "0��20440[W] = 00H...3FEH (PH)= 20 * (HEX)[W]";
BA_ "Version" SG_ 3221225472 DATC_MainRlyOffReq "17.11.00";
BA_ "RoutingFactor" SG_ 3221225472 DATC_MainRlyOffReq 5;
BA_ "UserSigValidity" SG_ 3221225472 DATC_MainRlyOffReq 3;
BA_ "Version" SG_ 3221225472 BCM_Crc7Val "18.11.08";
BA_ "UserSigValidity" SG_ 3221225472 BCM_Crc7Val 0;
BA_ "GenSigStartValue" SG_ 3221225472 BCM_Crc7Val 255;
BA_ "GenSigSendType" SG_ 3221225472 BCM_Crc7Val 4;
BA_ "Description" SG_ 3221225472 BCM_Crc7Val "The data area for CRC calculation is based on the data length (DLC) of the message DB.

The CRC shall be calculated over the entire data block (excluding the CRC bytes) including the user data, alive counter and Data ID 

 

- CRC Polynomial (0x1D) , Ini";
BA_ "Version" SG_ 3221225472 BCM_AlvCnt7Val "18.11.08";
BA_ "UserSigValidity" SG_ 3221225472 BCM_AlvCnt7Val 0;
BA_ "GenSigSendType" SG_ 3221225472 BCM_AlvCnt7Val 4;
BA_ "Description" SG_ 3221225472 BCM_AlvCnt7Val "For the first transmission request for a data element the counter shall be initialized with 0 and shall be incremented by 1

for every subsequent send request. When the counter reaches the maximum value(0xE), then it shall restart with 0 for the next sen";
BA_ "Version" SG_ 3221225472 Lamp_HiPrioHzrdReq "17.12.00";
BA_ "NetworkRequestHoldingTime" SG_ 3221225472 Lamp_HiPrioHzrdReq 5000;
BA_ "NetworkRequest" SG_ 3221225472 Lamp_HiPrioHzrdReq 0;
BA_ "UserSigValidity" SG_ 3221225472 Lamp_HiPrioHzrdReq 0;
BA_ "GenSigStartValue" SG_ 3221225472 Lamp_HiPrioHzrdReq 2;
BA_ "GenSigSendType" SG_ 3221225472 Lamp_HiPrioHzrdReq 4;
BA_ "Description" SG_ 3221225472 Lamp_HiPrioHzrdReq "-Higher priority than SJB hazard

-Diag/Arm/DisArm/Balarm/Panic/MTS

-Initial Value: 2";
BA_ "Version" SG_ 3221225472 Lamp_LoPrioHzrdReq "17.12.00";
BA_ "NetworkRequestHoldingTime" SG_ 3221225472 Lamp_LoPrioHzrdReq 5000;
BA_ "NetworkRequest" SG_ 3221225472 Lamp_LoPrioHzrdReq 0;
BA_ "UserSigValidity" SG_ 3221225472 Lamp_LoPrioHzrdReq 0;
BA_ "GenSigStartValue" SG_ 3221225472 Lamp_LoPrioHzrdReq 2;
BA_ "GenSigSendType" SG_ 3221225472 Lamp_LoPrioHzrdReq 4;
BA_ "Description" SG_ 3221225472 Lamp_LoPrioHzrdReq "-Lower priority than SJB hazard

-TrunkOpenClose/CrashUnlock/RemoteStart

-Initial Value: 2";
BA_ "Version" SG_ 3221225472 Lamp_DedicatedDrlOnReq "17.12.00";
BA_ "NetworkRequestHoldingTime" SG_ 3221225472 Lamp_DedicatedDrlOnReq 5000;
BA_ "NetworkRequest" SG_ 3221225472 Lamp_DedicatedDrlOnReq 0;
BA_ "UserSigValidity" SG_ 3221225472 Lamp_DedicatedDrlOnReq 0;
BA_ "GenSigSendType" SG_ 3221225472 Lamp_DedicatedDrlOnReq 4;
BA_ "Description" SG_ 3221225472 Lamp_DedicatedDrlOnReq "-Lamp on command for dedicated DRL headlamp";
BA_ "Version" SG_ 3221225472 Lamp_IntTailLmpOnReq "17.12.00";
BA_ "NetworkRequestHoldingTime" SG_ 3221225472 Lamp_IntTailLmpOnReq 5000;
BA_ "NetworkRequest" SG_ 3221225472 Lamp_IntTailLmpOnReq 0;
BA_ "UserSigValidity" SG_ 3221225472 Lamp_IntTailLmpOnReq 0;
BA_ "GenSigSendType" SG_ 3221225472 Lamp_IntTailLmpOnReq 4;
BA_ "Description" SG_ 3221225472 Lamp_IntTailLmpOnReq "-(Old)C_INTTailOn";
BA_ "Version" SG_ 3221225472 Lamp_ExtrnlTailLmpOnReq "17.12.00";
BA_ "NetworkRequestHoldingTime" SG_ 3221225472 Lamp_ExtrnlTailLmpOnReq 5000;
BA_ "NetworkRequest" SG_ 3221225472 Lamp_ExtrnlTailLmpOnReq 0;
BA_ "UserSigValidity" SG_ 3221225472 Lamp_ExtrnlTailLmpOnReq 0;
BA_ "GenSigSendType" SG_ 3221225472 Lamp_ExtrnlTailLmpOnReq 4;
BA_ "Description" SG_ 3221225472 Lamp_ExtrnlTailLmpOnReq "-(Old)C_EXTTailOn";
BA_ "Version" SG_ 3221225472 Lamp_HdLmpLoOnReq "17.12.00";
BA_ "NetworkRequestHoldingTime" SG_ 3221225472 Lamp_HdLmpLoOnReq 5000;
BA_ "NetworkRequest" SG_ 3221225472 Lamp_HdLmpLoOnReq 0;
BA_ "UserSigValidity" SG_ 3221225472 Lamp_HdLmpLoOnReq 0;
BA_ "GenSigSendType" SG_ 3221225472 Lamp_HdLmpLoOnReq 4;
BA_ "Description" SG_ 3221225472 Lamp_HdLmpLoOnReq "-(Old)C_HLampLowON";
BA_ "Version" SG_ 3221225472 Lamp_HdLmpHiOnReq "17.12.00";
BA_ "NetworkRequestHoldingTime" SG_ 3221225472 Lamp_HdLmpHiOnReq 5000;
BA_ "NetworkRequest" SG_ 3221225472 Lamp_HdLmpHiOnReq 0;
BA_ "UserSigValidity" SG_ 3221225472 Lamp_HdLmpHiOnReq 0;
BA_ "GenSigSendType" SG_ 3221225472 Lamp_HdLmpHiOnReq 4;
BA_ "Description" SG_ 3221225472 Lamp_HdLmpHiOnReq "-(Old)C_HLampHighON";
BA_ "Version" SG_ 3221225472 Lamp_AvTailLmpSta "17.12.00";
BA_ "NetworkRequestHoldingTime" SG_ 3221225472 Lamp_AvTailLmpSta 5000;
BA_ "NetworkRequest" SG_ 3221225472 Lamp_AvTailLmpSta 0;
BA_ "UserSigValidity" SG_ 3221225472 Lamp_AvTailLmpSta 0;
BA_ "GenSigStartValue" SG_ 3221225472 Lamp_AvTailLmpSta 1;
BA_ "GenSigSendType" SG_ 3221225472 Lamp_AvTailLmpSta 4;
BA_ "Description" SG_ 3221225472 Lamp_AvTailLmpSta "-Send with at the same time with C_IntTailOn

-Initiail Value: 1";
BA_ "Version" SG_ 3221225472 BCM_Crc9Val "18.11.08";
BA_ "UserSigValidity" SG_ 3221225472 BCM_Crc9Val 0;
BA_ "GenSigStartValue" SG_ 3221225472 BCM_Crc9Val 255;
BA_ "GenSigSendType" SG_ 3221225472 BCM_Crc9Val 4;
BA_ "Description" SG_ 3221225472 BCM_Crc9Val "The data area for CRC calculation is based on the data length (DLC) of the message DB.

The CRC shall be calculated over the entire data block (excluding the CRC bytes) including the user data, alive counter and Data ID 

 

- CRC Polynomial (0x1D) , Ini";
BA_ "Version" SG_ 3221225472 BCM_AlvCnt9Val "18.11.08";
BA_ "UserSigValidity" SG_ 3221225472 BCM_AlvCnt9Val 0;
BA_ "GenSigSendType" SG_ 3221225472 BCM_AlvCnt9Val 4;
BA_ "Description" SG_ 3221225472 BCM_AlvCnt9Val "For the first transmission request for a data element the counter shall be initialized with 0 and shall be incremented by 1

for every subsequent send request. When the counter reaches the maximum value(0xE), then it shall restart with 0 for the next sen";
BA_ "Version" SG_ 3221225472 Lamp_AutoLtSnsrNightSta "17.12.00";
BA_ "NetworkRequestHoldingTime" SG_ 3221225472 Lamp_AutoLtSnsrNightSta 5000;
BA_ "NetworkRequest" SG_ 3221225472 Lamp_AutoLtSnsrNightSta 0;
BA_ "UserSigValidity" SG_ 3221225472 Lamp_AutoLtSnsrNightSta 0;
BA_ "GenSigSendType" SG_ 3221225472 Lamp_AutoLtSnsrNightSta 4;
BA_ "Description" SG_ 3221225472 Lamp_AutoLtSnsrNightSta "This signal indicates autolight sensor output";
BA_ "Version" SG_ 3221225472 Lamp_AutoLtSnsrHorVal "17.12.00";
BA_ "NetworkRequestHoldingTime" SG_ 3221225472 Lamp_AutoLtSnsrHorVal 5000;
BA_ "NetworkRequest" SG_ 3221225472 Lamp_AutoLtSnsrHorVal 0;
BA_ "UserSigValidity" SG_ 3221225472 Lamp_AutoLtSnsrHorVal 0;
BA_ "GenSigSendType" SG_ 3221225472 Lamp_AutoLtSnsrHorVal 4;
BA_ "Description" SG_ 3221225472 Lamp_AutoLtSnsrHorVal "This signal indicates autolight sensor output (for HUD)";
BA_ "Version" SG_ 3221225472 FR_RDR_Crc1Val "18.11.08";
BA_ "RoutingFactor" SG_ 3221225472 FR_RDR_Crc1Val 5;
BA_ "UserSigValidity" SG_ 3221225472 FR_RDR_Crc1Val 3;
BA_ "GenSigStartValue" SG_ 3221225472 FR_RDR_Crc1Val 65535;
BA_ "Description" SG_ 3221225472 FR_RDR_Crc1Val "The data area for CRC calculation is based on the data length (DLC) of the message DB.

The CRC shall be calculated over the entire data block (excluding the CRC bytes) including the user data, alive counter and Data ID

 

- CRC Polynomial (0x1021) , In";
BA_ "Version" SG_ 3221225472 FR_RDR_AlvCnt1Val "18.11.08";
BA_ "RoutingFactor" SG_ 3221225472 FR_RDR_AlvCnt1Val 5;
BA_ "UserSigValidity" SG_ 3221225472 FR_RDR_AlvCnt1Val 3;
BA_ "Description" SG_ 3221225472 FR_RDR_AlvCnt1Val "For the first transmission request for a data element the counter shall be initialized with 0 and shall be incremented by 1 for every subsequent send request. 

When the counter reaches the maximum value(0xFF), then it shall restart with 0 for the next s";
BA_ "Version" SG_ 3221225472 FR_RDR_FCAEquipSta "18.11.06";
BA_ "RoutingFactor" SG_ 3221225472 FR_RDR_FCAEquipSta 5;
BA_ "UserSigValidity" SG_ 3221225472 FR_RDR_FCAEquipSta 3;
BA_ "Description" SG_ 3221225472 FR_RDR_FCAEquipSta "FCA Sensor Type and Coding Information";
BA_ "Version" SG_ 3221225472 FR_RDR_FCA_Plus_Sta "18.08.06";
BA_ "RoutingFactor" SG_ 3221225472 FR_RDR_FCA_Plus_Sta 5;
BA_ "UserSigValidity" SG_ 3221225472 FR_RDR_FCA_Plus_Sta 3;
BA_ "Description" SG_ 3221225472 FR_RDR_FCA_Plus_Sta "����ī�޶� �� ���淹�̴� ǻ�� Ʈ���� �̿��Ͽ� FCA-Car Ÿ���� ���������� �Ǵ��ϰ� FCA-Car/Ped/Cyc+ �ý��ۿ� �����ϴ� FCA-Car Ÿ�� ����/���� ���� ȸ�� �Ұ��� ���θ� �Ǵ���";
BA_ "Version" SG_ 3221225472 FR_RDR_SCCEquipSta "18.11.06";
BA_ "RoutingFactor" SG_ 3221225472 FR_RDR_SCCEquipSta 5;
BA_ "UserSigValidity" SG_ 3221225472 FR_RDR_SCCEquipSta 3;
BA_ "Description" SG_ 3221225472 FR_RDR_SCCEquipSta "This signal indicates equipment for SCC";
BA_ "Version" SG_ 3221225472 FR_RDR_FailInfoSta "18.11.06";
BA_ "RoutingFactor" SG_ 3221225472 FR_RDR_FailInfoSta 5;
BA_ "UserSigValidity" SG_ 3221225472 FR_RDR_FailInfoSta 3;
BA_ "Description" SG_ 3221225472 FR_RDR_FailInfoSta "This signal indicates abnormal state of the front radar. The abnormal state does not include ADAS function failure like SCC failure and FCA failure";
BA_ "Version" SG_ 3221225472 FR_RDR_CodingSta "18.11.06";
BA_ "RoutingFactor" SG_ 3221225472 FR_RDR_CodingSta 5;
BA_ "UserSigValidity" SG_ 3221225472 FR_RDR_CodingSta 3;
BA_ "Description" SG_ 3221225472 FR_RDR_CodingSta "This signal indicates coding state of the front radar.";
BA_ "Version" SG_ 3221225472 FR_RDR_ACANMonSta "18.11.06";
BA_ "RoutingFactor" SG_ 3221225472 FR_RDR_ACANMonSta 5;
BA_ "UserSigValidity" SG_ 3221225472 FR_RDR_ACANMonSta 3;
BA_ "Description" SG_ 3221225472 FR_RDR_ACANMonSta "This signal indicates result of A-CANFD network monitoring in the front radar.";
BA_ "Version" SG_ 3221225472 FR_RDR_HDAEquipSta "19.03.11";
BA_ "RoutingFactor" SG_ 3221225472 FR_RDR_HDAEquipSta 5;
BA_ "UserSigValidity" SG_ 3221225472 FR_RDR_HDAEquipSta 3;
BA_ "Description" SG_ 3221225472 FR_RDR_HDAEquipSta "HDA Coding Information";
BA_ "Version" SG_ 3221225472 ICU_Crc2Val "18.11.08";
BA_ "UserSigValidity" SG_ 3221225472 ICU_Crc2Val 0;
BA_ "GenSigStartValue" SG_ 3221225472 ICU_Crc2Val 255;
BA_ "GenSigSendType" SG_ 3221225472 ICU_Crc2Val 4;
BA_ "Description" SG_ 3221225472 ICU_Crc2Val "The data area for CRC calculation is based on the data length (DLC) of the message DB.

The CRC shall be calculated over the entire data block (excluding the CRC bytes) including the user data, alive counter and Data ID 

 

- CRC Polynomial (0x1D) , Ini";
BA_ "Version" SG_ 3221225472 ICU_AlvCnt2Val "18.11.08";
BA_ "UserSigValidity" SG_ 3221225472 ICU_AlvCnt2Val 0;
BA_ "GenSigSendType" SG_ 3221225472 ICU_AlvCnt2Val 4;
BA_ "Description" SG_ 3221225472 ICU_AlvCnt2Val "For the first transmission request for a data element the counter shall be initialized with 0 and shall be incremented by 1

for every subsequent send request. When the counter reaches the maximum value(0xE), then it shall restart with 0 for the next sen";
BA_ "Version" SG_ 3221225472 Autocut_DlvryModSta "17.12.00";
BA_ "NetworkRequestHoldingTime" SG_ 3221225472 Autocut_DlvryModSta 5000;
BA_ "NetworkRequest" SG_ 3221225472 Autocut_DlvryModSta 0;
BA_ "UserSigValidity" SG_ 3221225472 Autocut_DlvryModSta 0;
BA_ "GenSigStartValue" SG_ 3221225472 Autocut_DlvryModSta 1;
BA_ "GenSigSendType" SG_ 3221225472 Autocut_DlvryModSta 4;
BA_ "Description" SG_ 3221225472 Autocut_DlvryModSta "-(Old)C_SJB_DeliveryMode

-Initial value: 1";
BA_ "Version" SG_ 3221225472 DoorLock_AsstDrUnLkSta "17.12.00";
BA_ "NetworkRequestHoldingTime" SG_ 3221225472 DoorLock_AsstDrUnLkSta 5000;
BA_ "NetworkRequest" SG_ 3221225472 DoorLock_AsstDrUnLkSta 0;
BA_ "UserSigValidity" SG_ 3221225472 DoorLock_AsstDrUnLkSta 0;
BA_ "GenSigSendType" SG_ 3221225472 DoorLock_AsstDrUnLkSta 4;
BA_ "Version" SG_ 3221225472 Warn_DrvDrSwSta "17.12.00";
BA_ "NetworkRequestHoldingTime" SG_ 3221225472 Warn_DrvDrSwSta 5000;
BA_ "NetworkRequest" SG_ 3221225472 Warn_DrvDrSwSta 0;
BA_ "UserSigValidity" SG_ 3221225472 Warn_DrvDrSwSta 0;
BA_ "GenSigSendType" SG_ 3221225472 Warn_DrvDrSwSta 4;
BA_ "Version" SG_ 3221225472 DoorLock_RrLftDrUnLkSta "17.12.00";
BA_ "NetworkRequestHoldingTime" SG_ 3221225472 DoorLock_RrLftDrUnLkSta 5000;
BA_ "NetworkRequest" SG_ 3221225472 DoorLock_RrLftDrUnLkSta 0;
BA_ "UserSigValidity" SG_ 3221225472 DoorLock_RrLftDrUnLkSta 0;
BA_ "GenSigSendType" SG_ 3221225472 DoorLock_RrLftDrUnLkSta 4;
BA_ "Version" SG_ 3221225472 DoorLock_RrRtDrUnLkSta "17.12.00";
BA_ "NetworkRequestHoldingTime" SG_ 3221225472 DoorLock_RrRtDrUnLkSta 5000;
BA_ "NetworkRequest" SG_ 3221225472 DoorLock_RrRtDrUnLkSta 0;
BA_ "UserSigValidity" SG_ 3221225472 DoorLock_RrRtDrUnLkSta 0;
BA_ "GenSigSendType" SG_ 3221225472 DoorLock_RrRtDrUnLkSta 4;
BA_ "Version" SG_ 3221225472 ICU_GearPosRConfirmSta "19.03.02";
BA_ "UserSigValidity" SG_ 3221225472 ICU_GearPosRConfirmSta 3;
BA_ "GenSigSendType" SG_ 3221225472 ICU_GearPosRConfirmSta 4;
BA_ "Description" SG_ 3221225472 ICU_GearPosRConfirmSta "Output_b_GearBoxRPosition_500msConfirmed";
BA_ "Version" SG_ 3221225472 Warn_AsstDrSwSta "17.12.00";
BA_ "NetworkRequestHoldingTime" SG_ 3221225472 Warn_AsstDrSwSta 5000;
BA_ "NetworkRequest" SG_ 3221225472 Warn_AsstDrSwSta 0;
BA_ "UserSigValidity" SG_ 3221225472 Warn_AsstDrSwSta 0;
BA_ "GenSigSendType" SG_ 3221225472 Warn_AsstDrSwSta 4;
BA_ "Version" SG_ 3221225472 Warn_AsstStBltSwSta "17.12.00";
BA_ "NetworkRequestHoldingTime" SG_ 3221225472 Warn_AsstStBltSwSta 5000;
BA_ "NetworkRequest" SG_ 3221225472 Warn_AsstStBltSwSta 0;
BA_ "UserSigValidity" SG_ 3221225472 Warn_AsstStBltSwSta 0;
BA_ "GenSigStartValue" SG_ 3221225472 Warn_AsstStBltSwSta 1;
BA_ "GenSigSendType" SG_ 3221225472 Warn_AsstStBltSwSta 4;
BA_ "Description" SG_ 3221225472 Warn_AsstStBltSwSta "-Default value: 0x1 (Belt)



-Initial value: 0x1 (Belt)



-Timeout value: 0x1 (Belt)";
BA_ "Version" SG_ 3221225472 Warn_BrkFldSwSta "17.12.00";
BA_ "NetworkRequestHoldingTime" SG_ 3221225472 Warn_BrkFldSwSta 5000;
BA_ "NetworkRequest" SG_ 3221225472 Warn_BrkFldSwSta 0;
BA_ "UserSigValidity" SG_ 3221225472 Warn_BrkFldSwSta 0;
BA_ "GenSigSendType" SG_ 3221225472 Warn_BrkFldSwSta 4;
BA_ "Version" SG_ 3221225472 Warn_DrvStBltSwSta "17.12.00";
BA_ "NetworkRequestHoldingTime" SG_ 3221225472 Warn_DrvStBltSwSta 5000;
BA_ "NetworkRequest" SG_ 3221225472 Warn_DrvStBltSwSta 0;
BA_ "UserSigValidity" SG_ 3221225472 Warn_DrvStBltSwSta 0;
BA_ "GenSigSendType" SG_ 3221225472 Warn_DrvStBltSwSta 4;
BA_ "Version" SG_ 3221225472 Warn_HoodSwSta "17.12.00";
BA_ "NetworkRequestHoldingTime" SG_ 3221225472 Warn_HoodSwSta 5000;
BA_ "NetworkRequest" SG_ 3221225472 Warn_HoodSwSta 0;
BA_ "UserSigValidity" SG_ 3221225472 Warn_HoodSwSta 0;
BA_ "GenSigSendType" SG_ 3221225472 Warn_HoodSwSta 4;
BA_ "Version" SG_ 3221225472 Warn_PassStOccSta "17.12.00";
BA_ "NetworkRequestHoldingTime" SG_ 3221225472 Warn_PassStOccSta 5000;
BA_ "NetworkRequest" SG_ 3221225472 Warn_PassStOccSta 0;
BA_ "UserSigValidity" SG_ 3221225472 Warn_PassStOccSta 0;
BA_ "GenSigSendType" SG_ 3221225472 Warn_PassStOccSta 4;
BA_ "Description" SG_ 3221225472 Warn_PassStOccSta "Passenger Seated State







-Default value: 0x0 (��ž��)



-Initial value: 0x0 (��ž��)



-Timeout value: 0x0 (��ž��)";
BA_ "Version" SG_ 3221225472 Warn_RrCtrStBltSwSta "17.12.00";
BA_ "NetworkRequestHoldingTime" SG_ 3221225472 Warn_RrCtrStBltSwSta 5000;
BA_ "NetworkRequest" SG_ 3221225472 Warn_RrCtrStBltSwSta 0;
BA_ "UserSigValidity" SG_ 3221225472 Warn_RrCtrStBltSwSta 0;
BA_ "GenSigSendType" SG_ 3221225472 Warn_RrCtrStBltSwSta 4;
BA_ "Version" SG_ 3221225472 Warn_RrLftDrSwSta "17.12.00";
BA_ "NetworkRequestHoldingTime" SG_ 3221225472 Warn_RrLftDrSwSta 5000;
BA_ "NetworkRequest" SG_ 3221225472 Warn_RrLftDrSwSta 0;
BA_ "UserSigValidity" SG_ 3221225472 Warn_RrLftDrSwSta 0;
BA_ "GenSigSendType" SG_ 3221225472 Warn_RrLftDrSwSta 4;
BA_ "Version" SG_ 3221225472 Warn_RrLftStBltSwSta "17.12.00";
BA_ "NetworkRequestHoldingTime" SG_ 3221225472 Warn_RrLftStBltSwSta 5000;
BA_ "NetworkRequest" SG_ 3221225472 Warn_RrLftStBltSwSta 0;
BA_ "UserSigValidity" SG_ 3221225472 Warn_RrLftStBltSwSta 0;
BA_ "GenSigSendType" SG_ 3221225472 Warn_RrLftStBltSwSta 4;
BA_ "Version" SG_ 3221225472 Warn_RrRtDrSwSta "17.12.00";
BA_ "NetworkRequestHoldingTime" SG_ 3221225472 Warn_RrRtDrSwSta 5000;
BA_ "NetworkRequest" SG_ 3221225472 Warn_RrRtDrSwSta 0;
BA_ "UserSigValidity" SG_ 3221225472 Warn_RrRtDrSwSta 0;
BA_ "GenSigSendType" SG_ 3221225472 Warn_RrRtDrSwSta 4;
BA_ "Version" SG_ 3221225472 Warn_RrRtStBltSwSta "17.12.00";
BA_ "NetworkRequestHoldingTime" SG_ 3221225472 Warn_RrRtStBltSwSta 5000;
BA_ "NetworkRequest" SG_ 3221225472 Warn_RrRtStBltSwSta 0;
BA_ "UserSigValidity" SG_ 3221225472 Warn_RrRtStBltSwSta 0;
BA_ "GenSigSendType" SG_ 3221225472 Warn_RrRtStBltSwSta 4;
BA_ "Version" SG_ 3221225472 Warn_HoodSwMemorySta "17.12.00";
BA_ "NetworkRequestHoldingTime" SG_ 3221225472 Warn_HoodSwMemorySta 5000;
BA_ "NetworkRequest" SG_ 3221225472 Warn_HoodSwMemorySta 0;
BA_ "UserSigValidity" SG_ 3221225472 Warn_HoodSwMemorySta 3;
BA_ "GenSigSendType" SG_ 3221225472 Warn_HoodSwMemorySta 4;
BA_ "Description" SG_ 3221225472 Warn_HoodSwMemorySta "Hood swtich open->close information(memory)



This signal is for oil level warning lamp reset In case hood open->close when IG-OFF, 0x01 sent for 5 sec at next IG-ON";
BA_ "Version" SG_ 3221225472 Warn_WshrFldSwSta "17.12.00";
BA_ "NetworkRequestHoldingTime" SG_ 3221225472 Warn_WshrFldSwSta 5000;
BA_ "NetworkRequest" SG_ 3221225472 Warn_WshrFldSwSta 0;
BA_ "UserSigValidity" SG_ 3221225472 Warn_WshrFldSwSta 3;
BA_ "GenSigSendType" SG_ 3221225472 Warn_WshrFldSwSta 4;
BA_ "Description" SG_ 3221225472 Warn_WshrFldSwSta "Washer Fluid Switch Signal

This signal indicates Washer Fluid Switch Signal

0x0:Off/0x1:On";
BA_ "Version" SG_ 3221225472 ICU_Haptic_OPT "18.07.07";
BA_ "NetworkRequestHoldingTime" SG_ 3221225472 ICU_Haptic_OPT 5000;
BA_ "NetworkRequest" SG_ 3221225472 ICU_Haptic_OPT 0;
BA_ "UserSigValidity" SG_ 3221225472 ICU_Haptic_OPT 0;
BA_ "GenSigSendType" SG_ 3221225472 ICU_Haptic_OPT 4;
BA_ "Description" SG_ 3221225472 ICU_Haptic_OPT "Steering Wheel Haptic Warning Option Infomation (From ICU)";
BA_ "Version" SG_ 3221225472 ICU_Crc10Val "18.11.08";
BA_ "UserSigValidity" SG_ 3221225472 ICU_Crc10Val 0;
BA_ "GenSigStartValue" SG_ 3221225472 ICU_Crc10Val 255;
BA_ "GenSigSendType" SG_ 3221225472 ICU_Crc10Val 4;
BA_ "Description" SG_ 3221225472 ICU_Crc10Val "The data area for CRC calculation is based on the data length (DLC) of the message DB.

The CRC shall be calculated over the entire data block (excluding the CRC bytes) including the user data, alive counter and Data ID 

 

- CRC Polynomial (0x1D) , Ini";
BA_ "Version" SG_ 3221225472 ICU_AlvCnt10Val "18.11.08";
BA_ "UserSigValidity" SG_ 3221225472 ICU_AlvCnt10Val 0;
BA_ "GenSigSendType" SG_ 3221225472 ICU_AlvCnt10Val 4;
BA_ "Description" SG_ 3221225472 ICU_AlvCnt10Val "For the first transmission request for a data element the counter shall be initialized with 0 and shall be incremented by 1

for every subsequent send request. When the counter reaches the maximum value(0xE), then it shall restart with 0 for the next sen";
BA_ "Version" SG_ 3221225472 ICU_BS2SoC "17.12.00";
BA_ "UserSigValidity" SG_ 3221225472 ICU_BS2SoC 3;
BA_ "GenSigSendType" SG_ 3221225472 ICU_BS2SoC 4;
BA_ "Description" SG_ 3221225472 ICU_BS2SoC "This signal is battery State of Charge as calculated by battery sensor.";
BA_ "Version" SG_ 3221225472 ICU_BS2NCap "17.12.00";
BA_ "UserSigValidity" SG_ 3221225472 ICU_BS2NCap 3;
BA_ "GenSigStartValue" SG_ 3221225472 ICU_BS2NCap 255;
BA_ "GenSigSendType" SG_ 3221225472 ICU_BS2NCap 4;
BA_ "Description" SG_ 3221225472 ICU_BS2NCap "Nominal capacity";
BA_ "Version" SG_ 3221225472 ICU_BS2OpnCirVol "17.12.00";
BA_ "UserSigValidity" SG_ 3221225472 ICU_BS2OpnCirVol 3;
BA_ "GenSigStartValue" SG_ 3221225472 ICU_BS2OpnCirVol 4095;
BA_ "GenSigSendType" SG_ 3221225472 ICU_BS2OpnCirVol 4;
BA_ "Description" SG_ 3221225472 ICU_BS2OpnCirVol "Last open circuit voltage";
BA_ "Version" SG_ 3221225472 ICU_BS2_FSOC "18.08.03";
BA_ "UserSigValidity" SG_ 3221225472 ICU_BS2_FSOC 3;
BA_ "GenSigStartValue" SG_ 3221225472 ICU_BS2_FSOC 1;
BA_ "GenSigSendType" SG_ 3221225472 ICU_BS2_FSOC 4;
BA_ "Description" SG_ 3221225472 ICU_BS2_FSOC "This signal indicates whether the state of SOC signal is fault or not";
BA_ "Version" SG_ 3221225472 ICU_BS2_FSOH "18.08.03";
BA_ "UserSigValidity" SG_ 3221225472 ICU_BS2_FSOH 3;
BA_ "GenSigStartValue" SG_ 3221225472 ICU_BS2_FSOH 1;
BA_ "GenSigSendType" SG_ 3221225472 ICU_BS2_FSOH 4;
BA_ "Description" SG_ 3221225472 ICU_BS2_FSOH "This signal indicates whether the state of SOH signal is fault or not";
BA_ "Version" SG_ 3221225472 ICU_BS2_FSOF "18.08.03";
BA_ "UserSigValidity" SG_ 3221225472 ICU_BS2_FSOF 3;
BA_ "GenSigStartValue" SG_ 3221225472 ICU_BS2_FSOF 1;
BA_ "GenSigSendType" SG_ 3221225472 ICU_BS2_FSOF 4;
BA_ "Description" SG_ 3221225472 ICU_BS2_FSOF "This signal indicates whether the state of SOF signal is fault or not";
BA_ "Version" SG_ 3221225472 ICU_BS2_FQSTAT "18.08.03";
BA_ "UserSigValidity" SG_ 3221225472 ICU_BS2_FQSTAT 3;
BA_ "GenSigStartValue" SG_ 3221225472 ICU_BS2_FQSTAT 1;
BA_ "GenSigSendType" SG_ 3221225472 ICU_BS2_FQSTAT 4;
BA_ "Description" SG_ 3221225472 ICU_BS2_FQSTAT "This signal indicates whether quiescent current is high or not compared to pre-defined value";
BA_ "Version" SG_ 3221225472 ICU_BS2SoH "17.12.00";
BA_ "UserSigValidity" SG_ 3221225472 ICU_BS2SoH 3;
BA_ "GenSigStartValue" SG_ 3221225472 ICU_BS2SoH 255;
BA_ "GenSigSendType" SG_ 3221225472 ICU_BS2SoH 4;
BA_ "Description" SG_ 3221225472 ICU_BS2SoH "This signal is battery State of Health(SOH) as calculated by battery sensor.



This value shows reduction rate of nominal capacity.



This value can be used for diagnosis information of application system.";
BA_ "Version" SG_ 3221225472 ICU_BS2SoF "17.12.00";
BA_ "UserSigValidity" SG_ 3221225472 ICU_BS2SoF 3;
BA_ "GenSigStartValue" SG_ 3221225472 ICU_BS2SoF 255;
BA_ "GenSigSendType" SG_ 3221225472 ICU_BS2SoF 4;
BA_ "Description" SG_ 3221225472 ICU_BS2SoF "This signal is battery State of Function(SOF) as calculated by battery sensor.



This value shows information about the battery ability to crank the engine (both of warm & cold cranking).



This value is prediction value of the minimum voltage for the ";
BA_ "Version" SG_ 3221225472 ICU_Crc4Val "18.11.08";
BA_ "UserSigValidity" SG_ 3221225472 ICU_Crc4Val 0;
BA_ "GenSigStartValue" SG_ 3221225472 ICU_Crc4Val 255;
BA_ "GenSigSendType" SG_ 3221225472 ICU_Crc4Val 4;
BA_ "Description" SG_ 3221225472 ICU_Crc4Val "The data area for CRC calculation is based on the data length (DLC) of the message DB.

The CRC shall be calculated over the entire data block (excluding the CRC bytes) including the user data, alive counter and Data ID 

 

- CRC Polynomial (0x1D) , Ini";
BA_ "Version" SG_ 3221225472 ICU_AlvCnt4Val "18.11.08";
BA_ "UserSigValidity" SG_ 3221225472 ICU_AlvCnt4Val 0;
BA_ "GenSigSendType" SG_ 3221225472 ICU_AlvCnt4Val 4;
BA_ "Description" SG_ 3221225472 ICU_AlvCnt4Val "For the first transmission request for a data element the counter shall be initialized with 0 and shall be incremented by 1

for every subsequent send request. When the counter reaches the maximum value(0xE), then it shall restart with 0 for the next sen";
BA_ "Version" SG_ 3221225472 ExtLamp_TrnSigLmpLftBlnkngSta "17.12.00";
BA_ "NetworkRequestHoldingTime" SG_ 3221225472 ExtLamp_TrnSigLmpLftBlnkngSta 5000;
BA_ "NetworkRequest" SG_ 3221225472 ExtLamp_TrnSigLmpLftBlnkngSta 0;
BA_ "UserSigValidity" SG_ 3221225472 ExtLamp_TrnSigLmpLftBlnkngSta 0;
BA_ "GenSigSendType" SG_ 3221225472 ExtLamp_TrnSigLmpLftBlnkngSta 4;
BA_ "Version" SG_ 3221225472 ExtLamp_TrnSigLmpRtBlnkngSta "17.12.00";
BA_ "NetworkRequestHoldingTime" SG_ 3221225472 ExtLamp_TrnSigLmpRtBlnkngSta 5000;
BA_ "NetworkRequest" SG_ 3221225472 ExtLamp_TrnSigLmpRtBlnkngSta 0;
BA_ "UserSigValidity" SG_ 3221225472 ExtLamp_TrnSigLmpRtBlnkngSta 0;
BA_ "GenSigSendType" SG_ 3221225472 ExtLamp_TrnSigLmpRtBlnkngSta 4;
BA_ "Version" SG_ 3221225472 ExtLamp_ExtrnlTailLmpSta "17.12.00";
BA_ "NetworkRequestHoldingTime" SG_ 3221225472 ExtLamp_ExtrnlTailLmpSta 5000;
BA_ "NetworkRequest" SG_ 3221225472 ExtLamp_ExtrnlTailLmpSta 0;
BA_ "UserSigValidity" SG_ 3221225472 ExtLamp_ExtrnlTailLmpSta 0;
BA_ "GenSigSendType" SG_ 3221225472 ExtLamp_ExtrnlTailLmpSta 4;
BA_ "Description" SG_ 3221225472 ExtLamp_ExtrnlTailLmpSta "-(Old)C_EXTTail_Act";
BA_ "Version" SG_ 3221225472 ExtLamp_HzrdSwSta "17.12.00";
BA_ "NetworkRequestHoldingTime" SG_ 3221225472 ExtLamp_HzrdSwSta 5000;
BA_ "NetworkRequest" SG_ 3221225472 ExtLamp_HzrdSwSta 0;
BA_ "UserSigValidity" SG_ 3221225472 ExtLamp_HzrdSwSta 0;
BA_ "GenSigSendType" SG_ 3221225472 ExtLamp_HzrdSwSta 4;
BA_ "Version" SG_ 3221225472 ExtLamp_RrFgLmpSta "17.12.00";
BA_ "NetworkRequestHoldingTime" SG_ 3221225472 ExtLamp_RrFgLmpSta 5000;
BA_ "NetworkRequest" SG_ 3221225472 ExtLamp_RrFgLmpSta 0;
BA_ "UserSigValidity" SG_ 3221225472 ExtLamp_RrFgLmpSta 0;
BA_ "GenSigSendType" SG_ 3221225472 ExtLamp_RrFgLmpSta 4;
BA_ "Description" SG_ 3221225472 ExtLamp_RrFgLmpSta "-(Old)C_RearFog_Act";
BA_ "Version" SG_ 3221225472 IntLamp_InlTailLmpSta "17.12.00";
BA_ "NetworkRequestHoldingTime" SG_ 3221225472 IntLamp_InlTailLmpSta 5000;
BA_ "NetworkRequest" SG_ 3221225472 IntLamp_InlTailLmpSta 0;
BA_ "UserSigValidity" SG_ 3221225472 IntLamp_InlTailLmpSta 0;
BA_ "GenSigSendType" SG_ 3221225472 IntLamp_InlTailLmpSta 4;
BA_ "Description" SG_ 3221225472 IntLamp_InlTailLmpSta "-(Old)C_INTTail_Act";
BA_ "Version" SG_ 3221225472 Lamp_TrnSigLmpLftOnReq "17.12.05";
BA_ "NetworkRequestHoldingTime" SG_ 3221225472 Lamp_TrnSigLmpLftOnReq 5000;
BA_ "NetworkRequest" SG_ 3221225472 Lamp_TrnSigLmpLftOnReq 0;
BA_ "UserSigValidity" SG_ 3221225472 Lamp_TrnSigLmpLftOnReq 0;
BA_ "GenSigSendType" SG_ 3221225472 Lamp_TrnSigLmpLftOnReq 4;
BA_ "Version" SG_ 3221225472 Lamp_TrnSigLmpRtOnReq "17.12.05";
BA_ "NetworkRequestHoldingTime" SG_ 3221225472 Lamp_TrnSigLmpRtOnReq 5000;
BA_ "NetworkRequest" SG_ 3221225472 Lamp_TrnSigLmpRtOnReq 0;
BA_ "UserSigValidity" SG_ 3221225472 Lamp_TrnSigLmpRtOnReq 0;
BA_ "GenSigSendType" SG_ 3221225472 Lamp_TrnSigLmpRtOnReq 4;
BA_ "Version" SG_ 3221225472 ICU_Crc5Val "18.11.08";
BA_ "UserSigValidity" SG_ 3221225472 ICU_Crc5Val 0;
BA_ "GenSigStartValue" SG_ 3221225472 ICU_Crc5Val 255;
BA_ "GenSigSendType" SG_ 3221225472 ICU_Crc5Val 4;
BA_ "Description" SG_ 3221225472 ICU_Crc5Val "The data area for CRC calculation is based on the data length (DLC) of the message DB.

The CRC shall be calculated over the entire data block (excluding the CRC bytes) including the user data, alive counter and Data ID 

 

- CRC Polynomial (0x1D) , Ini";
BA_ "Version" SG_ 3221225472 ICU_AlvCnt5Val "18.11.08";
BA_ "UserSigValidity" SG_ 3221225472 ICU_AlvCnt5Val 0;
BA_ "GenSigSendType" SG_ 3221225472 ICU_AlvCnt5Val 4;
BA_ "Description" SG_ 3221225472 ICU_AlvCnt5Val "For the first transmission request for a data element the counter shall be initialized with 0 and shall be incremented by 1

for every subsequent send request. When the counter reaches the maximum value(0xE), then it shall restart with 0 for the next sen";
BA_ "Version" SG_ 3221225472 Trunk_TrnkInReleaseSwSta "17.12.00";
BA_ "NetworkRequestHoldingTime" SG_ 3221225472 Trunk_TrnkInReleaseSwSta 5000;
BA_ "NetworkRequest" SG_ 3221225472 Trunk_TrnkInReleaseSwSta 0;
BA_ "UserSigValidity" SG_ 3221225472 Trunk_TrnkInReleaseSwSta 0;
BA_ "GenSigSendType" SG_ 3221225472 Trunk_TrnkInReleaseSwSta 4;
BA_ "Description" SG_ 3221225472 Trunk_TrnkInReleaseSwSta "-Trunk Inner Release SW";
BA_ "Version" SG_ 3221225472 Trunk_TrnkTlgtOutReleaseSwSta "17.12.00";
BA_ "NetworkRequestHoldingTime" SG_ 3221225472 Trunk_TrnkTlgtOutReleaseSwSta 5000;
BA_ "NetworkRequest" SG_ 3221225472 Trunk_TrnkTlgtOutReleaseSwSta 0;
BA_ "UserSigValidity" SG_ 3221225472 Trunk_TrnkTlgtOutReleaseSwSta 0;
BA_ "GenSigSendType" SG_ 3221225472 Trunk_TrnkTlgtOutReleaseSwSta 4;
BA_ "Description" SG_ 3221225472 Trunk_TrnkTlgtOutReleaseSwSta "-(Old)C_TRUNK_LID

-Trunk/Tailgate Outter Release SW";
BA_ "Version" SG_ 3221225472 Trunk_TrnkTlgtSwSta "17.12.00";
BA_ "NetworkRequestHoldingTime" SG_ 3221225472 Trunk_TrnkTlgtSwSta 5000;
BA_ "NetworkRequest" SG_ 3221225472 Trunk_TrnkTlgtSwSta 0;
BA_ "UserSigValidity" SG_ 3221225472 Trunk_TrnkTlgtSwSta 0;
BA_ "GenSigSendType" SG_ 3221225472 Trunk_TrnkTlgtSwSta 4;
BA_ "Description" SG_ 3221225472 Trunk_TrnkTlgtSwSta "Full Lock SW Status Signal



(TailGate/TrunkLid Tpye all)



1. Luggage or Trunkroom Lamp On/Off



2. TailGate/TrunkLid Open Ind in cluster



3. Normal Open SW



  - SW Off: Full Lock(Full Close state)



  - SW On: ^Full Lock";
BA_ "Version" SG_ 3221225472 Trunk_GlvBxTrnkLkSwSta "17.12.00";
BA_ "NetworkRequestHoldingTime" SG_ 3221225472 Trunk_GlvBxTrnkLkSwSta 5000;
BA_ "NetworkRequest" SG_ 3221225472 Trunk_GlvBxTrnkLkSwSta 0;
BA_ "UserSigValidity" SG_ 3221225472 Trunk_GlvBxTrnkLkSwSta 0;
BA_ "GenSigSendType" SG_ 3221225472 Trunk_GlvBxTrnkLkSwSta 4;
BA_ "Description" SG_ 3221225472 Trunk_GlvBxTrnkLkSwSta "- Glove Box Trunk Lock SW";
BA_ "Version" SG_ 3221225472 Trunk_OpnDiagSetSta "17.12.00";
BA_ "NetworkRequestHoldingTime" SG_ 3221225472 Trunk_OpnDiagSetSta 5000;
BA_ "NetworkRequest" SG_ 3221225472 Trunk_OpnDiagSetSta 0;
BA_ "UserSigValidity" SG_ 3221225472 Trunk_OpnDiagSetSta 0;
BA_ "GenSigSendType" SG_ 3221225472 Trunk_OpnDiagSetSta 4;
BA_ "Description" SG_ 3221225472 Trunk_OpnDiagSetSta "Trunk/TailGate open function diagnostic setting



 - Off : Normal mode



 - On : Restrict mode";
BA_ "Version" SG_ 3221225472 USM_OneTouchTrnSigFuncSta "17.12.00";
BA_ "NetworkRequestHoldingTime" SG_ 3221225472 USM_OneTouchTrnSigFuncSta 5000;
BA_ "NetworkRequest" SG_ 3221225472 USM_OneTouchTrnSigFuncSta 0;
BA_ "UserSigValidity" SG_ 3221225472 USM_OneTouchTrnSigFuncSta 0;
BA_ "GenSigSendType" SG_ 3221225472 USM_OneTouchTrnSigFuncSta 4;
BA_ "Description" SG_ 3221225472 USM_OneTouchTrnSigFuncSta "This signal is 



- For One Touch Turn Signal Function,



 the advanced version of One Touch triple turn signal



- Communicated with Cluster for setting USM



- Periodic Event Signal to notice current staus to USM of Cluster";
BA_ "Version" SG_ 3221225472 DoorLock_DrvDrUnLkSta "17.12.00";
BA_ "NetworkRequestHoldingTime" SG_ 3221225472 DoorLock_DrvDrUnLkSta 5000;
BA_ "NetworkRequest" SG_ 3221225472 DoorLock_DrvDrUnLkSta 0;
BA_ "UserSigValidity" SG_ 3221225472 DoorLock_DrvDrUnLkSta 0;
BA_ "GenSigSendType" SG_ 3221225472 DoorLock_DrvDrUnLkSta 4;
BA_ "Version" SG_ 3221225472 DoorLock_LkOutSta "17.12.00";
BA_ "NetworkRequestHoldingTime" SG_ 3221225472 DoorLock_LkOutSta 5000;
BA_ "NetworkRequest" SG_ 3221225472 DoorLock_LkOutSta 0;
BA_ "UserSigValidity" SG_ 3221225472 DoorLock_LkOutSta 0;
BA_ "GenSigSendType" SG_ 3221225472 DoorLock_LkOutSta 4;
BA_ "Description" SG_ 3221225472 DoorLock_LkOutSta "- Door Lock or Unlock Output State 



0x0 : Off (Door lock/unlock output Off state)



0x1 : On (Door lock/unlock output On state)";
BA_ "Version" SG_ 3221225472 TwoTrnUnLkOptTyp "17.12.03";
BA_ "NetworkRequestHoldingTime" SG_ 3221225472 TwoTrnUnLkOptTyp 5000;
BA_ "NetworkRequest" SG_ 3221225472 TwoTrnUnLkOptTyp 0;
BA_ "UserSigValidity" SG_ 3221225472 TwoTrnUnLkOptTyp 0;
BA_ "GenSigSendType" SG_ 3221225472 TwoTrnUnLkOptTyp 4;
BA_ "Description" SG_ 3221225472 TwoTrnUnLkOptTyp "-(Old)C_TTUnlockOpt";
BA_ "Version" SG_ 3221225472 Defog_DfgrRlySta "17.12.00";
BA_ "NetworkRequestHoldingTime" SG_ 3221225472 Defog_DfgrRlySta 5000;
BA_ "NetworkRequest" SG_ 3221225472 Defog_DfgrRlySta 0;
BA_ "UserSigValidity" SG_ 3221225472 Defog_DfgrRlySta 0;
BA_ "GenSigSendType" SG_ 3221225472 Defog_DfgrRlySta 4;
BA_ "Version" SG_ 3221225472 C_CrashUnlockState "18.05.02";
BA_ "NetworkRequest" SG_ 3221225472 C_CrashUnlockState 0;
BA_ "UserSigValidity" SG_ 3221225472 C_CrashUnlockState 0;
BA_ "GenSigSendType" SG_ 3221225472 C_CrashUnlockState 4;
BA_ "Description" SG_ 3221225472 C_CrashUnlockState "Crash Unlock Active State

-0x0:Off

-0x1:Unlock(crash)";
BA_ "Version" SG_ 3221225472 CF_Gway_ADrLOptInfo "18.11.01";
BA_ "UserSigValidity" SG_ 3221225472 CF_Gway_ADrLOptInfo 1;
BA_ "GenSigSendType" SG_ 3221225472 CF_Gway_ADrLOptInfo 4;
BA_ "Description" SG_ 3221225472 CF_Gway_ADrLOptInfo "Smart key and transmission option information for auto door lock/unlock USM";
BA_ "Version" SG_ 3221225472 ICU_Crc7Val "18.11.08";
BA_ "UserSigValidity" SG_ 3221225472 ICU_Crc7Val 0;
BA_ "GenSigStartValue" SG_ 3221225472 ICU_Crc7Val 255;
BA_ "GenSigSendType" SG_ 3221225472 ICU_Crc7Val 4;
BA_ "Description" SG_ 3221225472 ICU_Crc7Val "The data area for CRC calculation is based on the data length (DLC) of the message DB.

The CRC shall be calculated over the entire data block (excluding the CRC bytes) including the user data, alive counter and Data ID 

 

- CRC Polynomial (0x1D) , Ini";
BA_ "Version" SG_ 3221225472 ICU_ADASHapticAutoOnSetReq "18.11.02";
BA_ "NetworkRequestHoldingTime" SG_ 3221225472 ICU_ADASHapticAutoOnSetReq 5000;
BA_ "NetworkRequest" SG_ 3221225472 ICU_ADASHapticAutoOnSetReq 0;
BA_ "UserSigValidity" SG_ 3221225472 ICU_ADASHapticAutoOnSetReq 3;
BA_ "GenSigSendType" SG_ 3221225472 ICU_ADASHapticAutoOnSetReq 4;
BA_ "Description" SG_ 3221225472 ICU_ADASHapticAutoOnSetReq "This signal describes that Haptic Warning function is automatically avtivated for warning of DRV assist system. When Haptic USM function is off and ADAS warning USM R-value is on, if ADAS warning USM R-value is changed from on to off, its state is chagne";
BA_ "Version" SG_ 3221225472 ICU_AlvCnt7Val "18.11.08";
BA_ "UserSigValidity" SG_ 3221225472 ICU_AlvCnt7Val 0;
BA_ "GenSigSendType" SG_ 3221225472 ICU_AlvCnt7Val 4;
BA_ "Description" SG_ 3221225472 ICU_AlvCnt7Val "For the first transmission request for a data element the counter shall be initialized with 0 and shall be incremented by 1

for every subsequent send request. When the counter reaches the maximum value(0xE), then it shall restart with 0 for the next sen";
BA_ "Version" SG_ 3221225472 SEA_ActvSta "17.12.00";
BA_ "NetworkRequestHoldingTime" SG_ 3221225472 SEA_ActvSta 5000;
BA_ "NetworkRequest" SG_ 3221225472 SEA_ActvSta 0;
BA_ "UserSigValidity" SG_ 3221225472 SEA_ActvSta 0;
BA_ "GenSigSendType" SG_ 3221225472 SEA_ActvSta 4;
BA_ "Description" SG_ 3221225472 SEA_ActvSta "Cluster pop-up when SEA function is activated";
BA_ "Version" SG_ 3221225472 ChildLock_ActnFlSta "17.12.00";
BA_ "NetworkRequestHoldingTime" SG_ 3221225472 ChildLock_ActnFlSta 5000;
BA_ "NetworkRequest" SG_ 3221225472 ChildLock_ActnFlSta 0;
BA_ "UserSigValidity" SG_ 3221225472 ChildLock_ActnFlSta 0;
BA_ "GenSigSendType" SG_ 3221225472 ChildLock_ActnFlSta 4;
BA_ "Description" SG_ 3221225472 ChildLock_ActnFlSta "Child Lock actuation failed";
BA_ "Version" SG_ 3221225472 USM_AutoDrLkReq "17.12.00";
BA_ "NetworkRequestHoldingTime" SG_ 3221225472 USM_AutoDrLkReq 5000;
BA_ "NetworkRequest" SG_ 3221225472 USM_AutoDrLkReq 0;
BA_ "UserSigValidity" SG_ 3221225472 USM_AutoDrLkReq 0;
BA_ "GenSigSendType" SG_ 3221225472 USM_AutoDrLkReq 4;
BA_ "Version" SG_ 3221225472 USM_AutoDrUnLkReq "17.12.00";
BA_ "NetworkRequestHoldingTime" SG_ 3221225472 USM_AutoDrUnLkReq 5000;
BA_ "NetworkRequest" SG_ 3221225472 USM_AutoDrUnLkReq 0;
BA_ "UserSigValidity" SG_ 3221225472 USM_AutoDrUnLkReq 0;
BA_ "GenSigSendType" SG_ 3221225472 USM_AutoDrUnLkReq 4;
BA_ "Version" SG_ 3221225472 USM_HapticCurrentSta "18.11.02";
BA_ "NetworkRequestHoldingTime" SG_ 3221225472 USM_HapticCurrentSta 5000;
BA_ "NetworkRequest" SG_ 3221225472 USM_HapticCurrentSta 0;
BA_ "UserSigValidity" SG_ 3221225472 USM_HapticCurrentSta 3;
BA_ "GenSigSendType" SG_ 3221225472 USM_HapticCurrentSta 4;
BA_ "Description" SG_ 3221225472 USM_HapticCurrentSta "This signal describes whether haptic function is activated or not";
BA_ "Version" SG_ 3221225472 USM_TwoTrnUnLkCurrentSta "17.12.00";
BA_ "NetworkRequestHoldingTime" SG_ 3221225472 USM_TwoTrnUnLkCurrentSta 5000;
BA_ "NetworkRequest" SG_ 3221225472 USM_TwoTrnUnLkCurrentSta 0;
BA_ "UserSigValidity" SG_ 3221225472 USM_TwoTrnUnLkCurrentSta 0;
BA_ "GenSigSendType" SG_ 3221225472 USM_TwoTrnUnLkCurrentSta 4;
BA_ "Version" SG_ 3221225472 ICU_Crc15Val "19.02.09";
BA_ "UserSigValidity" SG_ 3221225472 ICU_Crc15Val 0;
BA_ "GenSigStartValue" SG_ 3221225472 ICU_Crc15Val 255;
BA_ "Description" SG_ 3221225472 ICU_Crc15Val "The data area for CRC calculation is based on the data length (DLC) of the message DB.

The CRC shall be calculated over the entire data block (excluding the CRC bytes) including the user data, alive counter and Data ID 

 

- CRC Polynomial (0x1D) , Ini";
BA_ "Version" SG_ 3221225472 ICU_AlvCnt15Val "19.02.09";
BA_ "UserSigValidity" SG_ 3221225472 ICU_AlvCnt15Val 0;
BA_ "Description" SG_ 3221225472 ICU_AlvCnt15Val "For the first transmission request for a data element the counter shall be initialized with 0 and shall be incremented by 1

for every subsequent send request. When the counter reaches the maximum value(0xE), then it shall restart with 0 for the next sen";
BA_ "Version" SG_ 3221225472 OBCWakeupDrUnlock "19.04.06";
BA_ "UserSigValidity" SG_ 3221225472 OBCWakeupDrUnlock 0;
BA_ "Description" SG_ 3221225472 OBCWakeupDrUnlock "This signal is for OBC wake-up, When ICU Unlock event";
BA_ "Version" SG_ 3221225472 OBCWakeupDrLock "19.04.06";
BA_ "UserSigValidity" SG_ 3221225472 OBCWakeupDrLock 0;
BA_ "Description" SG_ 3221225472 OBCWakeupDrLock "This signal is for OBC wake-up, When ICU Lock event";
BA_ "Version" SG_ 3221225472 ICU_Crc6Val "18.11.08";
BA_ "UserSigValidity" SG_ 3221225472 ICU_Crc6Val 0;
BA_ "GenSigStartValue" SG_ 3221225472 ICU_Crc6Val 255;
BA_ "GenSigSendType" SG_ 3221225472 ICU_Crc6Val 4;
BA_ "Description" SG_ 3221225472 ICU_Crc6Val "The data area for CRC calculation is based on the data length (DLC) of the message DB.

The CRC shall be calculated over the entire data block (excluding the CRC bytes) including the user data, alive counter and Data ID 

 

- CRC Polynomial (0x1D) , Ini";
BA_ "Version" SG_ 3221225472 ICU_AlvCnt6Val "18.11.08";
BA_ "UserSigValidity" SG_ 3221225472 ICU_AlvCnt6Val 0;
BA_ "GenSigSendType" SG_ 3221225472 ICU_AlvCnt6Val 4;
BA_ "Description" SG_ 3221225472 ICU_AlvCnt6Val "For the first transmission request for a data element the counter shall be initialized with 0 and shall be incremented by 1

for every subsequent send request. When the counter reaches the maximum value(0xE), then it shall restart with 0 for the next sen";
BA_ "Version" SG_ 3221225472 Lamp_RrTrnSigLmpLftOpnSta "17.12.00";
BA_ "NetworkRequestHoldingTime" SG_ 3221225472 Lamp_RrTrnSigLmpLftOpnSta 5000;
BA_ "NetworkRequest" SG_ 3221225472 Lamp_RrTrnSigLmpLftOpnSta 0;
BA_ "UserSigValidity" SG_ 3221225472 Lamp_RrTrnSigLmpLftOpnSta 0;
BA_ "GenSigSendType" SG_ 3221225472 Lamp_RrTrnSigLmpLftOpnSta 4;
BA_ "Description" SG_ 3221225472 Lamp_RrTrnSigLmpLftOpnSta "Rear T/SIG Lamp



Left OpenStatus";
BA_ "Version" SG_ 3221225472 Lamp_RrTrnSigLmpRtOpnSta "17.12.00";
BA_ "NetworkRequestHoldingTime" SG_ 3221225472 Lamp_RrTrnSigLmpRtOpnSta 5000;
BA_ "NetworkRequest" SG_ 3221225472 Lamp_RrTrnSigLmpRtOpnSta 0;
BA_ "UserSigValidity" SG_ 3221225472 Lamp_RrTrnSigLmpRtOpnSta 0;
BA_ "GenSigSendType" SG_ 3221225472 Lamp_RrTrnSigLmpRtOpnSta 4;
BA_ "Description" SG_ 3221225472 Lamp_RrTrnSigLmpRtOpnSta "Rear T/SIG Lamp



Right OpenStatus";
BA_ "Version" SG_ 3221225472 Lamp_FrTrnSigLmpLftOpnSta "17.12.00";
BA_ "NetworkRequestHoldingTime" SG_ 3221225472 Lamp_FrTrnSigLmpLftOpnSta 5000;
BA_ "NetworkRequest" SG_ 3221225472 Lamp_FrTrnSigLmpLftOpnSta 0;
BA_ "UserSigValidity" SG_ 3221225472 Lamp_FrTrnSigLmpLftOpnSta 0;
BA_ "GenSigSendType" SG_ 3221225472 Lamp_FrTrnSigLmpLftOpnSta 4;
BA_ "Description" SG_ 3221225472 Lamp_FrTrnSigLmpLftOpnSta "Front T/SIG Lamp



Left OpenStatus";
BA_ "Version" SG_ 3221225472 Lamp_FrTrnSigLmpRtOpnSta "17.12.00";
BA_ "NetworkRequestHoldingTime" SG_ 3221225472 Lamp_FrTrnSigLmpRtOpnSta 5000;
BA_ "NetworkRequest" SG_ 3221225472 Lamp_FrTrnSigLmpRtOpnSta 0;
BA_ "UserSigValidity" SG_ 3221225472 Lamp_FrTrnSigLmpRtOpnSta 0;
BA_ "GenSigSendType" SG_ 3221225472 Lamp_FrTrnSigLmpRtOpnSta 4;
BA_ "Description" SG_ 3221225472 Lamp_FrTrnSigLmpRtOpnSta "Front T/SIG Lamp



Right OpenStatus";
BA_ "Version" SG_ 3221225472 ESC_Crc3Val "18.11.08";
BA_ "RoutingFactor" SG_ 3221225472 ESC_Crc3Val 5;
BA_ "UserSigValidity" SG_ 3221225472 ESC_Crc3Val 3;
BA_ "GenSigStartValue" SG_ 3221225472 ESC_Crc3Val 65535;
BA_ "Description" SG_ 3221225472 ESC_Crc3Val "The data area for CRC calculation is based on the data length (DLC) of the message DB.

The CRC shall be calculated over the entire data block (excluding the CRC bytes) including the user data, alive counter and Data ID

 

- CRC Polynomial (0x1021) , In";
BA_ "Version" SG_ 3221225472 ESC_FCA_ActvSta "19.11.02";
BA_ "RoutingFactor" SG_ 3221225472 ESC_FCA_ActvSta 5;
BA_ "UserSigValidity" SG_ 3221225472 ESC_FCA_ActvSta 3;
BA_ "Description" SG_ 3221225472 ESC_FCA_ActvSta "This signal specifies the status of control for FCA control request flag.

(FCA ���� ��û�� ���� ���� ����� ���࿩�� Ȯ���� ���� ���� ��ȣ)";
BA_ "Version" SG_ 3221225472 ESC_DBS_ActvSta "19.11.02";
BA_ "RoutingFactor" SG_ 3221225472 ESC_DBS_ActvSta 5;
BA_ "UserSigValidity" SG_ 3221225472 ESC_DBS_ActvSta 3;
BA_ "Description" SG_ 3221225472 ESC_DBS_ActvSta "This signal specifies the status of control for DBS flag.

(DBS ���� ��û�� ���� ���� ����� ���࿩�� Ȯ�� ���� ���� ��ȣ)";
BA_ "Version" SG_ 3221225472 ESC_RccaSta "17.12.00";
BA_ "RoutingFactor" SG_ 3221225472 ESC_RccaSta 5;
BA_ "UserSigValidity" SG_ 3221225472 ESC_RccaSta 3;
BA_ "Description" SG_ 3221225472 ESC_RccaSta "RCCA Brake Function Status";
BA_ "Version" SG_ 3221225472 ESC_PcaSta "17.12.06";
BA_ "RoutingFactor" SG_ 3221225472 ESC_PcaSta 5;
BA_ "UserSigValidity" SG_ 3221225472 ESC_PcaSta 3;
BA_ "Description" SG_ 3221225472 ESC_PcaSta "PCA-R Brake Status";
BA_ "Version" SG_ 3221225472 ESC_DiffBrkFuncSta "17.12.00";
BA_ "RoutingFactor" SG_ 3221225472 ESC_DiffBrkFuncSta 5;
BA_ "UserSigValidity" SG_ 3221225472 ESC_DiffBrkFuncSta 3;
BA_ "Description" SG_ 3221225472 ESC_DiffBrkFuncSta "This is ESC status for Differential brake function.";
BA_ "Version" SG_ 3221225472 ESC_BcaRPlusSta "17.12.07";
BA_ "RoutingFactor" SG_ 3221225472 ESC_BcaRPlusSta 5;
BA_ "UserSigValidity" SG_ 3221225472 ESC_BcaRPlusSta 3;
BA_ "Description" SG_ 3221225472 ESC_BcaRPlusSta "BCA-R+ Brake Function Status";
BA_ "Version" SG_ 3221225472 ESC_RspaSta "17.12.00";
BA_ "RoutingFactor" SG_ 3221225472 ESC_RspaSta 5;
BA_ "UserSigValidity" SG_ 3221225472 ESC_RspaSta 3;
BA_ "GenSigStartValue" SG_ 3221225472 ESC_RspaSta 1;
BA_ "Description" SG_ 3221225472 ESC_RspaSta "This signal indicates RSPA assistant control mode of ESC";
BA_ "Version" SG_ 3221225472 ESC_RspaCanFlFlag "17.12.00";
BA_ "RoutingFactor" SG_ 3221225472 ESC_RspaCanFlFlag 5;
BA_ "UserSigValidity" SG_ 3221225472 ESC_RspaCanFlFlag 3;
BA_ "Description" SG_ 3221225472 ESC_RspaCanFlFlag "This signal indicates RSPA CAN failure value.

E.g. Timeout, CRC error, Alive counter error, out of range signal value��";
BA_ "Version" SG_ 3221225472 ESC_RspaDclActv "17.12.00";
BA_ "RoutingFactor" SG_ 3221225472 ESC_RspaDclActv 5;
BA_ "UserSigValidity" SG_ 3221225472 ESC_RspaDclActv 3;
BA_ "Description" SG_ 3221225472 ESC_RspaDclActv "This signal indicates the additional braking control is activated for RSPA.

ESC activate additional deceleration to minimize vehicle speed overshoot.";
BA_ "Version" SG_ 3221225472 ESC_RspaStandStill "17.12.00";
BA_ "RoutingFactor" SG_ 3221225472 ESC_RspaStandStill 5;
BA_ "UserSigValidity" SG_ 3221225472 ESC_RspaStandStill 3;
BA_ "Description" SG_ 3221225472 ESC_RspaStandStill "This signal indicates confirmation for standstill of the vehicle.";
BA_ "Version" SG_ 3221225472 ESC_AlvCnt3Val "18.11.08";
BA_ "RoutingFactor" SG_ 3221225472 ESC_AlvCnt3Val 5;
BA_ "UserSigValidity" SG_ 3221225472 ESC_AlvCnt3Val 3;
BA_ "Description" SG_ 3221225472 ESC_AlvCnt3Val "For the first transmission request for a data element the counter shall be initialized with 0 and shall be incremented by 1 for every subsequent send request. 

When the counter reaches the maximum value(0xFF), then it shall restart with 0 for the next s";
BA_ "Version" SG_ 3221225472 MCB_ReqBrkAck "18.12.05";
BA_ "RoutingFactor" SG_ 3221225472 MCB_ReqBrkAck 5;
BA_ "UserSigValidity" SG_ 3221225472 MCB_ReqBrkAck 3;
BA_ "Description" SG_ 3221225472 MCB_ReqBrkAck "This signal is about communication with ACU. It is changed with ACU_ReqBrk_By_PCB signal value.

If ESC receive 0x1 or 0x2 value of ACU_ReqBrk_By_PCB, signal value of MCB_ReqBrkAck change to 0x1.

If ESC receive 0x0 value of ACU_ReqBrk_By_PCB, signal val";
BA_ "Version" SG_ 3221225472 MCB_CtlSta "19.05.02";
BA_ "RoutingFactor" SG_ 3221225472 MCB_CtlSta 5;
BA_ "UserSigValidity" SG_ 3221225472 MCB_CtlSta 3;
BA_ "Description" SG_ 3221225472 MCB_CtlSta "This signal indicate MCB activation status.";
BA_ "Version" SG_ 3221225472 MCB_DefSta "19.05.02";
BA_ "RoutingFactor" SG_ 3221225472 MCB_DefSta 5;
BA_ "UserSigValidity" SG_ 3221225472 MCB_DefSta 3;
BA_ "Description" SG_ 3221225472 MCB_DefSta "This signal indicate MCB defective status.";
BA_ "Version" SG_ 3221225472 ESC_LsdLimMod "18.05.02";
BA_ "RoutingFactor" SG_ 3221225472 ESC_LsdLimMod 5;
BA_ "UserSigValidity" SG_ 3221225472 ESC_LsdLimMod 3;
BA_ "Description" SG_ 3221225472 ESC_LsdLimMod "This signal indicates the request for eLSD torque limit mode.

0x0:Maximum limitation mode

0x1:Minimum limitation mode";
BA_ "Version" SG_ 3221225472 ESC_LsdOpn "18.05.02";
BA_ "RoutingFactor" SG_ 3221225472 ESC_LsdOpn 5;
BA_ "UserSigValidity" SG_ 3221225472 ESC_LsdOpn 3;
BA_ "Description" SG_ 3221225472 ESC_LsdOpn "This signal indicates the command for eLSD clutch open mode.";
BA_ "Version" SG_ 3221225472 ESC_LsdTqLim "18.05.02";
BA_ "RoutingFactor" SG_ 3221225472 ESC_LsdTqLim 5;
BA_ "UserSigValidity" SG_ 3221225472 ESC_LsdTqLim 3;
BA_ "GenSigStartValue" SG_ 3221225472 ESC_LsdTqLim 64255;
BA_ "Description" SG_ 3221225472 ESC_LsdTqLim "This signal indicates the request for the value of the torquel limit of eLSD.

0xFFFF : Error";
BA_ "Version" SG_ 3221225472 SCC_TqIntrvntnVal "17.12.00";
BA_ "RoutingFactor" SG_ 3221225472 SCC_TqIntrvntnVal 5;
BA_ "UserSigValidity" SG_ 3221225472 SCC_TqIntrvntnVal 3;
BA_ "Description" SG_ 3221225472 SCC_TqIntrvntnVal "The indicated torque command TQI_ACC is the basic control path to the engine power control. This command has the same priority in the torque-structure than the driver��s demand torque. The maximum value of either TQI_ACC or the driver torque is selected ";
BA_ "Version" SG_ 3221225472 ESC_VehAccelVal "17.12.00";
BA_ "RoutingFactor" SG_ 3221225472 ESC_VehAccelVal 5;
BA_ "UserSigValidity" SG_ 3221225472 ESC_VehAccelVal 3;
BA_ "Description" SG_ 3221225472 ESC_VehAccelVal "The vehicle acceleration ACCEL_REF_ACC displays the feedback signal for the inner acceleration control loop since it is the SCC-internal acceleration command value. In addition this signal is used to calculate the target object acceleration. If the requi";
BA_ "Version" SG_ 3221225472 ESC_AccelBasisVal "17.12.00";
BA_ "RoutingFactor" SG_ 3221225472 ESC_AccelBasisVal 5;
BA_ "UserSigValidity" SG_ 3221225472 ESC_AccelBasisVal 3;
BA_ "Description" SG_ 3221225472 ESC_AccelBasisVal "This value is used to initialize the acceleration control when SCC is engaged or after driver override.";
BA_ "Version" SG_ 3221225472 SCC_OptTyp "18.12.04";
BA_ "RoutingFactor" SG_ 3221225472 SCC_OptTyp 5;
BA_ "UserSigValidity" SG_ 3221225472 SCC_OptTyp 3;
BA_ "Description" SG_ 3221225472 SCC_OptTyp "This value is used for SCC is equipped or not.

Do not recognize 0x3(Not Coded) as failure.";
BA_ "Version" SG_ 3221225472 SCC_EnblReq "17.12.00";
BA_ "RoutingFactor" SG_ 3221225472 SCC_EnblReq 5;
BA_ "UserSigValidity" SG_ 3221225472 SCC_EnblReq 3;
BA_ "Description" SG_ 3221225472 SCC_EnblReq "This signal is set by the safety logic in the TCS/ESC. The safety logic shall monitor the following:

1. A temporary failure in the vehicle does not allow SCC (Brakes are overheated, etc��). 

SCC is disabled reversible.

2. SCC communication failure (ti";
BA_ "Version" SG_ 3221225472 SCC_TqReq "17.12.00";
BA_ "RoutingFactor" SG_ 3221225472 SCC_TqReq 5;
BA_ "UserSigValidity" SG_ 3221225472 SCC_TqReq 3;
BA_ "Description" SG_ 3221225472 SCC_TqReq "When it is set, the signal indicates that ESC requests engine torque control for SCC. When the signal is set, EMS should not conduct fuel-cut off control unless it is required to prevent the damage of the engine and the related components.";
BA_ "Version" SG_ 3221225472 SCC_ReqLimSta "17.12.00";
BA_ "RoutingFactor" SG_ 3221225472 SCC_ReqLimSta 5;
BA_ "UserSigValidity" SG_ 3221225472 SCC_ReqLimSta 3;
BA_ "Description" SG_ 3221225472 SCC_ReqLimSta "Due to limitaion of the actuators the acceleration or deceleration request from SCC can not be processed or only partly. 



Examples:

1. SCC is requesting more acceleration than the engine can deliver.

2. SCC is requesting deceleration on a low �� sur";
BA_ "Version" SG_ 3221225472 ESC_StdStillVal "17.12.00";
BA_ "RoutingFactor" SG_ 3221225472 ESC_StdStillVal 5;
BA_ "UserSigValidity" SG_ 3221225472 ESC_StdStillVal 3;
BA_ "Description" SG_ 3221225472 ESC_StdStillVal "If an ESC uses active wheel speed sensors, wheel speeds down to 0 Km/h can be measured. And at 0 Km/h a StandStill flag is set in the ESC. This signal is used in the offset determination of the yaw rate and shall indicate that the vehicle has come to a c";
BA_ "Version" SG_ 3221225472 ESC_BrkLtReq "17.12.00";
BA_ "RoutingFactor" SG_ 3221225472 ESC_BrkLtReq 5;
BA_ "UserSigValidity" SG_ 3221225472 ESC_BrkLtReq 3;
BA_ "Description" SG_ 3221225472 ESC_BrkLtReq "Flag from TCS which activates the illumination of the brake lights during automatic braking.";
BA_ "Version" SG_ 3221225472 ESC_DclEnblReq "17.12.00";
BA_ "RoutingFactor" SG_ 3221225472 ESC_DclEnblReq 5;
BA_ "UserSigValidity" SG_ 3221225472 ESC_DclEnblReq 3;
BA_ "Description" SG_ 3221225472 ESC_DclEnblReq "This signal enables the deceleration control to accept command values axvCv from SCC. This flag is complementary to the ACC_REQ flag if SCC is in active mode.";
BA_ "Version" SG_ 3221225472 ESC_DrvOvrdSta "17.12.00";
BA_ "RoutingFactor" SG_ 3221225472 ESC_DrvOvrdSta 5;
BA_ "UserSigValidity" SG_ 3221225472 ESC_DrvOvrdSta 3;
BA_ "Description" SG_ 3221225472 ESC_DrvOvrdSta "This signal indicates that acceleration or deceleration value of driver��s requirement is greater than SCC setting value.";
BA_ "Version" SG_ 3221225472 ESC_DrvBrkSta "17.12.00";
BA_ "RoutingFactor" SG_ 3221225472 ESC_DrvBrkSta 5;
BA_ "UserSigValidity" SG_ 3221225472 ESC_DrvBrkSta 3;
BA_ "Description" SG_ 3221225472 ESC_DrvBrkSta "This signal indicates flag from ESC to SCC to indicate the driver braking state";
BA_ "Version" SG_ 3221225472 ESC_DrvBrkActvSta "17.12.00";
BA_ "RoutingFactor" SG_ 3221225472 ESC_DrvBrkActvSta 5;
BA_ "UserSigValidity" SG_ 3221225472 ESC_DrvBrkActvSta 3;
BA_ "Description" SG_ 3221225472 ESC_DrvBrkActvSta "This signal indicates that a driver is pressing the brake pedal or not.";
BA_ "Version" SG_ 3221225472 ESC_PrkBrkActvSta "17.12.00";
BA_ "RoutingFactor" SG_ 3221225472 ESC_PrkBrkActvSta 5;
BA_ "UserSigValidity" SG_ 3221225472 ESC_PrkBrkActvSta 3;
BA_ "Description" SG_ 3221225472 ESC_PrkBrkActvSta "This signal indicates whether the parking brake is activated or not.";
BA_ "Version" SG_ 3221225472 FCA_EquipSta "18.12.04";
BA_ "RoutingFactor" SG_ 3221225472 FCA_EquipSta 5;
BA_ "UserSigValidity" SG_ 3221225472 FCA_EquipSta 3;
BA_ "Description" SG_ 3221225472 FCA_EquipSta "FCA Equipment Status

Do not recognize 0x3(Not Coded) as failure.";
BA_ "Version" SG_ 3221225472 FCA_AvlblSta "18.02.00";
BA_ "RoutingFactor" SG_ 3221225472 FCA_AvlblSta 5;
BA_ "UserSigValidity" SG_ 3221225472 FCA_AvlblSta 3;
BA_ "Description" SG_ 3221225472 FCA_AvlblSta "This signal indicates state signal from ESC to FCA which tells if ESC is 'Available', 'Temporarily not available', 'Permanently not available' or 'FCA Communication Error'.";
BA_ "Version" SG_ 3221225472 Diagnostics_for_PCTool_RES_Byte0 "18.08.02";
BA_ "NetworkRequestHoldingTime" SG_ 3221225472 Diagnostics_for_PCTool_RES_Byte0 5000;
BA_ "NetworkRequest" SG_ 3221225472 Diagnostics_for_PCTool_RES_Byte0 0;
BA_ "UserSigValidity" SG_ 3221225472 Diagnostics_for_PCTool_RES_Byte0 0;
BA_ "GenSigSendType" SG_ 3221225472 Diagnostics_for_PCTool_RES_Byte0 2;
BA_ "UsrSigPurpose" SG_ 3221225472 Diagnostics_for_PCTool_RES_Byte0 6;
BA_ "Version" SG_ 3221225472 Diagnostics_for_PCTool_RES_Byte2 "18.08.02";
BA_ "NetworkRequestHoldingTime" SG_ 3221225472 Diagnostics_for_PCTool_RES_Byte2 5000;
BA_ "NetworkRequest" SG_ 3221225472 Diagnostics_for_PCTool_RES_Byte2 0;
BA_ "UserSigValidity" SG_ 3221225472 Diagnostics_for_PCTool_RES_Byte2 0;
BA_ "GenSigSendType" SG_ 3221225472 Diagnostics_for_PCTool_RES_Byte2 2;
BA_ "UsrSigPurpose" SG_ 3221225472 Diagnostics_for_PCTool_RES_Byte2 6;
BA_ "Version" SG_ 3221225472 Diagnostics_for_PCTool_RES_Byte3 "18.08.02";
BA_ "NetworkRequestHoldingTime" SG_ 3221225472 Diagnostics_for_PCTool_RES_Byte3 5000;
BA_ "NetworkRequest" SG_ 3221225472 Diagnostics_for_PCTool_RES_Byte3 0;
BA_ "UserSigValidity" SG_ 3221225472 Diagnostics_for_PCTool_RES_Byte3 0;
BA_ "GenSigSendType" SG_ 3221225472 Diagnostics_for_PCTool_RES_Byte3 2;
BA_ "UsrSigPurpose" SG_ 3221225472 Diagnostics_for_PCTool_RES_Byte3 6;
BA_ "Version" SG_ 3221225472 Diagnostics_for_PCTool_RES_Byte4 "18.08.02";
BA_ "NetworkRequestHoldingTime" SG_ 3221225472 Diagnostics_for_PCTool_RES_Byte4 5000;
BA_ "NetworkRequest" SG_ 3221225472 Diagnostics_for_PCTool_RES_Byte4 0;
BA_ "UserSigValidity" SG_ 3221225472 Diagnostics_for_PCTool_RES_Byte4 0;
BA_ "GenSigSendType" SG_ 3221225472 Diagnostics_for_PCTool_RES_Byte4 2;
BA_ "UsrSigPurpose" SG_ 3221225472 Diagnostics_for_PCTool_RES_Byte4 6;
BA_ "Version" SG_ 3221225472 Diagnostics_for_PCTool_RES_Byte5 "18.08.02";
BA_ "NetworkRequestHoldingTime" SG_ 3221225472 Diagnostics_for_PCTool_RES_Byte5 5000;
BA_ "NetworkRequest" SG_ 3221225472 Diagnostics_for_PCTool_RES_Byte5 0;
BA_ "UserSigValidity" SG_ 3221225472 Diagnostics_for_PCTool_RES_Byte5 0;
BA_ "GenSigSendType" SG_ 3221225472 Diagnostics_for_PCTool_RES_Byte5 2;
BA_ "UsrSigPurpose" SG_ 3221225472 Diagnostics_for_PCTool_RES_Byte5 6;
BA_ "Version" SG_ 3221225472 Diagnostics_for_PCTool_RES_Byte6 "18.08.02";
BA_ "NetworkRequestHoldingTime" SG_ 3221225472 Diagnostics_for_PCTool_RES_Byte6 5000;
BA_ "NetworkRequest" SG_ 3221225472 Diagnostics_for_PCTool_RES_Byte6 0;
BA_ "UserSigValidity" SG_ 3221225472 Diagnostics_for_PCTool_RES_Byte6 0;
BA_ "GenSigSendType" SG_ 3221225472 Diagnostics_for_PCTool_RES_Byte6 2;
BA_ "UsrSigPurpose" SG_ 3221225472 Diagnostics_for_PCTool_RES_Byte6 6;
BA_ "Version" SG_ 3221225472 Diagnostics_for_PCTool_RES_Byte7 "18.08.02";
BA_ "NetworkRequestHoldingTime" SG_ 3221225472 Diagnostics_for_PCTool_RES_Byte7 5000;
BA_ "NetworkRequest" SG_ 3221225472 Diagnostics_for_PCTool_RES_Byte7 0;
BA_ "UserSigValidity" SG_ 3221225472 Diagnostics_for_PCTool_RES_Byte7 0;
BA_ "GenSigSendType" SG_ 3221225472 Diagnostics_for_PCTool_RES_Byte7 2;
BA_ "UsrSigPurpose" SG_ 3221225472 Diagnostics_for_PCTool_RES_Byte7 6;
BA_ "Version" SG_ 3221225472 Diagnostics_for_PCTool_RES_Byte1 "18.08.02";
BA_ "NetworkRequestHoldingTime" SG_ 3221225472 Diagnostics_for_PCTool_RES_Byte1 5000;
BA_ "NetworkRequest" SG_ 3221225472 Diagnostics_for_PCTool_RES_Byte1 0;
BA_ "UserSigValidity" SG_ 3221225472 Diagnostics_for_PCTool_RES_Byte1 0;
BA_ "GenSigSendType" SG_ 3221225472 Diagnostics_for_PCTool_RES_Byte1 2;
BA_ "UsrSigPurpose" SG_ 3221225472 Diagnostics_for_PCTool_RES_Byte1 6;
BA_ "Version" SG_ 3221225472 ADAS_PRK_Crc1Val "18.11.08";
BA_ "RoutingFactor" SG_ 3221225472 ADAS_PRK_Crc1Val 5;
BA_ "UserSigValidity" SG_ 3221225472 ADAS_PRK_Crc1Val 3;
BA_ "GenSigStartValue" SG_ 3221225472 ADAS_PRK_Crc1Val 65535;
BA_ "Description" SG_ 3221225472 ADAS_PRK_Crc1Val "The data area for CRC calculation is based on the data length (DLC) of the message DB.

The CRC shall be calculated over the entire data block (excluding the CRC bytes) including the user data, alive counter and Data ID

 

- CRC Polynomial (0x1021) , In";
BA_ "Version" SG_ 3221225472 ADAS_PRK_AlvCnt1Val "18.11.08";
BA_ "RoutingFactor" SG_ 3221225472 ADAS_PRK_AlvCnt1Val 5;
BA_ "UserSigValidity" SG_ 3221225472 ADAS_PRK_AlvCnt1Val 3;
BA_ "Description" SG_ 3221225472 ADAS_PRK_AlvCnt1Val "For the first transmission request for a data element the counter shall be initialized with 0 and shall be incremented by 1 for every subsequent send request. 

When the counter reaches the maximum value(0xFF), then it shall restart with 0 for the next s";
BA_ "Version" SG_ 3221225472 PCA_SysSta "17.12.00";
BA_ "RoutingFactor" SG_ 3221225472 PCA_SysSta 5;
BA_ "UserSigValidity" SG_ 3221225472 PCA_SysSta 3;
BA_ "Description" SG_ 3221225472 PCA_SysSta "PCA System status";
BA_ "Version" SG_ 3221225472 PCA_EquipSta "17.12.00";
BA_ "RoutingFactor" SG_ 3221225472 PCA_EquipSta 5;
BA_ "UserSigValidity" SG_ 3221225472 PCA_EquipSta 3;
BA_ "Description" SG_ 3221225472 PCA_EquipSta "PCA Failure status";
BA_ "Version" SG_ 3221225472 PCA_WrngLvlSta "19.01.08";
BA_ "RoutingFactor" SG_ 3221225472 PCA_WrngLvlSta 5;
BA_ "UserSigValidity" SG_ 3221225472 PCA_WrngLvlSta 3;
BA_ "Description" SG_ 3221225472 PCA_WrngLvlSta "PCA Warning level status";
BA_ "Version" SG_ 3221225472 PCA_WrngSndCtrSta "17.12.00";
BA_ "RoutingFactor" SG_ 3221225472 PCA_WrngSndCtrSta 5;
BA_ "UserSigValidity" SG_ 3221225472 PCA_WrngSndCtrSta 3;
BA_ "Description" SG_ 3221225472 PCA_WrngSndCtrSta "Warning sound center status";
BA_ "Version" SG_ 3221225472 PCA_WrngSndLftSta "17.12.00";
BA_ "RoutingFactor" SG_ 3221225472 PCA_WrngSndLftSta 5;
BA_ "UserSigValidity" SG_ 3221225472 PCA_WrngSndLftSta 3;
BA_ "Description" SG_ 3221225472 PCA_WrngSndLftSta "Warning sound left status";
BA_ "Version" SG_ 3221225472 PCA_WrngSndRtSta "17.12.00";
BA_ "RoutingFactor" SG_ 3221225472 PCA_WrngSndRtSta 5;
BA_ "UserSigValidity" SG_ 3221225472 PCA_WrngSndRtSta 3;
BA_ "Description" SG_ 3221225472 PCA_WrngSndRtSta "Warning sound right status";
BA_ "Version" SG_ 3221225472 PCA_BrkReq "19.07.06";
BA_ "RoutingFactor" SG_ 3221225472 PCA_BrkReq 5;
BA_ "UserSigValidity" SG_ 3221225472 PCA_BrkReq 3;
BA_ "Description" SG_ 3221225472 PCA_BrkReq "Brake request

with EPB : 0x2 PCA Brake on (hold)

without EPB : 0x1 PCA Brake on";
BA_ "Version" SG_ 3221225472 PCA_EpbReq "19.07.06";
BA_ "RoutingFactor" SG_ 3221225472 PCA_EpbReq 5;
BA_ "UserSigValidity" SG_ 3221225472 PCA_EpbReq 3;
BA_ "Description" SG_ 3221225472 PCA_EpbReq "request to hold the vehicle, applying EPB";
BA_ "Version" SG_ 3221225472 PCA_DclTrgtVal "18.07.01";
BA_ "RoutingFactor" SG_ 3221225472 PCA_DclTrgtVal 5;
BA_ "UserSigValidity" SG_ 3221225472 PCA_DclTrgtVal 3;
BA_ "Description" SG_ 3221225472 PCA_DclTrgtVal "Deceleration target value";
BA_ "Version" SG_ 3221225472 PCA_DgrSta "17.12.03";
BA_ "RoutingFactor" SG_ 3221225472 PCA_DgrSta 5;
BA_ "UserSigValidity" SG_ 3221225472 PCA_DgrSta 3;
BA_ "Description" SG_ 3221225472 PCA_DgrSta "Warning timing status";
BA_ "Version" SG_ 3221225472 ADAS_PRK_PDW_SwIndOnReq "18.05.02";
BA_ "RoutingFactor" SG_ 3221225472 ADAS_PRK_PDW_SwIndOnReq 5;
BA_ "UserSigValidity" SG_ 3221225472 ADAS_PRK_PDW_SwIndOnReq 3;
BA_ "Description" SG_ 3221225472 ADAS_PRK_PDW_SwIndOnReq "-PDW Switch Indicator On/Off Request

This signal is used for PDW-R and PDW-F/R";
BA_ "Version" SG_ 3221225472 ADAS_PRK_PDW_OptTyp "18.05.02";
BA_ "RoutingFactor" SG_ 3221225472 ADAS_PRK_PDW_OptTyp 5;
BA_ "UserSigValidity" SG_ 3221225472 ADAS_PRK_PDW_OptTyp 3;
BA_ "Description" SG_ 3221225472 ADAS_PRK_PDW_OptTyp "this signal means PDW Option (Non, PDW-R, PDW-FR)";
BA_ "Version" SG_ 3221225472 ADAS_PRK_PDW_AutoOn_USM "18.05.02";
BA_ "RoutingFactor" SG_ 3221225472 ADAS_PRK_PDW_AutoOn_USM 5;
BA_ "UserSigValidity" SG_ 3221225472 ADAS_PRK_PDW_AutoOn_USM 3;
BA_ "Description" SG_ 3221225472 ADAS_PRK_PDW_AutoOn_USM "PDW system automatically on/off setting status";
BA_ "Version" SG_ 3221225472 ESC_Crc1Val "18.11.08";
BA_ "RoutingFactor" SG_ 3221225472 ESC_Crc1Val 5;
BA_ "UserSigValidity" SG_ 3221225472 ESC_Crc1Val 3;
BA_ "GenSigStartValue" SG_ 3221225472 ESC_Crc1Val 65535;
BA_ "Description" SG_ 3221225472 ESC_Crc1Val "The data area for CRC calculation is based on the data length (DLC) of the message DB.

The CRC shall be calculated over the entire data block (excluding the CRC bytes) including the user data, alive counter and Data ID

 

- CRC Polynomial (0x1021) , In";
BA_ "Version" SG_ 3221225472 TCS_GearShftCharacteristicVal "17.12.00";
BA_ "RoutingFactor" SG_ 3221225472 TCS_GearShftCharacteristicVal 5;
BA_ "UserSigValidity" SG_ 3221225472 TCS_GearShftCharacteristicVal 3;
BA_ "Description" SG_ 3221225472 TCS_GearShftCharacteristicVal "Interface signal between TCS/ESC and TCU influencing the TCU switching characteristics in the case of an TCS control system.";
BA_ "Version" SG_ 3221225472 TCS_ManufacturerVal "17.12.00";
BA_ "RoutingFactor" SG_ 3221225472 TCS_ManufacturerVal 5;
BA_ "UserSigValidity" SG_ 3221225472 TCS_ManufacturerVal 3;
BA_ "Description" SG_ 3221225472 TCS_ManufacturerVal "TCS manufacturer information to distinguish between a system which requires only TQI_TCS function and a system which requires both TQI_TCS and TQI_SLW_TCS functions. This signal indicates that TCS requests torque reduction using only TQI_TCS or using bot";
BA_ "Version" SG_ 3221225472 TCS_TqIntrvntnVal "17.12.00";
BA_ "RoutingFactor" SG_ 3221225472 TCS_TqIntrvntnVal 5;
BA_ "UserSigValidity" SG_ 3221225472 TCS_TqIntrvntnVal 3;
BA_ "GenSigStartValue" SG_ 3221225472 TCS_TqIntrvntnVal 255;
BA_ "Description" SG_ 3221225472 TCS_TqIntrvntnVal "Request for an indicated desired engine torque, the combination of signals calls, on the one hand, for a desire for charge reduction (TCS or ESC function), and, on the other hand, for a desire for charge increase (MSR function).



TQI_TCS : Torque reduc";
BA_ "Version" SG_ 3221225472 MSR_TqIntrvntnVal "17.12.00";
BA_ "RoutingFactor" SG_ 3221225472 MSR_TqIntrvntnVal 5;
BA_ "UserSigValidity" SG_ 3221225472 MSR_TqIntrvntnVal 3;
BA_ "Description" SG_ 3221225472 MSR_TqIntrvntnVal "Request for an indicated desired engine torque, the combination of signals calls, on the one hand, for a desire for charge reduction (TCS or ESC function), and, on the other hand, for a desire for charge increase (MSR function).



TQI_MSR : The torque i";
BA_ "Version" SG_ 3221225472 TCS_SlwTqIntrvntnVal "17.12.00";
BA_ "RoutingFactor" SG_ 3221225472 TCS_SlwTqIntrvntnVal 5;
BA_ "UserSigValidity" SG_ 3221225472 TCS_SlwTqIntrvntnVal 3;
BA_ "GenSigStartValue" SG_ 3221225472 TCS_SlwTqIntrvntnVal 255;
BA_ "Description" SG_ 3221225472 TCS_SlwTqIntrvntnVal "Request for an indicated desired engine torque, the combination of signals calls, on the one hand, for a desire for charge reduction (TCS or ESC function), and, on the other hand, for a desire for charge increase (MSR function).



TQI_SLW_TCS : The driv";
BA_ "Version" SG_ 3221225472 ESC_CylPrsrVal "17.12.00";
BA_ "RoutingFactor" SG_ 3221225472 ESC_CylPrsrVal 5;
BA_ "UserSigValidity" SG_ 3221225472 ESC_CylPrsrVal 3;
BA_ "Description" SG_ 3221225472 ESC_CylPrsrVal "This signal indicates pressure of brake master cylinder and provides information how deeply  a driver is pressing brake pedal.";
BA_ "Version" SG_ 3221225472 ESC_CylPrsrSta "18.02.00";
BA_ "RoutingFactor" SG_ 3221225472 ESC_CylPrsrSta 5;
BA_ "UserSigValidity" SG_ 3221225472 ESC_CylPrsrSta 3;
BA_ "GenSigStartValue" SG_ 3221225472 ESC_CylPrsrSta 1;
BA_ "Description" SG_ 3221225472 ESC_CylPrsrSta "This signal indicates validity of CYL_PRES signal.";
BA_ "Version" SG_ 3221225472 ESC_CylPrsrDiagSta "17.12.00";
BA_ "RoutingFactor" SG_ 3221225472 ESC_CylPrsrDiagSta 5;
BA_ "UserSigValidity" SG_ 3221225472 ESC_CylPrsrDiagSta 3;
BA_ "GenSigStartValue" SG_ 3221225472 ESC_CylPrsrDiagSta 1;
BA_ "Description" SG_ 3221225472 ESC_CylPrsrDiagSta "This signal indicates self-diagnosis mode of master cylinder pressure signal. During system check, master cylinder pressure information cannot be sent(not available) and this bit should be set to 1.";
BA_ "Version" SG_ 3221225472 ESC_CylPrsrFlagSta "17.12.00";
BA_ "RoutingFactor" SG_ 3221225472 ESC_CylPrsrFlagSta 5;
BA_ "UserSigValidity" SG_ 3221225472 ESC_CylPrsrFlagSta 3;
BA_ "Description" SG_ 3221225472 ESC_CylPrsrFlagSta "This signal means that the pressure of master cylinder is 15 bar or over.

(0x0 : under 15 bar, 0x1 : 15 bar or over)



This signal may be difference with actual BLS(Brake Lamp Switch) state.

So the ESC does not guarantee using this signal as substitut";
BA_ "Version" SG_ 3221225472 ESC_VsmActvSta "17.12.00";
BA_ "RoutingFactor" SG_ 3221225472 ESC_VsmActvSta 5;
BA_ "UserSigValidity" SG_ 3221225472 ESC_VsmActvSta 3;
BA_ "Description" SG_ 3221225472 ESC_VsmActvSta "ESC controller provides an information on VSM (ESC+MDPS) Active signal. It indicates VSM control is

active or inactive.";
BA_ "Version" SG_ 3221225472 ESC_VsmDfctvSta "17.12.00";
BA_ "RoutingFactor" SG_ 3221225472 ESC_VsmDfctvSta 5;
BA_ "UserSigValidity" SG_ 3221225472 ESC_VsmDfctvSta 3;
BA_ "Description" SG_ 3221225472 ESC_VsmDfctvSta "Information regarding the VSM ��defective�� Indication";
BA_ "Version" SG_ 3221225472 ESC_VsmCtrlModSta "17.12.00";
BA_ "RoutingFactor" SG_ 3221225472 ESC_VsmCtrlModSta 5;
BA_ "UserSigValidity" SG_ 3221225472 ESC_VsmCtrlModSta 3;
BA_ "Description" SG_ 3221225472 ESC_VsmCtrlModSta "Classify mode1 , mode2 and mode3 of torque overlay. 

- Mode1 is sensor value overlay mode.

- Mode2 is output torque overlay mode. 

- Mode3 is for an alternative mode for Mobis VSM system";
BA_ "Version" SG_ 3221225472 ESC_AlvCnt1Val "18.11.08";
BA_ "RoutingFactor" SG_ 3221225472 ESC_AlvCnt1Val 5;
BA_ "UserSigValidity" SG_ 3221225472 ESC_AlvCnt1Val 3;
BA_ "Description" SG_ 3221225472 ESC_AlvCnt1Val "For the first transmission request for a data element the counter shall be initialized with 0 and shall be incremented by 1 for every subsequent send request. 

When the counter reaches the maximum value(0xFF), then it shall restart with 0 for the next s";
BA_ "Version" SG_ 3221225472 ESC_StrTqReq "17.12.00";
BA_ "RoutingFactor" SG_ 3221225472 ESC_StrTqReq 5;
BA_ "UserSigValidity" SG_ 3221225472 ESC_StrTqReq 3;
BA_ "GenSigStartValue" SG_ 3221225472 ESC_StrTqReq 2048;
BA_ "Description" SG_ 3221225472 ESC_StrTqReq "Requested additional Assist torque of MDPS gets from ESC to make vehicle more stable.



Relationship between signals:

ESC_StrTrqReq = 0 Nm  ( DST inactive )

-> ESC_DstAct = 0, ESC_DstCtrMode = 0

ESC_StrTrqReq < 0 Nm  or  ESC_StrTrqReq > 0 Nm  (active";
BA_ "Version" SG_ 3221225472 ESC_LongAccelOffstCalibPrmtr "18.02.00";
BA_ "RoutingFactor" SG_ 3221225472 ESC_LongAccelOffstCalibPrmtr 5;
BA_ "UserSigValidity" SG_ 3221225472 ESC_LongAccelOffstCalibPrmtr 3;
BA_ "GenSigStartValue" SG_ 3221225472 ESC_LongAccelOffstCalibPrmtr 255;
BA_ "Description" SG_ 3221225472 ESC_LongAccelOffstCalibPrmtr "This signal indicates information regarding the calibration parameter for longitudinal acceleration value.

This signal doesn't guarantee the actual offset value.

But this signal is the result of the offset measuring process.

The allowed use of this si";
BA_ "Version" SG_ 3221225472 ESC_IMURstStaAck "18.03.06";
BA_ "RoutingFactor" SG_ 3221225472 ESC_IMURstStaAck 5;
BA_ "UserSigValidity" SG_ 3221225472 ESC_IMURstStaAck 3;
BA_ "Description" SG_ 3221225472 ESC_IMURstStaAck "This signal is used to response for IMU sensor's reset status.

When the IMU sensor is about to reset, it will transmit the reset flag.

(After then the ACU will wait for acknowledge signal from ESC.)

If the ESC receive the reset flag from ACU, ESC will";
BA_ "Version" SG_ 3221225472 AVH_Sta "17.12.00";
BA_ "RoutingFactor" SG_ 3221225472 AVH_Sta 5;
BA_ "UserSigValidity" SG_ 3221225472 AVH_Sta 3;
BA_ "Description" SG_ 3221225472 AVH_Sta "This signal indicates whether the vehicle is held with hydraulic brake (service brake).";
BA_ "Version" SG_ 3221225472 LDM_Sta "17.12.00";
BA_ "RoutingFactor" SG_ 3221225472 LDM_Sta 5;
BA_ "UserSigValidity" SG_ 3221225472 LDM_Sta 3;
BA_ "Description" SG_ 3221225472 LDM_Sta "Information about ESC-Readiness to perform Dynamic Braking Function (DBF) or Automatic Vehicle Hold (AVH) which is requested by AVH switch.



LDM_STAT (0H)

 - EPB function : EPB is slave

LDM_STAT (1H)

 - EPB function : EPB stand alone";
BA_ "Version" SG_ 3221225472 EPB_ActvReq "17.12.00";
BA_ "RoutingFactor" SG_ 3221225472 EPB_ActvReq 5;
BA_ "UserSigValidity" SG_ 3221225472 EPB_ActvReq 3;
BA_ "Description" SG_ 3221225472 EPB_ActvReq "This signal indicates that an ESC requests EPB to activate braking. 



REQ_EPB_ACT (0H)

 - AVH status : Don��t care

REQ_EPB_ACT (1H)

 - AVH status : Active

REQ_EPB_ACT (2H)

 - AVH status : Active

REQ_EPB_ACT (3H)

 - AVH status : Disabled

(EPB St";
BA_ "Version" SG_ 3221225472 EPB_StaReq "17.12.00";
BA_ "RoutingFactor" SG_ 3221225472 EPB_StaReq 5;
BA_ "UserSigValidity" SG_ 3221225472 EPB_StaReq 3;
BA_ "GenSigStartValue" SG_ 3221225472 EPB_StaReq 1;
BA_ "Description" SG_ 3221225472 EPB_StaReq "This signal indicates the validity of REQ_EPB_ACT (ESC request for EPB to activate braking) signal.";
BA_ "Version" SG_ 3221225472 ECD_ActvSta "17.12.00";
BA_ "RoutingFactor" SG_ 3221225472 ECD_ActvSta 5;
BA_ "UserSigValidity" SG_ 3221225472 ECD_ActvSta 3;
BA_ "Description" SG_ 3221225472 ECD_ActvSta "ECD Active signal indicates whether ECD function is active (operating) or not.";
BA_ "Version" SG_ 3221225472 AVH_CluDis "17.12.00";
BA_ "RoutingFactor" SG_ 3221225472 AVH_CluDis 5;
BA_ "UserSigValidity" SG_ 3221225472 AVH_CluDis 3;
BA_ "Description" SG_ 3221225472 AVH_CluDis "An ESC can show its information message to driver on a cluster or a display module with this signal.";
BA_ "Version" SG_ 3221225472 AVH_AlrmReq "17.12.00";
BA_ "RoutingFactor" SG_ 3221225472 AVH_AlrmReq 5;
BA_ "UserSigValidity" SG_ 3221225472 AVH_AlrmReq 3;
BA_ "Description" SG_ 3221225472 AVH_AlrmReq "This signal indicates that an ESC requests cluster or tone controller to ring the alarm according to the status of an ESC";
BA_ "Version" SG_ 3221225472 AVH_ActvStaLmpDis "17.12.00";
BA_ "RoutingFactor" SG_ 3221225472 AVH_ActvStaLmpDis 5;
BA_ "UserSigValidity" SG_ 3221225472 AVH_ActvStaLmpDis 3;
BA_ "Description" SG_ 3221225472 AVH_ActvStaLmpDis "This signal indicates AVH active status lamp request from ESC to cluster.";
BA_ "Version" SG_ 3221225472 AVH_LmpDis "17.12.00";
BA_ "RoutingFactor" SG_ 3221225472 AVH_LmpDis 5;
BA_ "UserSigValidity" SG_ 3221225472 AVH_LmpDis 3;
BA_ "Description" SG_ 3221225472 AVH_LmpDis "Information about the status lamp request from ESC (AVH) to cluster.";
BA_ "Version" SG_ 3221225472 AWD_CrdnShftTqLimVal "17.12.00";
BA_ "RoutingFactor" SG_ 3221225472 AWD_CrdnShftTqLimVal 5;
BA_ "UserSigValidity" SG_ 3221225472 AWD_CrdnShftTqLimVal 3;
BA_ "GenSigStartValue" SG_ 3221225472 AWD_CrdnShftTqLimVal 64255;
BA_ "Description" SG_ 3221225472 AWD_CrdnShftTqLimVal "Interface signal between ABS/TCS/ESC and 4WD, demands 4WD cardan shaft torque limit.";
BA_ "Version" SG_ 3221225472 AWD_CltchDtyLimVal "17.12.00";
BA_ "RoutingFactor" SG_ 3221225472 AWD_CltchDtyLimVal 5;
BA_ "UserSigValidity" SG_ 3221225472 AWD_CltchDtyLimVal 3;
BA_ "Description" SG_ 3221225472 AWD_CltchDtyLimVal "Interface signal between ABS/TCS/ESC and 4WD and demands 4WD clutch duty limit.";
BA_ "Version" SG_ 3221225472 AWD_TransmsnTqLimModSta "17.12.00";
BA_ "RoutingFactor" SG_ 3221225472 AWD_TransmsnTqLimModSta 5;
BA_ "UserSigValidity" SG_ 3221225472 AWD_TransmsnTqLimModSta 3;
BA_ "Description" SG_ 3221225472 AWD_TransmsnTqLimModSta "This signal indicates that Interface signal between ESC and 4WD, selecting cardan shaft torque limitation mode of 4WD.";
BA_ "Version" SG_ 3221225472 AWD_RrWhlDtyLimReq "17.12.00";
BA_ "RoutingFactor" SG_ 3221225472 AWD_RrWhlDtyLimReq 5;
BA_ "UserSigValidity" SG_ 3221225472 AWD_RrWhlDtyLimReq 3;
BA_ "Description" SG_ 3221225472 AWD_RrWhlDtyLimReq "This signal indicates that ESC request 4WD ECU to limit control duty of rear wheels for improvement of stability of a vehicle during ESC control.";
BA_ "Version" SG_ 3221225472 AWD_FastOpnCrdnShftCltchReq "17.12.00";
BA_ "RoutingFactor" SG_ 3221225472 AWD_FastOpnCrdnShftCltchReq 5;
BA_ "UserSigValidity" SG_ 3221225472 AWD_FastOpnCrdnShftCltchReq 3;
BA_ "Description" SG_ 3221225472 AWD_FastOpnCrdnShftCltchReq "Interface signal between ESC and 4WD, demands fast opening or torque limit of the 4WD cardan shaft clutch.";
BA_ "Version" SG_ 3221225472 TCS_LmpSta "17.12.00";
BA_ "RoutingFactor" SG_ 3221225472 TCS_LmpSta 5;
BA_ "UserSigValidity" SG_ 3221225472 TCS_LmpSta 3;
BA_ "Description" SG_ 3221225472 TCS_LmpSta "The signal indicates the status of the ��TCS/ESC Function/Warning Lamp��";
BA_ "Version" SG_ 3221225472 TCS_OffLmpSta "17.12.00";
BA_ "RoutingFactor" SG_ 3221225472 TCS_OffLmpSta 5;
BA_ "UserSigValidity" SG_ 3221225472 TCS_OffLmpSta 3;
BA_ "Description" SG_ 3221225472 TCS_OffLmpSta "The signal indicates the status of the ��TCS/ESC OFF SW Lamp��";
BA_ "Version" SG_ 3221225472 ESC_OffTempSta "17.12.00";
BA_ "RoutingFactor" SG_ 3221225472 ESC_OffTempSta 5;
BA_ "UserSigValidity" SG_ 3221225472 ESC_OffTempSta 3;
BA_ "Description" SG_ 3221225472 ESC_OffTempSta "Information regarding the ESC OFF step by switch input of driver.";
BA_ "Version" SG_ 3221225472 DBC_WrngLmpSta "17.12.00";
BA_ "RoutingFactor" SG_ 3221225472 DBC_WrngLmpSta 5;
BA_ "UserSigValidity" SG_ 3221225472 DBC_WrngLmpSta 3;
BA_ "Description" SG_ 3221225472 DBC_WrngLmpSta "The signal indicates the status of the ��DBC Warning lamp��";
BA_ "Version" SG_ 3221225472 DBC_FuncLmpSta "17.12.00";
BA_ "RoutingFactor" SG_ 3221225472 DBC_FuncLmpSta 5;
BA_ "UserSigValidity" SG_ 3221225472 DBC_FuncLmpSta 3;
BA_ "Description" SG_ 3221225472 DBC_FuncLmpSta "The signal indicates the status of the ��DBC Function lamp��";
BA_ "Version" SG_ 3221225472 DBC_ClusterDis "18.07.03";
BA_ "RoutingFactor" SG_ 3221225472 DBC_ClusterDis 5;
BA_ "UserSigValidity" SG_ 3221225472 DBC_ClusterDis 3;
BA_ "Description" SG_ 3221225472 DBC_ClusterDis "DBC Pop-up Signal for Deactivation";
BA_ "Version" SG_ 3221225472 ESC_BrkCtrlSta "17.12.00";
BA_ "RoutingFactor" SG_ 3221225472 ESC_BrkCtrlSta 5;
BA_ "UserSigValidity" SG_ 3221225472 ESC_BrkCtrlSta 3;
BA_ "Description" SG_ 3221225472 ESC_BrkCtrlSta "This signal indicates that if brake control from the ECU request is in activation or not  during cruise control or speed limiter.";
BA_ "Version" SG_ 3221225472 TCS_Sta "18.12.01";
BA_ "RoutingFactor" SG_ 3221225472 TCS_Sta 5;
BA_ "UserSigValidity" SG_ 3221225472 TCS_Sta 3;
BA_ "Description" SG_ 3221225472 TCS_Sta "Information regarding the status of TCS function.



If the function has not been coded(fixed) yet, this signal will be transmitted as 0xE.



If the vehicle has been applied only ABS(without ESC), this signal will be fixed as 0x0.";
BA_ "Version" SG_ 3221225472 ESC_Sta "18.12.01";
BA_ "RoutingFactor" SG_ 3221225472 ESC_Sta 5;
BA_ "UserSigValidity" SG_ 3221225472 ESC_Sta 3;
BA_ "Description" SG_ 3221225472 ESC_Sta "Information regarding the status of ESC function.



If the function has not been coded(fixed) yet, this signal will be transmitted as 0xE.



If the vehicle has been applied only ABS(without ESC), this signal will be fixed as 0x0.";
BA_ "Version" SG_ 3221225472 TCS_PreActvSta "17.12.00";
BA_ "RoutingFactor" SG_ 3221225472 TCS_PreActvSta 5;
BA_ "UserSigValidity" SG_ 3221225472 TCS_PreActvSta 3;
BA_ "Description" SG_ 3221225472 TCS_PreActvSta "Pre TCS Control Signal";
BA_ "Version" SG_ 3221225472 DBC_Sta "18.12.01";
BA_ "RoutingFactor" SG_ 3221225472 DBC_Sta 5;
BA_ "UserSigValidity" SG_ 3221225472 DBC_Sta 3;
BA_ "Description" SG_ 3221225472 DBC_Sta "Information regarding the status of DBC function.



If the function has not been coded(fixed) yet, this signal will be transmitted as 0xE.";
BA_ "Version" SG_ 3221225472 TCS_TqFlag "18.07.01";
BA_ "RoutingFactor" SG_ 3221225472 TCS_TqFlag 5;
BA_ "UserSigValidity" SG_ 3221225472 TCS_TqFlag 3;
BA_ "Description" SG_ 3221225472 TCS_TqFlag "Flag indicating positive or negative TCS Intervention";
BA_ "Version" SG_ 3221225472 MSR_TqFlag "18.07.01";
BA_ "RoutingFactor" SG_ 3221225472 MSR_TqFlag 5;
BA_ "UserSigValidity" SG_ 3221225472 MSR_TqFlag 3;
BA_ "Description" SG_ 3221225472 MSR_TqFlag "Flag indicating positive or negative MSR Intervention";
BA_ "Version" SG_ 3221225472 HAC_Sta "18.12.01";
BA_ "RoutingFactor" SG_ 3221225472 HAC_Sta 5;
BA_ "UserSigValidity" SG_ 3221225472 HAC_Sta 3;
BA_ "Description" SG_ 3221225472 HAC_Sta "Information regarding the status of HAC function.



If the function has not been coded(fixed) yet, this signal wilil be transmitted as 0xE.";
BA_ "Version" SG_ 3221225472 TCS_SlwTqFlag "18.07.01";
BA_ "RoutingFactor" SG_ 3221225472 TCS_SlwTqFlag 5;
BA_ "UserSigValidity" SG_ 3221225472 TCS_SlwTqFlag 3;
BA_ "Description" SG_ 3221225472 TCS_SlwTqFlag "Flag indicating positive or negative SLOW TCS Intervention";
BA_ "Version" SG_ 3221225472 TCS_Req "17.12.00";
BA_ "RoutingFactor" SG_ 3221225472 TCS_Req 5;
BA_ "UserSigValidity" SG_ 3221225472 TCS_Req 3;
BA_ "Description" SG_ 3221225472 TCS_Req "Request for an indicated desired engine torque, the combination of signals calls, on the one hand, for a desire for charge reduction (TCS or ESC function), and, on the other hand, for a desire for charge increase (MSR function).



TCS_REQ : Identifies a";
BA_ "Version" SG_ 3221225472 MSR_FuncReq "17.12.00";
BA_ "RoutingFactor" SG_ 3221225472 MSR_FuncReq 5;
BA_ "UserSigValidity" SG_ 3221225472 MSR_FuncReq 3;
BA_ "Description" SG_ 3221225472 MSR_FuncReq "Request for an indicated desired engine torque, the combination of signals calls, on the one hand, for a desire for charge reduction (TCS or ESC function), and, on the other hand, for a desire for charge increase (MSR function).



MSR_C_REQ : Identifies";
BA_ "Version" SG_ 3221225472 RWS_GST_Byte0 "18.01.08";
BA_ "NetworkRequestHoldingTime" SG_ 3221225472 RWS_GST_Byte0 5000;
BA_ "NetworkRequest" SG_ 3221225472 RWS_GST_Byte0 0;
BA_ "UserSigValidity" SG_ 3221225472 RWS_GST_Byte0 0;
BA_ "GenSigSendType" SG_ 3221225472 RWS_GST_Byte0 2;
BA_ "UsrSigPurpose" SG_ 3221225472 RWS_GST_Byte0 2;
BA_ "Version" SG_ 3221225472 RWS_GST_Byte2 "18.01.08";
BA_ "NetworkRequestHoldingTime" SG_ 3221225472 RWS_GST_Byte2 5000;
BA_ "NetworkRequest" SG_ 3221225472 RWS_GST_Byte2 0;
BA_ "UserSigValidity" SG_ 3221225472 RWS_GST_Byte2 0;
BA_ "GenSigSendType" SG_ 3221225472 RWS_GST_Byte2 2;
BA_ "UsrSigPurpose" SG_ 3221225472 RWS_GST_Byte2 2;
BA_ "Version" SG_ 3221225472 RWS_GST_Byte3 "18.01.08";
BA_ "NetworkRequestHoldingTime" SG_ 3221225472 RWS_GST_Byte3 5000;
BA_ "NetworkRequest" SG_ 3221225472 RWS_GST_Byte3 0;
BA_ "UserSigValidity" SG_ 3221225472 RWS_GST_Byte3 0;
BA_ "GenSigSendType" SG_ 3221225472 RWS_GST_Byte3 2;
BA_ "UsrSigPurpose" SG_ 3221225472 RWS_GST_Byte3 2;
BA_ "Version" SG_ 3221225472 RWS_GST_Byte4 "18.01.08";
BA_ "NetworkRequestHoldingTime" SG_ 3221225472 RWS_GST_Byte4 5000;
BA_ "NetworkRequest" SG_ 3221225472 RWS_GST_Byte4 0;
BA_ "UserSigValidity" SG_ 3221225472 RWS_GST_Byte4 0;
BA_ "GenSigSendType" SG_ 3221225472 RWS_GST_Byte4 2;
BA_ "UsrSigPurpose" SG_ 3221225472 RWS_GST_Byte4 2;
BA_ "Version" SG_ 3221225472 RWS_GST_Byte5 "18.01.08";
BA_ "NetworkRequestHoldingTime" SG_ 3221225472 RWS_GST_Byte5 5000;
BA_ "NetworkRequest" SG_ 3221225472 RWS_GST_Byte5 0;
BA_ "UserSigValidity" SG_ 3221225472 RWS_GST_Byte5 0;
BA_ "GenSigSendType" SG_ 3221225472 RWS_GST_Byte5 2;
BA_ "UsrSigPurpose" SG_ 3221225472 RWS_GST_Byte5 2;
BA_ "Version" SG_ 3221225472 RWS_GST_Byte6 "18.01.08";
BA_ "NetworkRequestHoldingTime" SG_ 3221225472 RWS_GST_Byte6 5000;
BA_ "NetworkRequest" SG_ 3221225472 RWS_GST_Byte6 0;
BA_ "UserSigValidity" SG_ 3221225472 RWS_GST_Byte6 0;
BA_ "GenSigSendType" SG_ 3221225472 RWS_GST_Byte6 2;
BA_ "UsrSigPurpose" SG_ 3221225472 RWS_GST_Byte6 2;
BA_ "Version" SG_ 3221225472 RWS_GST_Byte7 "18.01.08";
BA_ "NetworkRequestHoldingTime" SG_ 3221225472 RWS_GST_Byte7 5000;
BA_ "NetworkRequest" SG_ 3221225472 RWS_GST_Byte7 0;
BA_ "UserSigValidity" SG_ 3221225472 RWS_GST_Byte7 0;
BA_ "GenSigSendType" SG_ 3221225472 RWS_GST_Byte7 2;
BA_ "UsrSigPurpose" SG_ 3221225472 RWS_GST_Byte7 2;
BA_ "Version" SG_ 3221225472 RWS_GST_Byte1 "18.01.08";
BA_ "NetworkRequestHoldingTime" SG_ 3221225472 RWS_GST_Byte1 5000;
BA_ "NetworkRequest" SG_ 3221225472 RWS_GST_Byte1 0;
BA_ "UserSigValidity" SG_ 3221225472 RWS_GST_Byte1 0;
BA_ "GenSigSendType" SG_ 3221225472 RWS_GST_Byte1 2;
BA_ "UsrSigPurpose" SG_ 3221225472 RWS_GST_Byte1 2;
BA_ "Version" SG_ 3221225472 BCM_Crc10Val "18.11.08";
BA_ "UserSigValidity" SG_ 3221225472 BCM_Crc10Val 0;
BA_ "GenSigStartValue" SG_ 3221225472 BCM_Crc10Val 255;
BA_ "GenSigSendType" SG_ 3221225472 BCM_Crc10Val 4;
BA_ "Description" SG_ 3221225472 BCM_Crc10Val "The data area for CRC calculation is based on the data length (DLC) of the message DB.

The CRC shall be calculated over the entire data block (excluding the CRC bytes) including the user data, alive counter and Data ID 

 

- CRC Polynomial (0x1D) , Ini";
BA_ "Version" SG_ 3221225472 BCM_AlvCnt10Val "18.11.08";
BA_ "UserSigValidity" SG_ 3221225472 BCM_AlvCnt10Val 0;
BA_ "GenSigSendType" SG_ 3221225472 BCM_AlvCnt10Val 4;
BA_ "Description" SG_ 3221225472 BCM_AlvCnt10Val "For the first transmission request for a data element the counter shall be initialized with 0 and shall be incremented by 1

for every subsequent send request. When the counter reaches the maximum value(0xE), then it shall restart with 0 for the next sen";
BA_ "Version" SG_ 3221225472 Wiper_PrkngPosSta "17.12.00";
BA_ "NetworkRequestHoldingTime" SG_ 3221225472 Wiper_PrkngPosSta 5000;
BA_ "NetworkRequest" SG_ 3221225472 Wiper_PrkngPosSta 0;
BA_ "UserSigValidity" SG_ 3221225472 Wiper_PrkngPosSta 0;
BA_ "GenSigSendType" SG_ 3221225472 Wiper_PrkngPosSta 4;
BA_ "Version" SG_ 3221225472 Wiper_RainSnsrOptionTyp "17.12.00";
BA_ "NetworkRequestHoldingTime" SG_ 3221225472 Wiper_RainSnsrOptionTyp 5000;
BA_ "NetworkRequest" SG_ 3221225472 Wiper_RainSnsrOptionTyp 0;
BA_ "UserSigValidity" SG_ 3221225472 Wiper_RainSnsrOptionTyp 0;
BA_ "GenSigSendType" SG_ 3221225472 Wiper_RainSnsrOptionTyp 4;
BA_ "Description" SG_ 3221225472 Wiper_RainSnsrOptionTyp "Rain Sensor Option Information";
BA_ "Version" SG_ 3221225472 Wiper_RainSnsrSta "17.12.00";
BA_ "NetworkRequestHoldingTime" SG_ 3221225472 Wiper_RainSnsrSta 5000;
BA_ "NetworkRequest" SG_ 3221225472 Wiper_RainSnsrSta 0;
BA_ "UserSigValidity" SG_ 3221225472 Wiper_RainSnsrSta 0;
BA_ "GenSigSendType" SG_ 3221225472 Wiper_RainSnsrSta 4;
BA_ "Description" SG_ 3221225472 Wiper_RainSnsrSta "This signal represents the status of Rain Sensor signal state.";
BA_ "Version" SG_ 3221225472 BCM_SolSnsrRtOutVoltVal "18.04.02";
BA_ "NetworkRequestHoldingTime" SG_ 3221225472 BCM_SolSnsrRtOutVoltVal 5000;
BA_ "NetworkRequest" SG_ 3221225472 BCM_SolSnsrRtOutVoltVal 0;
BA_ "UserSigValidity" SG_ 3221225472 BCM_SolSnsrRtOutVoltVal 0;
BA_ "GenSigSendType" SG_ 3221225472 BCM_SolSnsrRtOutVoltVal 4;
BA_ "Description" SG_ 3221225472 BCM_SolSnsrRtOutVoltVal "This signal indicates solar sensor output voltage - RH";
BA_ "Version" SG_ 3221225472 BCM_SolSnsrLftOutVoltVal "18.04.02";
BA_ "NetworkRequestHoldingTime" SG_ 3221225472 BCM_SolSnsrLftOutVoltVal 5000;
BA_ "NetworkRequest" SG_ 3221225472 BCM_SolSnsrLftOutVoltVal 0;
BA_ "UserSigValidity" SG_ 3221225472 BCM_SolSnsrLftOutVoltVal 0;
BA_ "GenSigSendType" SG_ 3221225472 BCM_SolSnsrLftOutVoltVal 4;
BA_ "Description" SG_ 3221225472 BCM_SolSnsrLftOutVoltVal "This signal indicates solar sensor output voltage - LH";
BA_ "Version" SG_ 3221225472 BCM_GearPosPSta "17.12.00";
BA_ "NetworkRequestHoldingTime" SG_ 3221225472 BCM_GearPosPSta 5000;
BA_ "NetworkRequest" SG_ 3221225472 BCM_GearPosPSta 0;
BA_ "UserSigValidity" SG_ 3221225472 BCM_GearPosPSta 0;
BA_ "GenSigSendType" SG_ 3221225472 BCM_GearPosPSta 4;
BA_ "Version" SG_ 3221225472 BCM_SunRoofOpnSta "17.12.00";
BA_ "NetworkRequestHoldingTime" SG_ 3221225472 BCM_SunRoofOpnSta 5000;
BA_ "NetworkRequest" SG_ 3221225472 BCM_SunRoofOpnSta 0;
BA_ "UserSigValidity" SG_ 3221225472 BCM_SunRoofOpnSta 0;
BA_ "GenSigSendType" SG_ 3221225472 BCM_SunRoofOpnSta 4;
BA_ "Description" SG_ 3221225472 BCM_SunRoofOpnSta "-Sunroof open/close state";
BA_ "Version" SG_ 3221225472 Diagnostics_for_PCTool_REQ_Byte0 "18.08.02";
BA_ "NetworkRequestHoldingTime" SG_ 3221225472 Diagnostics_for_PCTool_REQ_Byte0 5000;
BA_ "NetworkRequest" SG_ 3221225472 Diagnostics_for_PCTool_REQ_Byte0 0;
BA_ "UserSigValidity" SG_ 3221225472 Diagnostics_for_PCTool_REQ_Byte0 0;
BA_ "GenSigSendType" SG_ 3221225472 Diagnostics_for_PCTool_REQ_Byte0 2;
BA_ "UsrSigPurpose" SG_ 3221225472 Diagnostics_for_PCTool_REQ_Byte0 6;
BA_ "Version" SG_ 3221225472 Diagnostics_for_PCTool_REQ_Byte2 "18.08.02";
BA_ "NetworkRequestHoldingTime" SG_ 3221225472 Diagnostics_for_PCTool_REQ_Byte2 5000;
BA_ "NetworkRequest" SG_ 3221225472 Diagnostics_for_PCTool_REQ_Byte2 0;
BA_ "UserSigValidity" SG_ 3221225472 Diagnostics_for_PCTool_REQ_Byte2 0;
BA_ "GenSigSendType" SG_ 3221225472 Diagnostics_for_PCTool_REQ_Byte2 2;
BA_ "UsrSigPurpose" SG_ 3221225472 Diagnostics_for_PCTool_REQ_Byte2 6;
BA_ "Version" SG_ 3221225472 Diagnostics_for_PCTool_REQ_Byte3 "18.08.02";
BA_ "NetworkRequestHoldingTime" SG_ 3221225472 Diagnostics_for_PCTool_REQ_Byte3 5000;
BA_ "NetworkRequest" SG_ 3221225472 Diagnostics_for_PCTool_REQ_Byte3 0;
BA_ "UserSigValidity" SG_ 3221225472 Diagnostics_for_PCTool_REQ_Byte3 0;
BA_ "GenSigSendType" SG_ 3221225472 Diagnostics_for_PCTool_REQ_Byte3 2;
BA_ "UsrSigPurpose" SG_ 3221225472 Diagnostics_for_PCTool_REQ_Byte3 6;
BA_ "Version" SG_ 3221225472 Diagnostics_for_PCTool_REQ_Byte4 "18.08.02";
BA_ "NetworkRequestHoldingTime" SG_ 3221225472 Diagnostics_for_PCTool_REQ_Byte4 5000;
BA_ "NetworkRequest" SG_ 3221225472 Diagnostics_for_PCTool_REQ_Byte4 0;
BA_ "UserSigValidity" SG_ 3221225472 Diagnostics_for_PCTool_REQ_Byte4 0;
BA_ "GenSigSendType" SG_ 3221225472 Diagnostics_for_PCTool_REQ_Byte4 2;
BA_ "UsrSigPurpose" SG_ 3221225472 Diagnostics_for_PCTool_REQ_Byte4 6;
BA_ "Version" SG_ 3221225472 Diagnostics_for_PCTool_REQ_Byte5 "18.08.02";
BA_ "NetworkRequestHoldingTime" SG_ 3221225472 Diagnostics_for_PCTool_REQ_Byte5 5000;
BA_ "NetworkRequest" SG_ 3221225472 Diagnostics_for_PCTool_REQ_Byte5 0;
BA_ "UserSigValidity" SG_ 3221225472 Diagnostics_for_PCTool_REQ_Byte5 0;
BA_ "GenSigSendType" SG_ 3221225472 Diagnostics_for_PCTool_REQ_Byte5 2;
BA_ "UsrSigPurpose" SG_ 3221225472 Diagnostics_for_PCTool_REQ_Byte5 6;
BA_ "Version" SG_ 3221225472 Diagnostics_for_PCTool_REQ_Byte6 "18.08.02";
BA_ "NetworkRequestHoldingTime" SG_ 3221225472 Diagnostics_for_PCTool_REQ_Byte6 5000;
BA_ "NetworkRequest" SG_ 3221225472 Diagnostics_for_PCTool_REQ_Byte6 0;
BA_ "UserSigValidity" SG_ 3221225472 Diagnostics_for_PCTool_REQ_Byte6 0;
BA_ "GenSigSendType" SG_ 3221225472 Diagnostics_for_PCTool_REQ_Byte6 2;
BA_ "UsrSigPurpose" SG_ 3221225472 Diagnostics_for_PCTool_REQ_Byte6 6;
BA_ "Version" SG_ 3221225472 Diagnostics_for_PCTool_REQ_Byte7 "18.08.02";
BA_ "NetworkRequestHoldingTime" SG_ 3221225472 Diagnostics_for_PCTool_REQ_Byte7 5000;
BA_ "NetworkRequest" SG_ 3221225472 Diagnostics_for_PCTool_REQ_Byte7 0;
BA_ "UserSigValidity" SG_ 3221225472 Diagnostics_for_PCTool_REQ_Byte7 0;
BA_ "GenSigSendType" SG_ 3221225472 Diagnostics_for_PCTool_REQ_Byte7 2;
BA_ "UsrSigPurpose" SG_ 3221225472 Diagnostics_for_PCTool_REQ_Byte7 6;
BA_ "Version" SG_ 3221225472 Diagnostics_for_PCTool_REQ_Byte1 "18.08.02";
BA_ "NetworkRequestHoldingTime" SG_ 3221225472 Diagnostics_for_PCTool_REQ_Byte1 5000;
BA_ "NetworkRequest" SG_ 3221225472 Diagnostics_for_PCTool_REQ_Byte1 0;
BA_ "UserSigValidity" SG_ 3221225472 Diagnostics_for_PCTool_REQ_Byte1 0;
BA_ "GenSigSendType" SG_ 3221225472 Diagnostics_for_PCTool_REQ_Byte1 2;
BA_ "UsrSigPurpose" SG_ 3221225472 Diagnostics_for_PCTool_REQ_Byte1 6;
BA_ "Version" SG_ 3221225472 GST_RWS_Byte0 "18.01.08";
BA_ "NetworkRequestHoldingTime" SG_ 3221225472 GST_RWS_Byte0 5000;
BA_ "NetworkRequest" SG_ 3221225472 GST_RWS_Byte0 0;
BA_ "UserSigValidity" SG_ 3221225472 GST_RWS_Byte0 0;
BA_ "GenSigSendType" SG_ 3221225472 GST_RWS_Byte0 2;
BA_ "UsrSigPurpose" SG_ 3221225472 GST_RWS_Byte0 2;
BA_ "Version" SG_ 3221225472 GST_RWS_Byte2 "18.01.08";
BA_ "NetworkRequestHoldingTime" SG_ 3221225472 GST_RWS_Byte2 5000;
BA_ "NetworkRequest" SG_ 3221225472 GST_RWS_Byte2 0;
BA_ "UserSigValidity" SG_ 3221225472 GST_RWS_Byte2 0;
BA_ "GenSigSendType" SG_ 3221225472 GST_RWS_Byte2 2;
BA_ "UsrSigPurpose" SG_ 3221225472 GST_RWS_Byte2 2;
BA_ "Version" SG_ 3221225472 GST_RWS_Byte3 "18.01.08";
BA_ "NetworkRequestHoldingTime" SG_ 3221225472 GST_RWS_Byte3 5000;
BA_ "NetworkRequest" SG_ 3221225472 GST_RWS_Byte3 0;
BA_ "UserSigValidity" SG_ 3221225472 GST_RWS_Byte3 0;
BA_ "GenSigSendType" SG_ 3221225472 GST_RWS_Byte3 2;
BA_ "UsrSigPurpose" SG_ 3221225472 GST_RWS_Byte3 2;
BA_ "Version" SG_ 3221225472 GST_RWS_Byte4 "18.01.08";
BA_ "NetworkRequestHoldingTime" SG_ 3221225472 GST_RWS_Byte4 5000;
BA_ "NetworkRequest" SG_ 3221225472 GST_RWS_Byte4 0;
BA_ "UserSigValidity" SG_ 3221225472 GST_RWS_Byte4 0;
BA_ "GenSigSendType" SG_ 3221225472 GST_RWS_Byte4 2;
BA_ "UsrSigPurpose" SG_ 3221225472 GST_RWS_Byte4 2;
BA_ "Version" SG_ 3221225472 GST_RWS_Byte5 "18.01.08";
BA_ "NetworkRequestHoldingTime" SG_ 3221225472 GST_RWS_Byte5 5000;
BA_ "NetworkRequest" SG_ 3221225472 GST_RWS_Byte5 0;
BA_ "UserSigValidity" SG_ 3221225472 GST_RWS_Byte5 0;
BA_ "GenSigSendType" SG_ 3221225472 GST_RWS_Byte5 2;
BA_ "UsrSigPurpose" SG_ 3221225472 GST_RWS_Byte5 2;
BA_ "Version" SG_ 3221225472 GST_RWS_Byte6 "18.01.08";
BA_ "NetworkRequestHoldingTime" SG_ 3221225472 GST_RWS_Byte6 5000;
BA_ "NetworkRequest" SG_ 3221225472 GST_RWS_Byte6 0;
BA_ "UserSigValidity" SG_ 3221225472 GST_RWS_Byte6 0;
BA_ "GenSigSendType" SG_ 3221225472 GST_RWS_Byte6 2;
BA_ "UsrSigPurpose" SG_ 3221225472 GST_RWS_Byte6 2;
BA_ "Version" SG_ 3221225472 GST_RWS_Byte7 "18.01.08";
BA_ "NetworkRequestHoldingTime" SG_ 3221225472 GST_RWS_Byte7 5000;
BA_ "NetworkRequest" SG_ 3221225472 GST_RWS_Byte7 0;
BA_ "UserSigValidity" SG_ 3221225472 GST_RWS_Byte7 0;
BA_ "GenSigSendType" SG_ 3221225472 GST_RWS_Byte7 2;
BA_ "UsrSigPurpose" SG_ 3221225472 GST_RWS_Byte7 2;
BA_ "Version" SG_ 3221225472 GST_RWS_Byte1 "18.01.08";
BA_ "NetworkRequestHoldingTime" SG_ 3221225472 GST_RWS_Byte1 5000;
BA_ "NetworkRequest" SG_ 3221225472 GST_RWS_Byte1 0;
BA_ "UserSigValidity" SG_ 3221225472 GST_RWS_Byte1 0;
BA_ "GenSigSendType" SG_ 3221225472 GST_RWS_Byte1 2;
BA_ "UsrSigPurpose" SG_ 3221225472 GST_RWS_Byte1 2;
BA_ "Version" SG_ 3221225472 ADAS_PRK_Crc2Val "18.11.08";
BA_ "RoutingFactor" SG_ 3221225472 ADAS_PRK_Crc2Val 5;
BA_ "UserSigValidity" SG_ 3221225472 ADAS_PRK_Crc2Val 3;
BA_ "GenSigStartValue" SG_ 3221225472 ADAS_PRK_Crc2Val 65535;
BA_ "Description" SG_ 3221225472 ADAS_PRK_Crc2Val "The data area for CRC calculation is based on the data length (DLC) of the message DB.

The CRC shall be calculated over the entire data block (excluding the CRC bytes) including the user data, alive counter and Data ID

 

- CRC Polynomial (0x1021) , In";
BA_ "Version" SG_ 3221225472 ADAS_PRK_AlvCnt2Val "18.11.08";
BA_ "RoutingFactor" SG_ 3221225472 ADAS_PRK_AlvCnt2Val 5;
BA_ "UserSigValidity" SG_ 3221225472 ADAS_PRK_AlvCnt2Val 3;
BA_ "Description" SG_ 3221225472 ADAS_PRK_AlvCnt2Val "For the first transmission request for a data element the counter shall be initialized with 0 and shall be incremented by 1 for every subsequent send request. 

When the counter reaches the maximum value(0xFF), then it shall restart with 0 for the next s";
BA_ "Version" SG_ 3221225472 PA_ModDis "17.12.03";
BA_ "RoutingFactor" SG_ 3221225472 PA_ModDis 5;
BA_ "UserSigValidity" SG_ 3221225472 PA_ModDis 3;
BA_ "Description" SG_ 3221225472 PA_ModDis "This signal is used for PA/PDW display ON/OFF.

The value is sended to be based on the PA/PDW internal activation status, not the only switch status.

This means that the signal value should be OFF in case of PA/PDW internal activation status OFF, althou";
BA_ "Version" SG_ 3221225472 PA_ModSelSeqDis "17.11.00";
BA_ "RoutingFactor" SG_ 3221225472 PA_ModSelSeqDis 5;
BA_ "UserSigValidity" SG_ 3221225472 PA_ModSelSeqDis 3;
BA_ "Description" SG_ 3221225472 PA_ModSelSeqDis "The signal is used for PA mode selection tap of Cluster.";
BA_ "Version" SG_ 3221225472 PA_HmiStaDis "17.11.00";
BA_ "RoutingFactor" SG_ 3221225472 PA_HmiStaDis 5;
BA_ "UserSigValidity" SG_ 3221225472 PA_HmiStaDis 3;
BA_ "Description" SG_ 3221225472 PA_HmiStaDis "This signal is used for PA HMI indicator (display).";
BA_ "Version" SG_ 3221225472 PA_FrLftWrngDis "17.11.00";
BA_ "RoutingFactor" SG_ 3221225472 PA_FrLftWrngDis 5;
BA_ "UserSigValidity" SG_ 3221225472 PA_FrLftWrngDis 3;
BA_ "Description" SG_ 3221225472 PA_FrLftWrngDis "This signal is used for PA sensors warning indicator(display).";
BA_ "Version" SG_ 3221225472 PA_FrCtrWrngDis "17.12.03";
BA_ "RoutingFactor" SG_ 3221225472 PA_FrCtrWrngDis 5;
BA_ "UserSigValidity" SG_ 3221225472 PA_FrCtrWrngDis 3;
BA_ "Description" SG_ 3221225472 PA_FrCtrWrngDis "This signal is used for PA sensors warning indicator(display).

PA_FrCtrWrngDis signal is to indicate the closest obstacle warning among front inner left & right sensors.";
BA_ "Version" SG_ 3221225472 PA_FrRtWrngDis "17.11.00";
BA_ "RoutingFactor" SG_ 3221225472 PA_FrRtWrngDis 5;
BA_ "UserSigValidity" SG_ 3221225472 PA_FrRtWrngDis 3;
BA_ "Description" SG_ 3221225472 PA_FrRtWrngDis "This signal is used for PA sensors warning indicator(display).";
BA_ "Version" SG_ 3221225472 PA_RrLftWrngDis "17.11.00";
BA_ "RoutingFactor" SG_ 3221225472 PA_RrLftWrngDis 5;
BA_ "UserSigValidity" SG_ 3221225472 PA_RrLftWrngDis 3;
BA_ "Description" SG_ 3221225472 PA_RrLftWrngDis "This signal is used for PA sensors warning indicator(display).";
BA_ "Version" SG_ 3221225472 PA_RrCtrWrngDis "17.12.03";
BA_ "RoutingFactor" SG_ 3221225472 PA_RrCtrWrngDis 5;
BA_ "UserSigValidity" SG_ 3221225472 PA_RrCtrWrngDis 3;
BA_ "Description" SG_ 3221225472 PA_RrCtrWrngDis "This signal is used for PA sensors warning indicator(display).

PA_RrCtrWrngDis signal is to indicate the closest obstacle warning among rear inner left & right sensors.";
BA_ "Version" SG_ 3221225472 PA_RrRtWrngDis "17.11.00";
BA_ "RoutingFactor" SG_ 3221225472 PA_RrRtWrngDis 5;
BA_ "UserSigValidity" SG_ 3221225472 PA_RrRtWrngDis 3;
BA_ "Description" SG_ 3221225472 PA_RrRtWrngDis "This signal is used for PA sensors warning indicator(display).";
BA_ "Version" SG_ 3221225472 PA_BpAlrmReq "18.08.07";
BA_ "RoutingFactor" SG_ 3221225472 PA_BpAlrmReq 5;
BA_ "UserSigValidity" SG_ 3221225472 PA_BpAlrmReq 3;
BA_ "Description" SG_ 3221225472 PA_BpAlrmReq "This signal is used for Beep warning alarm of PA/PDW in AMP Speaker

and PIEZO(SMK) Buzzer";
BA_ "Version" SG_ 3221225472 PA_AlrmVlmLvlReq "17.11.00";
BA_ "RoutingFactor" SG_ 3221225472 PA_AlrmVlmLvlReq 5;
BA_ "UserSigValidity" SG_ 3221225472 PA_AlrmVlmLvlReq 3;
BA_ "Description" SG_ 3221225472 PA_AlrmVlmLvlReq "This signal is used for adjusting PDW Volume";
BA_ "Version" SG_ 3221225472 PA_AlrmVlmDeratingReq "17.11.00";
BA_ "RoutingFactor" SG_ 3221225472 PA_AlrmVlmDeratingReq 5;
BA_ "UserSigValidity" SG_ 3221225472 PA_AlrmVlmDeratingReq 3;
BA_ "Description" SG_ 3221225472 PA_AlrmVlmDeratingReq "This signal indicates function of Audio volume down during PA / PDW Warning Alarm.";
BA_ "Version" SG_ 3221225472 PA_FrWrngAlrmReq "17.11.00";
BA_ "RoutingFactor" SG_ 3221225472 PA_FrWrngAlrmReq 5;
BA_ "UserSigValidity" SG_ 3221225472 PA_FrWrngAlrmReq 3;
BA_ "Description" SG_ 3221225472 PA_FrWrngAlrmReq "This signal is used for front warning alarm of PA/PDW.";
BA_ "Version" SG_ 3221225472 PA_RrWrngAlrmReq "17.11.00";
BA_ "RoutingFactor" SG_ 3221225472 PA_RrWrngAlrmReq 5;
BA_ "UserSigValidity" SG_ 3221225472 PA_RrWrngAlrmReq 3;
BA_ "Description" SG_ 3221225472 PA_RrWrngAlrmReq "This signal is used for rear warning alarm of PA/PDW.";
BA_ "Version" SG_ 3221225472 PA_FrLftWrngAlrmReq "17.11.00";
BA_ "RoutingFactor" SG_ 3221225472 PA_FrLftWrngAlrmReq 5;
BA_ "UserSigValidity" SG_ 3221225472 PA_FrLftWrngAlrmReq 3;
BA_ "Description" SG_ 3221225472 PA_FrLftWrngAlrmReq "This signal is used for front left warning alarm of PA/PDW for EXP AMP";
BA_ "Version" SG_ 3221225472 PA_FrCtrWrngAlrmReq "17.11.00";
BA_ "RoutingFactor" SG_ 3221225472 PA_FrCtrWrngAlrmReq 5;
BA_ "UserSigValidity" SG_ 3221225472 PA_FrCtrWrngAlrmReq 3;
BA_ "Description" SG_ 3221225472 PA_FrCtrWrngAlrmReq "This signal is used for front center warning alarm of PA/PDW for EXP AMP";
VAL_ 3221225472 DATC_OutTempSnsrVal 255 "Error" ;
VAL_ 3221225472 DATC_DfgSw 0 "FRONT DEF switch is not selected" 1 "FRONT DEF switch is selected" 2 "Not Used" 3 "Error Indicator" ;
VAL_ 3221225472 DATC_BattChlrVlv_FltCode 0 "Dafault" 1 "No Error" 2 "Error" 3 "Error Indicator" ;
VAL_ 3221225472 DATC_BattEvapVlvSta 0 "Default" 1 "Valve Off (OPEN)" 2 "Valve On (CLOSE)" 3 "Error Indicator" ;
VAL_ 3221225472 DATC_BattEvapVlv_FltCode 0 "Default" 1 "No Error" 2 "Error" 3 "Error Indicator" ;
VAL_ 3221225472 DATC_BattEwpOpReq 255 "Error Indicator" ;
VAL_ 3221225472 DATC_BlwrLvl 0 "OFF" 1 "0 level" 2 "1 level" 3 "2 level" 4 "3 level" 5 "4 level" 6 "5 level" 7 "6 level" 8 "7 evel" 9 "8 level" 10 "Reserved" 11 "Reserved" 12 "Reserved" 13 "Reserved" 14 "Reserved" 15 "Error Indicator" ;
VAL_ 3221225472 DATC_AAFOpenReq 0 "Default" 1 "1 st" 2 "2 nd" 3 "Open" 4 "Reserved" 5 "Reserved" 6 "Reserved" 7 "Error indicator" ;
VAL_ 3221225472 DATC_ManufacturerTyp 0 "FATC Type 0 (default)" 1 "FATC Type 1 (Doowon)" 2 "FATC Type 2 (Hanon)/0X3:FATC Type 3(DENSO)" 4 "Not used" 5 "Not used" 6 "Not used" 7 "Error Indicator" ;
VAL_ 3221225472 DATC_AcnCompTyp 0 "Internal Compressor" 1 "External Compressor with Comp clutch" 2 "External Compressor without Comp clutch" 3 "Fixed Compressor" 4 "electrical Compressor" 6 "Not used" 7 "Error Indicator" ;
VAL_ 3221225472 DATC_AcnReq 0 "A/C Non-Request" 1 "A/C Request" 2 "Not used" 3 "Error Indicator" ;
VAL_ 3221225472 DATC_BlwSta 0 "Blower Off" 1 "Blower On" 2 "Not used" 3 "Error Indicator" ;
VAL_ 3221225472 DATC_BlwMaxSta 0 "NOT Max blower speed" 1 "Max blower speed" 2 "Not used" 3 "Error Indicator" ;
VAL_ 3221225472 DATC_SrvLmpReq 0 "Off" 1 "Service Lamp On" 2 "Not used" 3 "Error Indicator" ;
VAL_ 3221225472 DATC_AcnECompOpSta 0 "E-Compressor Not-Operation" 1 "E-Compressor Operation" 2 "Not used" 3 "Error Indicator" ;
VAL_ 3221225472 DATC_AcnCompFltSta 0 "A/C E-Compressor Normal" 1 "A/C E-Compressor Fail" 2 "Not used" 3 "Error Indicator" ;
VAL_ 3221225472 DATC_RrDfgOpSta 0 "Rear Defog Off" 1 "Rear Defog On" 2 "Not used" 3 "Error Indicator" ;
VAL_ 3221225472 DATC_HVCompIntlkSta 0 "Disconnect" 1 "Connect" 2 "Not used" 3 "Error Indicator" ;
VAL_ 3221225472 DATC_HVIntDischrgLkReq 0 "Not Request" 1 "Request" 2 "Not used" 3 "Error Indicator" ;
VAL_ 3221225472 DATC_AcnECompMaxReqPwrVal 1023 "Error Indicator" ;
VAL_ 3221225472 DATC_AcnECompCnsmptPwrVal 1023 "Error Indicator" ;
VAL_ 3221225472 DATC_MainRlyOffReq 0 "Non-Request" 1 "Request" 2 "Not used" 3 "Error Indicator" ;
VAL_ 3221225472 Lamp_HiPrioHzrdReq 0 "Off" 1 "High On" 2 "High Inactive" 3 "Reserved" 4 "Reserved" 5 "Reseved" 6 "Not Used" 7 "Error Indicator" ;
VAL_ 3221225472 Lamp_LoPrioHzrdReq 0 "Off" 1 "Low On" 2 "Low Inactive" 3 "Reserved" 4 "Reserved" 5 "Reseved" 6 "Not Used" 7 "Error Indicator" ;
VAL_ 3221225472 Lamp_DedicatedDrlOnReq 0 "Off" 1 "On" 2 "Not Used" 3 "Error Indicator" ;
VAL_ 3221225472 Lamp_IntTailLmpOnReq 0 "Off" 1 "On" 2 "Not Used" 3 "Error Indicator" ;
VAL_ 3221225472 Lamp_ExtrnlTailLmpOnReq 0 "Off" 1 "On" 2 "Not Used" 3 "Error Indicator" ;
VAL_ 3221225472 Lamp_HdLmpLoOnReq 0 "Off" 1 "On" 2 "Not Used" 3 "Error Indicator" ;
VAL_ 3221225472 Lamp_HdLmpHiOnReq 0 "Off" 1 "On" 2 "Not Used" 3 "Error Indicator" ;
VAL_ 3221225472 Lamp_AvTailLmpSta 0 "Off" 1 "On" 2 "Not Used" 3 "Error Indicator" ;
VAL_ 3221225472 Lamp_AutoLtSnsrNightSta 0 "Off" 1 "Night" 2 "Not Used" 3 "Error Indicator" ;
VAL_ 3221225472 FR_RDR_FCAEquipSta 0 "Not Applied" 1 "Applied" 2 "Not used" 3 "Error Indicator" ;
VAL_ 3221225472 FR_RDR_FCA_Plus_Sta 0 "FCA-Car Ÿ�� ������" 1 "FCA-Car Ÿ�� ���� �� ����, �������� ȸ�ǺҰ�" 2 "FCA-Car Ÿ�� ���� �� ���� ���� ȸ�� �Ұ�" 3 "FCA-Car Ÿ�� ���� �� ���� ���� ȸ�� �Ұ�" 4 "FCA-Car Ÿ�� ����" 5 "Not Used" 6 "Not Used" 7 "Error Indicator" ;
VAL_ 3221225472 FR_RDR_SCCEquipSta 0 "Not Applied" 1 "Applied" 2 "Not used" 3 "Error Indicator" ;
VAL_ 3221225472 FR_RDR_FailInfoSta 0 "Normal" 1 "Unit failure" 2 "Alignment failure" 3 "Blockage, Temperature" 4 "Coding failure" 5 "Reserved" 6 "Reserved" 7 "Error indicator" ;
VAL_ 3221225472 FR_RDR_CodingSta 0 "Coded" 1 "Not coded" 2 "Reserved" 3 "Error indicator" ;
VAL_ 3221225472 FR_RDR_ACANMonSta 0 "Normal" 1 "A-CANFD Bus-off" 2 "A-CANFD Timeout" 3 "Error indicator" ;
VAL_ 3221225472 FR_RDR_HDAEquipSta 0 "Not Applied" 1 "Applied" 2 "Not used" 3 "Error Indicator" ;
VAL_ 3221225472 Autocut_DlvryModSta 0 "Before Delivery(Welcome Off)" 1 "After Delivery(Welcome On)" 2 "Not Used" 3 "Error Indicator" ;
VAL_ 3221225472 DoorLock_AsstDrUnLkSta 0 "Lock" 1 "Unlock" 2 "Not Used" 3 "Error Indicator" ;
VAL_ 3221225472 Warn_DrvDrSwSta 0 "Close" 1 "Open" 2 "Not Used" 3 "Error Indicator" ;
VAL_ 3221225472 DoorLock_RrLftDrUnLkSta 0 "Lock" 1 "Unlock" 2 "Not Used" 3 "Error Indicator" ;
VAL_ 3221225472 DoorLock_RrRtDrUnLkSta 0 "Lock" 1 "Unlock" 2 "Not Used" 3 "Error Indicator" ;
VAL_ 3221225472 ICU_GearPosRConfirmSta 0 "Off" 1 "On" 2 "Reserved" 3 "Invalid" ;
VAL_ 3221225472 Warn_AsstDrSwSta 0 "Close" 1 "Open" 2 "Not Used" 3 "Error Indicator" ;
VAL_ 3221225472 Warn_AsstStBltSwSta 0 "Unbelted" 1 "Belted" 2 "Not Used" 3 "Error Indicator" ;
VAL_ 3221225472 Warn_BrkFldSwSta 0 "Off" 1 "On" 2 "Not Used" 3 "Error Indicator" ;
VAL_ 3221225472 Warn_DrvStBltSwSta 0 "Unbelted" 1 "Belted" 2 "Not Used" 3 "Error Indicator" ;
VAL_ 3221225472 Warn_HoodSwSta 0 "Off" 1 "On" 2 "Not Used" 3 "Error Indicator" ;
VAL_ 3221225472 Warn_PassStOccSta 0 "Off (UnSeated)" 1 "On (Seated)" 2 "Not Used" 3 "Error Indicator" ;
VAL_ 3221225472 Warn_RrCtrStBltSwSta 0 "Unbelted" 1 "Belted" 2 "Not Used" 3 "Error Indicator" ;
VAL_ 3221225472 Warn_RrLftDrSwSta 0 "Close" 1 "Open" 2 "Not Used" 3 "Error Indicator" ;
VAL_ 3221225472 Warn_RrLftStBltSwSta 0 "Unbelted" 1 "Belted" 2 "Not Used" 3 "Error Indicator" ;
VAL_ 3221225472 Warn_RrRtDrSwSta 0 "Close" 1 "Open" 2 "Not Used" 3 "Error Indicator" ;
VAL_ 3221225472 Warn_RrRtStBltSwSta 0 "Unbelted" 1 "Belted" 2 "Not Used" 3 "Error Indicator" ;
VAL_ 3221225472 Warn_HoodSwMemorySta 0 "No event" 1 "hood_open_close" 2 "reserved" 3 "reserved" ;
VAL_ 3221225472 Warn_WshrFldSwSta 0 "Off" 1 "On" ;
VAL_ 3221225472 ICU_Haptic_OPT 0 "Default" 1 "No option(None Haptic Option)" 2 "Option" 3 "Invalid" ;
VAL_ 3221225472 ICU_BS2_FSOC 0 "valid" 1 "invalid" ;
VAL_ 3221225472 ICU_BS2_FSOH 0 "valid" 1 "invalid" ;
VAL_ 3221225472 ICU_BS2_FSOF 0 "valid" 1 "invalid" ;
VAL_ 3221225472 ICU_BS2_FQSTAT 0 "valid" 1 "invalid" ;
VAL_ 3221225472 ExtLamp_TrnSigLmpLftBlnkngSta 0 "Off" 1 "On" 2 "Not Used" 3 "Error Indicator" ;
VAL_ 3221225472 ExtLamp_TrnSigLmpRtBlnkngSta 0 "Off" 1 "On" 2 "Not Used" 3 "Error Indicator" ;
VAL_ 3221225472 ExtLamp_ExtrnlTailLmpSta 0 "Off" 1 "On" 2 "Not Used" 3 "Error Indicator" ;
VAL_ 3221225472 ExtLamp_HzrdSwSta 0 "Off" 1 "On" 2 "Not Used" 3 "Error Indicator" ;
VAL_ 3221225472 ExtLamp_RrFgLmpSta 0 "Off" 1 "On" 2 "Not Used" 3 "Error Indicator" ;
VAL_ 3221225472 IntLamp_InlTailLmpSta 0 "Off" 1 "On" 2 "Not Used" 3 "Error Indicator" ;
VAL_ 3221225472 Lamp_TrnSigLmpLftOnReq 0 "Inactive" 1 "Active Off(Flasher Off)" 2 "Active On(Flasher On)" 3 "reserved" ;
VAL_ 3221225472 Lamp_TrnSigLmpRtOnReq 0 "Inactive" 1 "Active Off(Flasher Off)" 2 "Active On(Flasher On)" 3 "reserved" ;
VAL_ 3221225472 Trunk_TrnkInReleaseSwSta 0 "Off" 1 "On" 2 "Not Used" 3 "Error Indicator" ;
VAL_ 3221225472 Trunk_TrnkTlgtOutReleaseSwSta 0 "Off" 1 "On" 2 "Not Used" 3 "Error Indicator" ;
VAL_ 3221225472 Trunk_TrnkTlgtSwSta 0 "Close(Full Lock)" 1 "Open(Not Full Lock)" 2 "Not Used" 3 "Error Indicator" ;
VAL_ 3221225472 Trunk_GlvBxTrnkLkSwSta 0 "Off" 1 "On" 2 "Not Used" 3 "Error Indicator" ;
VAL_ 3221225472 Trunk_OpnDiagSetSta 0 "OFF" 1 "ON" 2 "Not Used" 3 "Error Indicator" ;
VAL_ 3221225472 USM_OneTouchTrnSigFuncSta 0 "Default" 1 "One Touch Turn Off" 2 "3 Flashing" 3 "5 Flashing" 4 "7 Flashing" 5 "Invalid" ;
VAL_ 3221225472 DoorLock_DrvDrUnLkSta 0 "Lock" 1 "Unlock" 2 "Not Used" 3 "Error Indicator" ;
VAL_ 3221225472 DoorLock_LkOutSta 0 "Off" 1 "On" 2 "Not Used" 3 "Error Indicator" ;
VAL_ 3221225472 TwoTrnUnLkOptTyp 0 "Off" 1 "On" 2 "Not Used" 3 "Error Indicator" ;
VAL_ 3221225472 Defog_DfgrRlySta 0 "Off" 1 "On" 2 "Not Used" 3 "Error Indicator" ;
VAL_ 3221225472 C_CrashUnlockState 0 "Off" 1 "Unlock(Crash)" ;
VAL_ 3221225472 CF_Gway_ADrLOptInfo 0 "Non-SMK & AT" 1 "Non-SMK & MT" 2 "SMK & AT" 3 "SMK & MT" 4 "Not used" 5 "Not used" 6 "Not used" 7 "Invalid" ;
VAL_ 3221225472 ICU_ADASHapticAutoOnSetReq 0 "Default" 1 "Active" 2 "Inactive" 3 "Reserved" ;
VAL_ 3221225472 SEA_ActvSta 0 "InActivated" 1 "Activated" 2 "Not Used" 3 "Error Indicator" ;
VAL_ 3221225472 ChildLock_ActnFlSta 0 "OK" 1 "Failed" 2 "Not Used" 3 "Error Indicator" ;
VAL_ 3221225472 USM_AutoDrLkReq 0 "Default" 1 "Off" 2 "Vehicle Speed On(15km)" 3 "Shift Lever On" 4 "Invalid" ;
VAL_ 3221225472 USM_AutoDrUnLkReq 0 "Default" 1 "Off" 2 "Key Out On (AllDoors)" 3 "Shift Lever On (AllDoors)" 4 "Override" 5 "Invalid" 6 "Key Out On (Driver Door)" 7 "Shift Lever On (Driver Door)" ;
VAL_ 3221225472 USM_HapticCurrentSta 0 "Default" 1 "Haptic Active" 2 "Haptic Inactive" 3 "Invalid" ;
VAL_ 3221225472 USM_TwoTrnUnLkCurrentSta 0 "Default" 1 "Ttunlock Off" 2 "Ttunlock On" 3 "Invalid" ;
VAL_ 3221225472 OBCWakeupDrUnlock 0 "Default" 1 "Off" 2 "On(Unlock)" 3 "Error Indicator" ;
VAL_ 3221225472 OBCWakeupDrLock 0 "Default" 1 "Off" 2 "On(DrLock)" 3 "Error Indicator" ;
VAL_ 3221225472 Lamp_RrTrnSigLmpLftOpnSta 0 "Normal" 1 "Open Status" 2 "Not Used" 3 "Error Indicator" ;
VAL_ 3221225472 Lamp_RrTrnSigLmpRtOpnSta 0 "Normal" 1 "Open Status" 2 "Not Used" 3 "Error Indicator" ;
VAL_ 3221225472 Lamp_FrTrnSigLmpLftOpnSta 0 "Normal" 1 "Open Status" 2 "Not Used" 3 "Error Indicator" ;
VAL_ 3221225472 Lamp_FrTrnSigLmpRtOpnSta 0 "Normal" 1 "Open Status" 2 "Not Used" 3 "Error Indicator" ;
VAL_ 3221225472 ESC_FCA_ActvSta 0 "FCA Brake is not in activation" 1 "FCA Pre-Brake" 2 "FCA Full-Brake" 3 "Invalid" ;
VAL_ 3221225472 ESC_DBS_ActvSta 0 "DBS control is inactive" 1 "DBS control is active" 2 "Not used" 3 "Not used" ;
VAL_ 3221225472 ESC_RccaSta 0 "RCCA availble" 1 "RCCA brake started" 2 "RCCA braking is ended" 3 "RCCA braking error" ;
VAL_ 3221225472 ESC_PcaSta 0 "PCA available" 1 "PCA brake started" 2 "PCA brake ended" 3 "PCA disable" ;
VAL_ 3221225472 ESC_DiffBrkFuncSta 0 "Differential braking available without error" 1 "Differential braking disable" 2 "Differential braking is activated" 3 "Error Indicator" ;
VAL_ 3221225472 ESC_BcaRPlusSta 0 "BCA-R+ available" 1 "BCA-R+ braking is started" 2 "BCA-R+ braking is ended" 3 "BCA-R+ braking error" ;
VAL_ 3221225472 ESC_RspaSta 0 "Not used" 1 "ESC Initial" 2 "ESC New Start" 3 "ESC Ready" 4 "Not used" 5 "ESC Assist" 6 "ESC Assist Fail" 7 "ESC Abort" 8 "ESC Ready Fail" ;
VAL_ 3221225472 ESC_RspaCanFlFlag 0 "ESC received RSPA CAN message successfully" 1 "ESC failed to receive RSPA CAN message successfully" 2 "Not used" 3 "Error Indicator" ;
VAL_ 3221225472 ESC_RspaDclActv 0 "Inactive" 1 "Active" 2 "Not used" 3 "Error Indicator" ;
VAL_ 3221225472 ESC_RspaStandStill 0 "Initial" 1 "ESC stopped the vehicle by RSPA request" 2 "Not used" 3 "Error Indicator" ;
VAL_ 3221225472 MCB_ReqBrkAck 0 "Wait Status for Crash" 1 "Received ACU Crash Information" 2 "Not used" 3 "Not used" ;
VAL_ 3221225472 MCB_CtlSta 0 "Not Activation" 1 "Activation" ;
VAL_ 3221225472 MCB_DefSta 0 "Normal state" 1 "Fail" ;
VAL_ 3221225472 ESC_LsdLimMod 0 "Maximum limitation mode" 1 "Minimum limitation mode" ;
VAL_ 3221225472 ESC_LsdOpn 0 "Passive" 1 "Fast Open" 2 "Slow Open" 3 "Torque Limit" 4 "Reserved" 5 "Reserved" 6 "Reserved" 7 "Error" ;
VAL_ 3221225472 ESC_VehAccelVal 2047 "Error" ;
VAL_ 3221225472 ESC_AccelBasisVal 2047 "Error" ;
VAL_ 3221225472 SCC_OptTyp 0 "SCC is not equipped" 1 "SCC is equipped" 2 "Not used" 3 "Not Coded" ;
VAL_ 3221225472 SCC_EnblReq 0 "SCC enabled" 1 "SCC disabled reversible" 2 "SCC disabled irreversible" 3 "SCC disabled irreversible due to communication error" ;
VAL_ 3221225472 SCC_TqReq 0 "No request" 1 "Enable SCC torque request" 2 "Not used" 3 "Error Indicator" ;
VAL_ 3221225472 SCC_ReqLimSta 0 "No request" 1 "Limited No Limitation" 2 "Acceleration Limited" 3 "Deceleration Limited" ;
VAL_ 3221225472 ESC_StdStillVal 0 "No stand still detected" 1 "stand still detected" 2 "Not used" 3 "Error Indicator" ;
VAL_ 3221225472 ESC_BrkLtReq 0 "No request" 1 "Activate brake lights" 2 "Not used" 3 "Error Indicator" ;
VAL_ 3221225472 ESC_DclEnblReq 0 "Disable deceleration control" 1 "Enable deceleration control" 2 "Not used" 3 "Error Indicator" ;
VAL_ 3221225472 ESC_DrvOvrdSta 0 "No override" 1 "Override by acceleration pedal" 2 "Override by deceleration" 3 "Error Indicator" ;
VAL_ 3221225472 ESC_DrvBrkSta 0 "Driver is not braking / failure" 1 "Driver is braking" 2 "Not used" 3 "Error Indicator" ;
VAL_ 3221225472 ESC_DrvBrkActvSta 0 "Brake pedal not pressed" 1 "Brake pedal pressed" 2 "Not used" 3 "Error Indicator" ;
VAL_ 3221225472 ESC_PrkBrkActvSta 0 "Parking brake is not activated" 1 "Parking brake is activated" 2 "Not used" 3 "Error Indicator" ;
VAL_ 3221225472 FCA_EquipSta 0 "FCA is not equipped" 1 "FCA is equipped" 2 "Not used" 3 "Not Coded" ;
VAL_ 3221225472 FCA_AvlblSta 0 "Available" 1 "Temporarily not available" 2 "Permanently not available" 3 "FCA Communication Error" ;
VAL_ 3221225472 PCA_SysSta 0 "Default" 1 "PCW off, PCA off" 2 "PCW on, PCA off" 3 "PCW on, PCA on" 4 "Reserved" 5 "Reserved" 6 "Reserved" 7 "Invalid" ;
VAL_ 3221225472 PCA_EquipSta 0 "Normal" 1 "Unavailable by ESC" 2 "Unavailable by Camera" 3 "Unavailable by Ultrasonic" 4 "Unavailable by PCA-R" 5 "Reserved" 6 "Reserved" 7 "Invalid" ;
VAL_ 3221225472 PCA_WrngLvlSta 0 "Normal" 1 "Ready" 2 "Warning" 3 "Assist" 4 "Assist Ended" 5 "Reserved" 6 "Reserved" 7 "Invalid" ;
VAL_ 3221225472 PCA_WrngSndCtrSta 0 "Normal" 1 "Warning" 2 "Reserved" 3 "Invalid" ;
VAL_ 3221225472 PCA_WrngSndLftSta 0 "Normal" 1 "Warning" 2 "Reserved" 3 "Invalid" ;
VAL_ 3221225472 PCA_WrngSndRtSta 0 "Normal" 1 "Warning" 2 "Reserved" 3 "Invalid" ;
VAL_ 3221225472 PCA_BrkReq 0 "PCA Brake off" 1 "PCA Brake on" 2 "PCA Brake on (hold)" 3 "Error indicator" ;
VAL_ 3221225472 PCA_EpbReq 0 "Apply EPB" 1 "Stand by" 2 "Reserved" 3 "Invalid" ;
VAL_ 3221225472 PCA_DgrSta 0 "Default" 1 "Late" 2 "Normal" 3 "Reserved" 4 "Reserved" 5 "Reserved" 6 "Reserved" 7 "Invalid" ;
VAL_ 3221225472 ADAS_PRK_PDW_SwIndOnReq 0 "Indicator Off" 1 "Indicator On" 2 "Not Used" 3 "Error Indicator" ;
VAL_ 3221225472 ADAS_PRK_PDW_OptTyp 0 "None" 1 "PDW-R" 2 "PDW-FR" 3 "Reserved" 4 "Reserved" 5 "Reserved" 6 "Not Used" 7 "Error Indicator" ;
VAL_ 3221225472 ADAS_PRK_PDW_AutoOn_USM 0 "Default" 1 "Function Off" 2 "Function On" 3 "Invalid" ;
VAL_ 3221225472 TCS_GearShftCharacteristicVal 0 "passive (gear change allowed)" 1 "active (gear change not allowed)" 2 "Not used" 3 "Error Indicator" ;
VAL_ 3221225472 TCS_ManufacturerVal 0 "Using both TQI_TCS and TQI_SLW_TCS" 1 "Using TQI_TCS only (Not using TQI_SLW_TCS)" 2 "Not used" 3 "Error Indicator" ;
VAL_ 3221225472 ESC_CylPrsrVal 4095 "Error" ;
VAL_ 3221225472 ESC_CylPrsrSta 0 "Master cylinder pressure signal is invalid" 1 "Master cylinder pressure signal is valid" 2 "Not used" 3 "Error Indicator" ;
VAL_ 3221225472 ESC_CylPrsrDiagSta 0 "Master cylinder pressure is not available temporarily" 1 "Master cylinder pressure signal is available" 2 "Not used" 3 "Error Indicator" ;
VAL_ 3221225472 ESC_CylPrsrFlagSta 0 "Off" 1 "On" 2 "Not used" 3 "Error Indicator" ;
VAL_ 3221225472 ESC_VsmActvSta 0 "VSM control inactive" 1 "VSM control active" 2 "Not used" 3 "Error Indicator" ;
VAL_ 3221225472 ESC_VsmDfctvSta 0 "VSM is not defective" 1 "VSM is defective" 2 "Not used" 3 "Error Indicator" ;
VAL_ 3221225472 ESC_VsmCtrlModSta 0 "Inactive" 1 "Mode 1 (sensor value overlay mode)" 2 "Mode 2 (output torque overlay mode)" 3 "Mode 3 (Particular control)" ;
VAL_ 3221225472 ESC_StrTqReq 4095 "Error" ;
VAL_ 3221225472 ESC_IMURstStaAck 0 "No reset flag received" 1 "Reset flag has been received" ;
VAL_ 3221225472 AVH_Sta 0 "No apply" 1 "Vehicle is held by the service brake" 2 "Being released" 3 "Error Indicator" ;
VAL_ 3221225472 LDM_Sta 0 "ESC ready to DBF/AVH (requested by switch)" 1 "ESC can��t perform DBF/AVH (requested by switch)" 2 "Not used" 3 "Error Indicator" ;
VAL_ 3221225472 EPB_ActvReq 0 "No request" 1 "Release request" 2 "Close request in comfort mode" 3 "Close request in secure mode" ;
VAL_ 3221225472 EPB_StaReq 0 "REQ_EPB_ACT signal is invalid" 1 "REQ_EPB_ACT signal is valid" 2 "Not used" 3 "Error Indicator" ;
VAL_ 3221225472 ECD_ActvSta 0 "ECD is not active" 1 "ECD is active(operating)" 2 "Not used" 3 "Error Indicator" ;
VAL_ 3221225472 AVH_CluDis 0 "AVH is off" 1 "AUTO HOLD to be deactivated Press Brake Pedal" 2 "Press Brake Pedal to Release AUTO HOLD" 3 "AUTO HOLD cannot be activated Close Door, Hood, Trunk" 4 "AUTO HOLD cannot be deactivated, Close Door" ;
VAL_ 3221225472 AVH_AlrmReq 0 "No alarm" 1 "On AVH Activation, Vehicle is not secured and driver is still inside = comfortable tone" 2 "Not used" 3 "Error Indicator" ;
VAL_ 3221225472 AVH_ActvStaLmpDis 0 "Lamp On" 1 "Lamp Off" 2 "Not used" 3 "Error Indicator" ;
VAL_ 3221225472 AVH_LmpDis 0 "AVH Off (Lamp Status" 1 "AVH failure (Lamp Status" 2 "AVH ACTIVE (Lamp Status" 3 "AVH READY (Lamp Status" 4 "Lamp Status" 5 "Lamp Status" 6 "Lamp Status" ;
VAL_ 3221225472 AWD_CrdnShftTqLimVal 65535 "Error" ;
VAL_ 3221225472 AWD_CltchDtyLimVal 255 "Error" ;
VAL_ 3221225472 AWD_TransmsnTqLimModSta 0 "Maximum limitation mode" 1 "Minimum limitation mode" 2 "Not used" 3 "Error Indicator" ;
VAL_ 3221225472 AWD_RrWhlDtyLimReq 0 "No request from ESC" 1 "Request duty limit from ESC" 2 "Not used" 3 "Error Indicator" ;
VAL_ 3221225472 AWD_FastOpnCrdnShftCltchReq 0 "Passive" 1 "Clutch off" 2 "Torque limit" 3 "Error" ;
VAL_ 3221225472 TCS_LmpSta 0 "TCS/ESC Function/Warning Lamp OFF" 1 "TCS/ESC Function/Warning Lamp ON" 2 "TCS/ESC Function/Warning Lamp BLINKING(2Hz)" 3 "Error Indicator" ;
VAL_ 3221225472 TCS_OffLmpSta 0 "TCS/ESC OFF SW Lamp OFF" 1 "TCS/ESC OFF SW Lamp ON" 2 "Not used" 3 "Error Indicator" ;
VAL_ 3221225472 ESC_OffTempSta 0 "Normal Mode" 1 "Sports Mode" 2 "Off Mode" 3 "ESC OFF SW is defective (failed)" ;
VAL_ 3221225472 DBC_WrngLmpSta 0 "DBC Warning lamp OFF" 1 "DBC Warning lamp ON" 2 "Not used" 3 "Error Indicator" ;
VAL_ 3221225472 DBC_FuncLmpSta 0 "DBC Function lamp OFF" 1 "DBC Function lamp ON" 2 "DBC Function lamp BLINKING(2Hz)" 3 "Error Indicator" ;
VAL_ 3221225472 DBC_ClusterDis 0 "DBC Enabled" 1 "DBC Disabled by system fault" 2 "Reserved" 3 "Reserved" ;
VAL_ 3221225472 ESC_BrkCtrlSta 0 "Brake control is not in activation" 1 "Brake control is in activation" 2 "Not used" 3 "Error Indicator" ;
VAL_ 3221225472 TCS_Sta 0 "Not Applied" 1 "Off" 2 "Ready" 3 "Activated" 4 "Reserved" 5 "Reserved" 6 "Reserved" 7 "Reserved" 8 "Reserved" 9 "Reserved" 10 "Reserved" 11 "Reserved" 12 "Reserved" 13 "Reserved" 14 "Not Coded" 15 "Defective" ;
VAL_ 3221225472 ESC_Sta 0 "Not Applied" 1 "Off" 2 "Ready" 3 "Activated" 4 "Reserved" 5 "Reserved" 6 "Reserved" 7 "Reserved" 8 "Reserved" 9 "Reserved" 10 "Reserved" 11 "Reserved" 12 "Reserved" 13 "Reserved" 14 "Not Coded" 15 "Defective" ;
VAL_ 3221225472 TCS_PreActvSta 0 "-" 1 "Pre TCS Active" 2 "Not used" 3 "Error Indicator" ;
VAL_ 3221225472 DBC_Sta 0 "Not Applied" 1 "Off" 2 "Ready" 3 "Activated" 4 "Reserved" 5 "Reserved" 6 "Reserved" 7 "Reserved" 8 "Reserved" 9 "Reserved" 10 "Reserved" 11 "Reserved" 12 "Reserved" 13 "Reserved" 14 "Not Coded" 15 "Defective" ;
VAL_ 3221225472 TCS_TqFlag 0 "Positive" 1 "Negative" ;
VAL_ 3221225472 MSR_TqFlag 0 "Positive" 1 "Negative" ;
VAL_ 3221225472 HAC_Sta 0 "Not Applied" 1 "Off" 2 "Ready" 3 "Activated" 4 "Reserved" 5 "Reserved" 6 "Reserved" 7 "Reserved" 8 "Reserved" 9 "Reserved" 10 "Reserved" 11 "Reserved" 12 "Reserved" 13 "Reserved" 14 "Not Coded" 15 "Defective" ;
VAL_ 3221225472 TCS_SlwTqFlag 0 "Positive" 1 "Negative" ;
VAL_ 3221225472 TCS_Req 0 "Passive" 1 "TCS/ESC control active" 2 "Not used" 3 "Error Indicator" ;
VAL_ 3221225472 MSR_FuncReq 0 "Passive or TCS function" 1 "MSR control active" 2 "Not used" 3 "Error Indicator" ;
VAL_ 3221225472 Wiper_PrkngPosSta 0 "else" 1 "Parking Position" 2 "Not Used" 3 "Error Indicator" ;
VAL_ 3221225472 Wiper_RainSnsrOptionTyp 0 "Non Rain Sensor Option" 1 "Rain Sensor Option" 2 "Not Used" 3 "Error Indicator" ;
VAL_ 3221225472 Wiper_RainSnsrSta 0 "OFF" 1 "Rain Detected" 2 "Low" 3 "High" 4 "Fault 1" 5 "Fault 2" 6 "Fault 3" 7 "Reserved" 8 "Reserved" 9 "Reserved" 10 "Reserved" 11 "Reserved" 12 "Reserved" 13 "Reserved" 14 "Not Used" 15 "Error Indicator" ;
VAL_ 3221225472 BCM_GearPosPSta 0 "Off" 1 "P" 2 "Not Used" 3 "Error Indicator" ;
VAL_ 3221225472 BCM_SunRoofOpnSta 0 "Close" 1 "Open" 2 "Not Used" 3 "Error Indicator" ;
VAL_ 3221225472 PA_ModDis 0 "No display" 1 "PDW display" 2 "PA display" 3 "PDW & PA display" 4 "Reserved" 5 "Reserved" 6 "Not used" 7 "Error Indicator" ;
VAL_ 3221225472 PA_ModSelSeqDis 0 "Default" 1 "Domestic" 2 "EU LHD" 3 "EU RHD" 4 "Reserved" 5 "Reserved" 6 "Not used" 7 "Error Indicator" ;
VAL_ 3221225472 PA_HmiStaDis 0 "No Display" 1 "Parking mode selection - right perpendicular" 2 "Parking mode selection - left perpendicular" 3 "Parking mode selection - right parallel" 4 "Parking mode selection - left parallel" 5 "Parking mode selection - OFF" 6 "Requesting go forward for detecting parking space" 7 "Detecting parking space - right perpendicular" 8 "Detecting parking space - left perpendicular" 9 "Detecting parking space - right parallel" 10 "Detecting parking space - left parallel" 13 "Requesting stop of vehicle in perpendicular parking" 14 "Requesting Steering Wheel to left side in right perpendicular parking" 15 "Requesting Steering Wheel to right side in left perpendicular parking" 17 "Finishing parking space - right perpendicular" 18 "Finishing parking space - left perpendicular" 19 "Finishing parking space - right parallel" 20 "Finishing parking space - left parallel" 23 "Automatic steering activation" 25 "Requesting gear shift to forward during automatic steering activation" 26 "Requesting gear shift to backward during automatic steering activation" 28 "Finishing automatic steering activation" 30 "System auto-canceled" 31 "System failed" 32 "Over speed of vehicle" 33 "Requesting EPB AUTO-HOLD OFF" 34 "System deactivation by TRAILER MODE" 35 "System deactivation by TCS OFF" 37 "Parking out mode selection - OFF" 38 "Parking out mode selection - left" 39 "Parking out mode selection - right" 40 "Detecting parking out space - left" 41 "Detecting parking out space - right" 42 "Requesting gear shift to backward in parking out mode after detecting parking out space" 44 "Automatic steering activation for parking out" 46 "Requesting gear shift to forward in parking out mode" 47 "Requesting gear shift to backward in parking out mode" 49 "Finishing automatic steering activation for parking out" 50 "System auto-canceled in parking out mode" 51 "Informing parking space - right perpendicular" 52 "Informing parking space - left perpendicular" 53 "Informing parking space - right parallel" 54 "Informing parking space - left parallel" 62 "Not used" 63 "Error Indicator" ;
VAL_ 3221225472 PA_FrLftWrngDis 0 "OFF (No warning)" 1 "1��st warning level" 2 "2��nd warning level" 3 "3��nd warning level (the closest status with obstacle)" 4 "Reserved" 5 "Reserved" 6 "Not used" 7 "Error Indicator" ;
VAL_ 3221225472 PA_FrCtrWrngDis 0 "OFF (No warning)" 1 "1��st warning level" 2 "2��nd warning level" 3 "3��nd warning level (the closest status with obstacle)" 4 "Reserved" 5 "Reserved" 6 "Not used" 7 "Error Indicator" ;
VAL_ 3221225472 PA_FrRtWrngDis 0 "OFF (No warning)" 1 "1��st warning level" 2 "2��nd warning level" 3 "3��nd warning level (the closest status with obstacle)" 4 "Reserved" 5 "Reserved" 6 "Not used" 7 "Error Indicator" ;
VAL_ 3221225472 PA_RrLftWrngDis 0 "OFF (No warning)" 1 "1��st warning level" 2 "2��nd warning level" 3 "3��nd warning level (the closest status with obstacle)" 4 "Reserved" 5 "Reserved" 6 "Not used" 7 "Error Indicator" ;
VAL_ 3221225472 PA_RrCtrWrngDis 0 "OFF (No warning)" 1 "1��st warning level" 2 "2��nd warning level" 3 "3��nd warning level (the closest status with obstacle)" 4 "Reserved" 5 "Reserved" 6 "Not used" 7 "Error Indicator" ;
VAL_ 3221225472 PA_RrRtWrngDis 0 "OFF (No warning)" 1 "1��st warning level" 2 "2��nd warning level" 3 "3��nd warning level (the closest status with obstacle)" 4 "Reserved" 5 "Reserved" 6 "Not used" 7 "Error Indicator" ;
VAL_ 3221225472 PA_BpAlrmReq 0 "No warning alarm" 1 "PA or PDW Failure State warning alarm" 30 "Not used" 31 "Error Indicator" 3 "Change to TGS ��R�� warning alarm" 4 "PA parking complete warning alarm" 7 "��Stop�� message during PA function warning alarm" 8 "��Scan complete�� message warning" 9 "��System abort�� message during PA driving warning alarm" 10 "��Gear Shift to Backward�� warning alarm" 11 "��Gear Shift to Forward�� warning alarm" 12 "PA parking out complete warning alarm" 14 "SMK Sound request" ;
VAL_ 3221225472 PA_AlrmVlmLvlReq 0 "Default" 1 "Level 1" 2 "Level 2" 3 "Level 3" 4 "Reserved" 5 "Reserved" 6 "Not used" 7 "Error Indicator" ;
VAL_ 3221225472 PA_AlrmVlmDeratingReq 0 "OFF (deactivation of warning alarm)" 1 "ON (activation of warning alarm)" 2 "Not used" 3 "Error Indicator" ;
VAL_ 3221225472 PA_FrWrngAlrmReq 0 "OFF(No warning alarm)" 1 "��st warning alarm level" 2 "2��nd warning alarm level" 3 "3��nd warning alarm level (the closest status with obstacle)" ;
VAL_ 3221225472 PA_RrWrngAlrmReq 0 "OFF(No warning alarm)" 1 "1��st warning alarm level" 2 "2��nd warning alarm level" 3 "3��nd warning alarm level (the closest status with obstacle)" ;
VAL_ 3221225472 PA_FrLftWrngAlrmReq 0 "OFF(No warning alarm)" 1 "1��st warning alarm level" 2 "2��nd warning alarm level" 3 "3��nd warning alarm level (the closest status with obstacle)" ;
VAL_ 3221225472 PA_FrCtrWrngAlrmReq 0 "OFF(No warning alarm)" 1 "1��st warning alarm level" 2 "2��nd warning alarm level" 3 "3��nd warning alarm level (the closest status with obstacle)" ;
