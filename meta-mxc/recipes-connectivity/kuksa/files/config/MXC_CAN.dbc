VERSION ""

NS_ :

BS_:

BU_: MXC CGW

BO_ 3221225472 VECTOR__INDEPENDENT_SIG_MSG: 0 Vector__XXX
 SG_ PA_FrRtWrngAlrmReq : 0|2@1+ (1,0) [0|0] "" Vector__XXX
 SG_ PA_RrLftWrngAlrmReq : 0|2@1+ (1,0) [0|0] "" Vector__XXX
 SG_ PA_RrCtrWrngAlrmReq : 0|2@1+ (1,0) [0|0] "" Vector__XXX
 SG_ PA_RrRtWrngAlrmReq : 0|2@1+ (1,0) [0|0] "" Vector__XXX
 SG_ PA_Sta : 0|4@1+ (1,0) [0|0] "" Vector__XXX
 SG_ PA_TestModSta : 0|2@1+ (1,0) [0|0] "" Vector__XXX
 SG_ PA_StrAnglReq : 0|16@1- (0.1,0) [0|0] "" Vector__XXX
 SG_ ADAS_CMD_Crc10Val : 0|16@1+ (1,0) [0|0] "" Vector__XXX
 SG_ ADAS_CMD_AlvCnt10Val : 0|8@1+ (1,0) [0|0] "" Vector__XXX
 SG_ FCA_OnOffEquipSta : 0|3@1+ (1,0) [0|0] "" Vector__XXX
 SG_ FCA_SysFlrSta : 0|3@1+ (1,0) [0|0] "" Vector__XXX
 SG_ FCA_WrngLvlSta : 0|2@1+ (1,0) [0|0] "" Vector__XXX
 SG_ FCA_VehStpReq : 0|2@1+ (1,0) [0|0] "" Vector__XXX
 SG_ FCA_StbltActvReq : 0|3@1+ (1,0) [0|0] "" Vector__XXX
 SG_ FCA_HydrlcBstAsstReq : 0|2@1+ (1,0) [0|0] "" Vector__XXX
 SG_ FCA_DclReqVal : 0|8@1+ (0.01,0) [0|0] "g" Vector__XXX
 SG_ FCA_PrefillActvReq : 0|2@1+ (1,0) [0|0] "" Vector__XXX
 SG_ FCA_PartialActvReq : 0|2@1+ (1,0) [0|0] "" Vector__XXX
 SG_ FCA_FullActvReq : 0|2@1+ (1,0) [0|0] "" Vector__XXX
 SG_ FCA_SnstvtyModRetVal : 0|3@1+ (1,0) [0|0] "" Vector__XXX
 SG_ FCA_WrngSndSta : 0|3@1+ (1,0) [0|0] "" Vector__XXX
 SG_ FCA_RelVel : 0|9@1+ (0.1,0) [0|0] "m/s" Vector__XXX
 SG_ FCA_TimetoCllsn : 0|8@1+ (10,0) [0|0] "ms" Vector__XXX
 SG_ Nmode_FCAOff_Sta : 0|2@1+ (1,0) [0|0] "" Vector__XXX
 SG_ FCA_Jnctn_OnOffEquipSta : 0|2@1+ (1,0) [0|0] "" Vector__XXX
 SG_ FCA_WrngTrgtDis : 0|5@1+ (1,0) [0|0] "" Vector__XXX
 SG_ ADAS_DRV_FCA_Plus_Sta : 0|2@1+ (1,0) [0|0] "" Vector__XXX
 SG_ ECS_Crc3Val : 0|16@1+ (1,0) [0|0] "" Vector__XXX
 SG_ ECSIVSS_RREstDmpVelVal : 0|12@1- (1,0) [0|0] "mm/s" Vector__XXX
 SG_ ECSIVSS_DmpCtrlrErrSta : 0|2@1+ (1,0) [0|0] "" Vector__XXX
 SG_ ECSIVSS_IVSSCtrlrErrSta : 0|2@1+ (1,0) [0|0] "" Vector__XXX
 SG_ ECSIVSS_AntRollCtrlSta : 0|2@1+ (1,0) [0|0] "" Vector__XXX
 SG_ ECSIVSS_FLCtrlSta : 0|2@1+ (1,0) [0|0] "" Vector__XXX
 SG_ ECSIVSS_FRCtrlSta : 0|2@1+ (1,0) [0|0] "" Vector__XXX
 SG_ ECSIVSS_RLCtrlSta : 0|2@1+ (1,0) [0|0] "" Vector__XXX
 SG_ ECSIVSS_RRCtrlSta : 0|2@1+ (1,0) [0|0] "" Vector__XXX
 SG_ ECS_AlvCnt3Val : 0|8@1+ (1,0) [0|0] "" Vector__XXX
 SG_ ECSIVSS_FLFinCurrentVal : 0|8@1+ (0.5,0) [0|0] "%" Vector__XXX
 SG_ ECSIVSS_FRFinCurrentVal : 0|8@1+ (0.5,0) [0|0] "%" Vector__XXX
 SG_ ECSIVSS_RLFinCurrentVal : 0|8@1+ (0.5,0) [0|0] "%" Vector__XXX
 SG_ ECSIVSS_RRFinCurrentVal : 0|8@1+ (0.5,0) [0|0] "%" Vector__XXX
 SG_ ECSIVSS_FLEstDmpVelVal : 0|12@1- (1,0) [0|0] "mm/s" Vector__XXX
 SG_ ECSIVSS_FREstDmpVelVal : 0|12@1- (1,0) [0|0] "mm/s" Vector__XXX
 SG_ ECSIVSS_RLEstDmpVelVal : 0|12@1- (1,0) [0|0] "mm/s" Vector__XXX
 SG_ ADAS_PRK_Crc3Val : 0|16@1+ (1,0) [0|0] "" Vector__XXX
 SG_ RSPA_LftTrgtPosY : 0|8@1+ (5,-640) [0|0] "" Vector__XXX
 SG_ RSPA_Sta : 0|4@1+ (1,0) [0|0] "" Vector__XXX
 SG_ RSPA_Actv : 0|2@1+ (1,0) [0|0] "" Vector__XXX
 SG_ RSPA_TrgtGearSta : 0|3@1+ (1,0) [0|0] "" Vector__XXX
 SG_ RSPA_EpbReq : 0|2@1+ (1,0) [0|0] "" Vector__XXX
 SG_ RSPA_ExtLampReq : 0|3@1+ (1,0) [0|0] "" Vector__XXX
 SG_ RSPA_CrankingReq : 0|2@1+ (1,0) [0|0] "" Vector__XXX
 SG_ RSPA_IdOutWarnReq : 0|2@1+ (1,0) [0|0] "" Vector__XXX
 SG_ RSPA_IndBlnkReq : 0|3@1+ (1,0) [0|0] "" Vector__XXX
 SG_ RSPA_SysOff : 0|1@1+ (1,0) [0|0] "" Vector__XXX
 SG_ RSPA_DccCmd : 0|2@1+ (1,0) [0|0] "" Vector__XXX
 SG_ RSPA_StopReq : 0|2@1+ (1,0) [0|0] "" Vector__XXX
 SG_ RSPA_SelDevInfo : 0|2@1+ (1,0) [0|0] "" Vector__XXX
 SG_ RSPA_SelFuncInfo : 0|2@1+ (1,0) [0|0] "" Vector__XXX
 SG_ RSPA_TrgtVehSpdVal : 0|10@1+ (0.01,0) [0|0] "km/h" Vector__XXX
 SG_ ADAS_PRK_AlvCnt3Val : 0|8@1+ (1,0) [0|0] "" Vector__XXX
 SG_ RSPA_AddtnlAccelActv : 0|2@1+ (1,0) [0|0] "" Vector__XXX
 SG_ RSPA_Opt : 0|2@1+ (1,0) [0|0] "" Vector__XXX
 SG_ RSPA_TrgtTqVal : 0|12@1- (1,0) [0|0] "Nm" Vector__XXX
 SG_ RSPA_DCTTrgtTqVal : 0|16@1+ (0.3906,0) [0|0] "" Vector__XXX
 SG_ RSPA_RtTrgtDir : 0|16@1- (1,0) [0|0] "Deg" Vector__XXX
 SG_ RSPA_LftTrgtDir : 0|16@1- (1,0) [0|0] "Deg" Vector__XXX
 SG_ RSPA_AvnDis : 0|2@1+ (1,0) [0|0] "" Vector__XXX
 SG_ RSPA_AvnModDis : 0|2@1+ (1,0) [0|0] "" Vector__XXX
 SG_ RSPA_AvnModNumDis : 0|3@1+ (1,0) [0|0] "" Vector__XXX
 SG_ RSPA_AvnSubViewDis : 0|2@1+ (1,0) [0|0] "" Vector__XXX
 SG_ RSPA_AvnModADLDis : 0|2@1+ (1,0) [0|0] "" Vector__XXX
 SG_ RSPA_AvnModPDFLDis : 0|2@1+ (1,0) [0|0] "" Vector__XXX
 SG_ RSPA_AvnModPLDis : 0|2@1+ (1,0) [0|0] "" Vector__XXX
 SG_ RSPA_AvnModPDRLDis : 0|2@1+ (1,0) [0|0] "" Vector__XXX
 SG_ RSPA_AvnModPDRRDis : 0|2@1+ (1,0) [0|0] "" Vector__XXX
 SG_ RSPA_AvnModPRDis : 0|2@1+ (1,0) [0|0] "" Vector__XXX
 SG_ RSPA_AvnModPDFRDis : 0|2@1+ (1,0) [0|0] "" Vector__XXX
 SG_ RSPA_AvnModADRDis : 0|2@1+ (1,0) [0|0] "" Vector__XXX
 SG_ RSPA_CamDis : 0|3@1+ (1,0) [0|0] "" Vector__XXX
 SG_ RSPA_CnclTyp : 0|2@1+ (1,0) [0|0] "" Vector__XXX
 SG_ RSPA_AvnHmiDis : 0|8@1+ (1,0) [0|0] "" Vector__XXX
 SG_ RSPA_BxHght : 0|8@1+ (10,3500) [0|0] "" Vector__XXX
 SG_ RSPA_BxWidth : 0|8@1+ (5,1000) [0|0] "" Vector__XXX
 SG_ RSPA_RtTrgtPosX : 0|8@1+ (5,-640) [0|0] "" Vector__XXX
 SG_ RSPA_RtTrgtPosY : 0|8@1+ (5,-640) [0|0] "" Vector__XXX
 SG_ RSPA_LftTrgtPosX : 0|8@1+ (5,-640) [0|0] "" Vector__XXX
 SG_ IAU_DigitalKeyOpt : 0|2@1+ (1,0) [0|0] "" Vector__XXX
 SG_ IAU_ProfileIDRVal : 0|4@1+ (1,0) [0|0] "" Vector__XXX
 SG_ IAU_ISKLearnState : 0|2@1+ (1,0) [0|0] "" Vector__XXX
 SG_ IAU_DigitalKeyProcessingSta : 0|4@1+ (1,0) [0|0] "" Vector__XXX
 SG_ IAU_DigitalKeyExit : 0|4@1+ (1,0) [0|0] "" Vector__XXX
 SG_ IAU_DigitalKeyEnblRVal : 0|2@1+ (1,0) [0|0] "" Vector__XXX
 SG_ IAU_OwnerPhnRegRVal : 0|2@1+ (1,0) [0|0] "" Vector__XXX
 SG_ IAU_NFCCard1RegRVal : 0|2@1+ (1,0) [0|0] "" Vector__XXX
 SG_ IAU_NFCCard2RegRVal : 0|2@1+ (1,0) [0|0] "" Vector__XXX
 SG_ IAU_RdyToSendAuthDataSta : 0|2@1+ (1,0) [0|0] "" Vector__XXX
 SG_ IAU_OptTyp : 0|3@1+ (1,0) [0|0] "" Vector__XXX
 SG_ IAU_NFCKeyReminder : 0|1@1+ (1,0) [0|0] "" Vector__XXX
 SG_ IAU_NFCDeactivation : 0|1@1+ (1,0) [0|0] "" Vector__XXX
 SG_ IAU_DISPWrng : 0|4@1+ (1,0) [0|0] "" Vector__XXX
 SG_ IAU_ConStat : 0|2@1+ (1,0) [0|0] "" Vector__XXX
 SG_ IAU_LftDrHndLockDetected : 0|2@1+ (1,0) [0|0] "" Vector__XXX
 SG_ IAU_LftDrHndUnlockDetected : 0|2@1+ (1,0) [0|0] "" Vector__XXX
 SG_ IAU_RtDrHndLockDetected : 0|2@1+ (1,0) [0|0] "" Vector__XXX
 SG_ IAU_RtDrHndUnlockDetected : 0|2@1+ (1,0) [0|0] "" Vector__XXX
 SG_ IAU_ProfileIDParingRVal : 0|2@1+ (1,0) [0|0] "" Vector__XXX
 SG_ EPB_Logger1_Byte0 : 0|8@1+ (1,0) [0|0] "" Vector__XXX
 SG_ EPB_Logger1_Byte2 : 0|8@1+ (1,0) [0|0] "" Vector__XXX
 SG_ EPB_Logger1_Byte3 : 0|8@1+ (1,0) [0|0] "" Vector__XXX
 SG_ EPB_Logger1_Byte4 : 0|8@1+ (1,0) [0|0] "" Vector__XXX
 SG_ EPB_Logger1_Byte5 : 0|8@1+ (1,0) [0|0] "" Vector__XXX
 SG_ EPB_Logger1_Byte6 : 0|8@1+ (1,0) [0|0] "" Vector__XXX
 SG_ EPB_Logger1_Byte7 : 0|8@1+ (1,0) [0|0] "" Vector__XXX
 SG_ EPB_Logger1_Byte1 : 0|8@1+ (1,0) [0|0] "" Vector__XXX
 SG_ EPB_Logger0_Byte0 : 0|8@1+ (1,0) [0|0] "" Vector__XXX
 SG_ EPB_Logger0_Byte2 : 0|8@1+ (1,0) [0|0] "" Vector__XXX
 SG_ EPB_Logger0_Byte3 : 0|8@1+ (1,0) [0|0] "" Vector__XXX
 SG_ EPB_Logger0_Byte4 : 0|8@1+ (1,0) [0|0] "" Vector__XXX
 SG_ EPB_Logger0_Byte5 : 0|8@1+ (1,0) [0|0] "" Vector__XXX
 SG_ EPB_Logger0_Byte6 : 0|8@1+ (1,0) [0|0] "" Vector__XXX
 SG_ EPB_Logger0_Byte7 : 0|8@1+ (1,0) [0|0] "" Vector__XXX
 SG_ EPB_Logger0_Byte1 : 0|8@1+ (1,0) [0|0] "" Vector__XXX
 SG_ MODE_MDPS_SET : 0|3@1+ (1,0) [0|0] "" Vector__XXX
 SG_ MODE_ECS_SET : 0|3@1+ (1,0) [0|0] "" Vector__XXX
 SG_ MODE_4WD_SET : 0|3@1+ (1,0) [0|0] "" Vector__XXX
 SG_ MODE_BRAKE_SET : 0|3@1+ (1,0) [0|0] "" Vector__XXX
 SG_ MODE_ENG_SET : 0|3@1+ (1,0) [0|0] "" Vector__XXX
 SG_ EPB_DTO_Byte0 : 0|8@1+ (1,0) [0|0] "" Vector__XXX
 SG_ EPB_DTO_Byte2 : 0|8@1+ (1,0) [0|0] "" Vector__XXX
 SG_ EPB_DTO_Byte3 : 0|8@1+ (1,0) [0|0] "" Vector__XXX
 SG_ EPB_DTO_Byte4 : 0|8@1+ (1,0) [0|0] "" Vector__XXX
 SG_ EPB_DTO_Byte5 : 0|8@1+ (1,0) [0|0] "" Vector__XXX
 SG_ EPB_DTO_Byte6 : 0|8@1+ (1,0) [0|0] "" Vector__XXX
 SG_ EPB_DTO_Byte7 : 0|8@1+ (1,0) [0|0] "" Vector__XXX
 SG_ EPB_DTO_Byte1 : 0|8@1+ (1,0) [0|0] "" Vector__XXX
 SG_ EPB_CRO_Byte0 : 0|8@1+ (1,0) [0|0] "" Vector__XXX
 SG_ EPB_CRO_Byte2 : 0|8@1+ (1,0) [0|0] "" Vector__XXX
 SG_ EPB_CRO_Byte3 : 0|8@1+ (1,0) [0|0] "" Vector__XXX
 SG_ EPB_CRO_Byte4 : 0|8@1+ (1,0) [0|0] "" Vector__XXX
 SG_ EPB_CRO_Byte5 : 0|8@1+ (1,0) [0|0] "" Vector__XXX
 SG_ EPB_CRO_Byte6 : 0|8@1+ (1,0) [0|0] "" Vector__XXX
 SG_ EPB_CRO_Byte7 : 0|8@1+ (1,0) [0|0] "" Vector__XXX
 SG_ EPB_CRO_Byte1 : 0|8@1+ (1,0) [0|0] "" Vector__XXX
 SG_ EPB_Logger5_Byte0 : 0|8@1+ (1,0) [0|0] "" Vector__XXX
 SG_ EPB_Logger5_Byte2 : 0|8@1+ (1,0) [0|0] "" Vector__XXX
 SG_ EPB_Logger5_Byte3 : 0|8@1+ (1,0) [0|0] "" Vector__XXX
 SG_ EPB_Logger5_Byte4 : 0|8@1+ (1,0) [0|0] "" Vector__XXX
 SG_ EPB_Logger5_Byte5 : 0|8@1+ (1,0) [0|0] "" Vector__XXX
 SG_ EPB_Logger5_Byte6 : 0|8@1+ (1,0) [0|0] "" Vector__XXX
 SG_ EPB_Logger5_Byte7 : 0|8@1+ (1,0) [0|0] "" Vector__XXX
 SG_ EPB_Logger5_Byte1 : 0|8@1+ (1,0) [0|0] "" Vector__XXX
 SG_ EPB_Logger4_Byte0 : 0|8@1+ (1,0) [0|0] "" Vector__XXX
 SG_ EPB_Logger4_Byte2 : 0|8@1+ (1,0) [0|0] "" Vector__XXX
 SG_ EPB_Logger4_Byte3 : 0|8@1+ (1,0) [0|0] "" Vector__XXX
 SG_ EPB_Logger4_Byte4 : 0|8@1+ (1,0) [0|0] "" Vector__XXX
 SG_ EPB_Logger4_Byte5 : 0|8@1+ (1,0) [0|0] "" Vector__XXX
 SG_ EPB_Logger4_Byte6 : 0|8@1+ (1,0) [0|0] "" Vector__XXX
 SG_ EPB_Logger4_Byte7 : 0|8@1+ (1,0) [0|0] "" Vector__XXX
 SG_ EPB_Logger4_Byte1 : 0|8@1+ (1,0) [0|0] "" Vector__XXX
 SG_ EPB_Logger3_Byte0 : 0|8@1+ (1,0) [0|0] "" Vector__XXX
 SG_ EPB_Logger3_Byte2 : 0|8@1+ (1,0) [0|0] "" Vector__XXX
 SG_ EPB_Logger3_Byte3 : 0|8@1+ (1,0) [0|0] "" Vector__XXX
 SG_ EPB_Logger3_Byte4 : 0|8@1+ (1,0) [0|0] "" Vector__XXX
 SG_ EPB_Logger3_Byte5 : 0|8@1+ (1,0) [0|0] "" Vector__XXX
 SG_ EPB_Logger3_Byte6 : 0|8@1+ (1,0) [0|0] "" Vector__XXX
 SG_ EPB_Logger3_Byte7 : 0|8@1+ (1,0) [0|0] "" Vector__XXX
 SG_ EPB_Logger3_Byte1 : 0|8@1+ (1,0) [0|0] "" Vector__XXX
 SG_ EPB_Logger2_Byte0 : 0|8@1+ (1,0) [0|0] "" Vector__XXX
 SG_ EPB_Logger2_Byte2 : 0|8@1+ (1,0) [0|0] "" Vector__XXX
 SG_ EPB_Logger2_Byte3 : 0|8@1+ (1,0) [0|0] "" Vector__XXX
 SG_ EPB_Logger2_Byte4 : 0|8@1+ (1,0) [0|0] "" Vector__XXX
 SG_ EPB_Logger2_Byte5 : 0|8@1+ (1,0) [0|0] "" Vector__XXX
 SG_ EPB_Logger2_Byte6 : 0|8@1+ (1,0) [0|0] "" Vector__XXX
 SG_ EPB_Logger2_Byte7 : 0|8@1+ (1,0) [0|0] "" Vector__XXX
 SG_ EPB_Logger2_Byte1 : 0|8@1+ (1,0) [0|0] "" Vector__XXX
 SG_ EPB_Logger9_Byte0 : 0|8@1+ (1,0) [0|0] "" Vector__XXX
 SG_ EPB_Logger9_Byte2 : 0|8@1+ (1,0) [0|0] "" Vector__XXX
 SG_ EPB_Logger9_Byte3 : 0|8@1+ (1,0) [0|0] "" Vector__XXX
 SG_ EPB_Logger9_Byte4 : 0|8@1+ (1,0) [0|0] "" Vector__XXX
 SG_ EPB_Logger9_Byte5 : 0|8@1+ (1,0) [0|0] "" Vector__XXX
 SG_ EPB_Logger9_Byte6 : 0|8@1+ (1,0) [0|0] "" Vector__XXX
 SG_ EPB_Logger9_Byte7 : 0|8@1+ (1,0) [0|0] "" Vector__XXX
 SG_ EPB_Logger9_Byte1 : 0|8@1+ (1,0) [0|0] "" Vector__XXX
 SG_ EPB_Logger8_Byte0 : 0|8@1+ (1,0) [0|0] "" Vector__XXX
 SG_ EPB_Logger8_Byte2 : 0|8@1+ (1,0) [0|0] "" Vector__XXX
 SG_ EPB_Logger8_Byte3 : 0|8@1+ (1,0) [0|0] "" Vector__XXX
 SG_ EPB_Logger8_Byte4 : 0|8@1+ (1,0) [0|0] "" Vector__XXX
 SG_ EPB_Logger8_Byte5 : 0|8@1+ (1,0) [0|0] "" Vector__XXX
 SG_ EPB_Logger8_Byte6 : 0|8@1+ (1,0) [0|0] "" Vector__XXX
 SG_ EPB_Logger8_Byte7 : 0|8@1+ (1,0) [0|0] "" Vector__XXX
 SG_ EPB_Logger8_Byte1 : 0|8@1+ (1,0) [0|0] "" Vector__XXX
 SG_ EPB_Logger7_Byte0 : 0|8@1+ (1,0) [0|0] "" Vector__XXX
 SG_ EPB_Logger7_Byte2 : 0|8@1+ (1,0) [0|0] "" Vector__XXX
 SG_ EPB_Logger7_Byte3 : 0|8@1+ (1,0) [0|0] "" Vector__XXX
 SG_ EPB_Logger7_Byte4 : 0|8@1+ (1,0) [0|0] "" Vector__XXX
 SG_ EPB_Logger7_Byte5 : 0|8@1+ (1,0) [0|0] "" Vector__XXX
 SG_ EPB_Logger7_Byte6 : 0|8@1+ (1,0) [0|0] "" Vector__XXX
 SG_ EPB_Logger7_Byte7 : 0|8@1+ (1,0) [0|0] "" Vector__XXX
 SG_ EPB_Logger7_Byte1 : 0|8@1+ (1,0) [0|0] "" Vector__XXX
 SG_ EPB_Logger6_Byte0 : 0|8@1+ (1,0) [0|0] "" Vector__XXX
 SG_ EPB_Logger6_Byte2 : 0|8@1+ (1,0) [0|0] "" Vector__XXX
 SG_ EPB_Logger6_Byte3 : 0|8@1+ (1,0) [0|0] "" Vector__XXX
 SG_ EPB_Logger6_Byte4 : 0|8@1+ (1,0) [0|0] "" Vector__XXX
 SG_ EPB_Logger6_Byte5 : 0|8@1+ (1,0) [0|0] "" Vector__XXX
 SG_ EPB_Logger6_Byte6 : 0|8@1+ (1,0) [0|0] "" Vector__XXX
 SG_ EPB_Logger6_Byte7 : 0|8@1+ (1,0) [0|0] "" Vector__XXX
 SG_ EPB_Logger6_Byte1 : 0|8@1+ (1,0) [0|0] "" Vector__XXX
 SG_ PSB_Crc1Val : 0|8@1+ (1,0) [0|0] "" Vector__XXX
 SG_ PSB_AlvCnt1Val : 0|4@1+ (1,0) [0|0] "" Vector__XXX
 SG_ PSB_LHFlrSta : 0|2@1+ (1,0) [0|0] "" Vector__XXX
 SG_ PSB_LHActvSta : 0|4@1+ (1,0) [0|0] "" Vector__XXX
 SG_ PSB_RHFlrSta : 0|2@1+ (1,0) [0|0] "" Vector__XXX
 SG_ PSB_RHActvSta : 0|4@1+ (1,0) [0|0] "" Vector__XXX
 SG_ PSB_ActForAcu : 0|4@1+ (1,0) [0|0] "" Vector__XXX
 SG_ GST_LPI_DCU_ESC_IEB_Byte0 : 0|8@1+ (1,0) [0|0] "" Vector__XXX
 SG_ GST_LPI_DCU_ESC_IEB_Byte2 : 0|8@1+ (1,0) [0|0] "" Vector__XXX
 SG_ GST_LPI_DCU_ESC_IEB_Byte3 : 0|8@1+ (1,0) [0|0] "" Vector__XXX
 SG_ GST_LPI_DCU_ESC_IEB_Byte4 : 0|8@1+ (1,0) [0|0] "" Vector__XXX
 SG_ GST_LPI_DCU_ESC_IEB_Byte5 : 0|8@1+ (1,0) [0|0] "" Vector__XXX
 SG_ GST_LPI_DCU_ESC_IEB_Byte6 : 0|8@1+ (1,0) [0|0] "" Vector__XXX
 SG_ GST_LPI_DCU_ESC_IEB_Byte7 : 0|8@1+ (1,0) [0|0] "" Vector__XXX
 SG_ GST_LPI_DCU_ESC_IEB_Byte1 : 0|8@1+ (1,0) [0|0] "" Vector__XXX
 SG_ POS_V2_Offset : 0|13@1+ (1,0) [0|0] "m" Vector__XXX
 SG_ POS_V2_PathIndex : 0|6@1+ (1,0) [0|0] "" Vector__XXX
 SG_ POS_V2_CyclicCounter : 0|2@1+ (1,0) [0|0] "" Vector__XXX
 SG_ POS_V2_RangeAvgSpeed : 0|9@1+ (1,0) [0|0] "km/h" Vector__XXX
 SG_ POS_V2_CurrAltitude100m : 0|6@1+ (1,0) [0|0] "m" Vector__XXX
 SG_ POS_V2_CurrAltitude1m : 0|7@1+ (1,0) [0|0] "m" Vector__XXX
 SG_ POS_V2_CurrFuncRoadClass : 0|3@1+ (1,0) [0|0] "" Vector__XXX
 SG_ POS_V2_CurrFormOfWay : 0|4@1+ (1,0) [0|0] "" Vector__XXX
 SG_ POS_V2_CurrDirectionLanes : 0|4@1+ (1,0) [0|0] "" Vector__XXX
 SG_ POS_V2_CurrSpeedLimit : 0|5@1+ (1,0) [0|0] "km/h or MPH" Vector__XXX
 SG_ POS_V2_CurrTrafficSpeed : 0|5@1+ (1,0) [0|0] "km/h or MPH" Vector__XXX
 SG_ VCU_Crc5Val : 0|16@1+ (1,0) [0|0] "" Vector__XXX
 SG_ VCU_EnergyFlowSta : 0|4@1+ (1,0) [0|15] "" Vector__XXX
 SG_ VCU_SbwWarnSndSta : 0|2@1+ (1,0) [0|0] "flag" Vector__XXX
 SG_ VCU_EcoGuide_DispReq : 0|2@1+ (1,0) [0|3] "" Vector__XXX
 SG_ VCU_EcoGuide_ApsGaugeVal : 0|7@1+ (1,0) [0|100] "%" Vector__XXX
 SG_ VCU_EcoGuide_EcoGaugeVal : 0|7@1+ (1,0) [0|100] "%" Vector__XXX
 SG_ VCU_TgSocDteAcChgVal : 0|11@1+ (1,0) [0|2047] "km" Vector__XXX
 SG_ VCU_TgSocDteDcChgVal : 0|11@1+ (1,0) [0|2047] "km" Vector__XXX
 SG_ VCU_DistFromRegenDispReq : 0|2@1+ (1,0) [0|3] "" Vector__XXX
 SG_ VCU_DistFromRegenVal : 0|10@1+ (10,0) [0|10230] "m" Vector__XXX
 SG_ VCU_AlvCnt5Val : 0|8@1+ (1,0) [0|0] "" Vector__XXX
 SG_ VCU_DrvStyle_DispReq : 0|2@1+ (1,0) [0|3] "" Vector__XXX
 SG_ VCU_DrvStyle_HighLightSta : 0|2@1+ (1,0) [0|3] "" Vector__XXX
 SG_ VCU_DrvStyle_EcoVal : 0|7@1+ (1,0) [0|100] "%" Vector__XXX
 SG_ VCU_DrvStyle_NonEcoVal : 0|7@1+ (1,0) [0|100] "%" Vector__XXX
 SG_ VCU_DrvStyle_NorVal : 0|7@1+ (1,0) [0|100] "%" Vector__XXX
 SG_ VCU_EcoPotential_EcoVal : 0|8@1+ (0.5,0) [0|100] "" Vector__XXX
 SG_ VCU_EcoPotential_NorVal : 0|8@1+ (0.5,0) [0|100] "" Vector__XXX
 SG_ VCU_EcoPotential_SptVal : 0|8@1+ (0.5,0) [0|100] "" Vector__XXX
 SG_ VCU_InstFuelEcoVal_Per100km : 0|8@1+ (0.5,0) [0|126.5] "kWh/100km" Vector__XXX
 SG_ VCU_InstFuelEcoVal_PerkWh : 0|8@1+ (0.1,0) [0|25.5] "km/kWh" Vector__XXX
 SG_ VCU_CO2RdcTripDistVal : 0|10@1+ (1,0) [0|1023] "km" Vector__XXX
 SG_ VCU_EvDrvRdyCluDispSta : 0|2@1+ (1,0) [0|3] "" Vector__XXX
 SG_ VCU_CO2RdcVal : 0|10@1+ (100,0) [0|102300] "g" Vector__XXX
 SG_ VCU_PwrDnModeSta : 0|2@1+ (1,0) [0|3] "" Vector__XXX
 SG_ VCU_CluWarnMsgSta : 0|4@1+ (1,0) [0|15] "" Vector__XXX
 SG_ VCU_DteOffDispSta : 0|2@1+ (1,0) [0|0] "flag" Vector__XXX
 SG_ VCU_LowSocAlertSta : 0|3@1+ (1,0) [0|7] "" Vector__XXX
 SG_ VCU_VcrmReq : 0|2@1+ (1,0) [0|3] "" Vector__XXX
 SG_ VCU_PdlWarnMsgSta : 0|2@1+ (1,0) [0|3] "" Vector__XXX
 SG_ VCU_VirtualApsActSta : 0|2@1+ (1,0) [0|3] "" Vector__XXX
 SG_ VCU_VirtualApsVal : 0|8@1+ (0.3906,0) [0|99.61] "%" Vector__XXX
 SG_ VCU_ServiceLampReq : 0|2@1+ (1,0) [0|3] "" Vector__XXX
 SG_ VCU_ServiceModeSta : 0|2@1+ (1,0) [0|3] "" Vector__XXX
 SG_ VCU_NPosWshModSta : 0|2@1+ (1,0) [0|0] "flag" Vector__XXX
 SG_ VCU_PowerTrainType : 0|2@1+ (1,0) [0|3] "" Vector__XXX
 SG_ VCU_DteBaseVal : 0|11@1+ (1,0) [0|2047] "km" Vector__XXX
 SG_ VCU_AvnDteOnCalcSta : 0|2@1+ (1,0) [0|3] "" Vector__XXX
 SG_ VCU_SbwWarnMsgSta : 0|3@1+ (1,0) [0|0] "flag" Vector__XXX
 SG_ VCU_DteNaviRouteVal : 0|10@1+ (2,0) [0|1026] "km" Vector__XXX
 SG_ VCU_DteAddVal : 0|8@1+ (1,0) [0|255] "km" Vector__XXX
 SG_ VCU_PwrGaugeVal : 0|8@1- (1,0) [-100|100] "%" Vector__XXX
 SG_ HU_DistanceUnit : 0|2@1+ (1,0) [0|0] "" Vector__XXX
 SG_ HU_MicActivity : 0|2@1+ (1,0) [0|0] "" Vector__XXX
 SG_ AVN_RSPA_CancelInput : 0|2@1+ (1,0) [0|3] "" Vector__XXX
 SG_ AVN_RSPA_ModeSetStat : 0|4@1+ (1,0) [0|0] "" Vector__XXX
 SG_ AVN_RSPA_Disp_Rdy : 0|2@1+ (1,0) [0|0] "" Vector__XXX
 SG_ CF_AVN_ProfileIDRValue : 0|4@1+ (1,0) [0|0] "" Vector__XXX
 SG_ HazardFromHUSVM : 0|2@1+ (1,0) [0|0] "" Vector__XXX
 SG_ OMUOSMirCtrl : 0|2@1+ (1,0) [0|0] "" Vector__XXX
 SG_ AVN_PDW_Input : 0|2@1+ (1,0) [0|3] "" Vector__XXX
 SG_ AVN_RSPA_Input : 0|2@1+ (1,0) [0|3] "" Vector__XXX
 SG_ AVN_ParkingSW : 0|3@1+ (1,0) [0|0] "" Vector__XXX
 SG_ HU_AliveStatus : 0|2@1+ (1,0) [0|0] "" Vector__XXX
 SG_ C_MtnAlertClu : 0|2@1+ (1,0) [0|0] "" Vector__XXX
 SG_ LPI_DCU_ESC_IEB_GST_Byte0 : 0|8@1+ (1,0) [0|0] "" Vector__XXX
 SG_ LPI_DCU_ESC_IEB_GST_Byte2 : 0|8@1+ (1,0) [0|0] "" Vector__XXX
 SG_ LPI_DCU_ESC_IEB_GST_Byte3 : 0|8@1+ (1,0) [0|0] "" Vector__XXX
 SG_ LPI_DCU_ESC_IEB_GST_Byte4 : 0|8@1+ (1,0) [0|0] "" Vector__XXX
 SG_ LPI_DCU_ESC_IEB_GST_Byte5 : 0|8@1+ (1,0) [0|0] "" Vector__XXX
 SG_ LPI_DCU_ESC_IEB_GST_Byte6 : 0|8@1+ (1,0) [0|0] "" Vector__XXX
 SG_ LPI_DCU_ESC_IEB_GST_Byte7 : 0|8@1+ (1,0) [0|0] "" Vector__XXX
 SG_ LPI_DCU_ESC_IEB_GST_Byte1 : 0|8@1+ (1,0) [0|0] "" Vector__XXX
 SG_ GST_ACU_Byte0 : 0|8@1+ (1,0) [0|0] "" Vector__XXX
 SG_ GST_ACU_Byte2 : 0|8@1+ (1,0) [0|0] "" Vector__XXX
 SG_ GST_ACU_Byte3 : 0|8@1+ (1,0) [0|0] "" Vector__XXX
 SG_ GST_ACU_Byte4 : 0|8@1+ (1,0) [0|0] "" Vector__XXX
 SG_ GST_ACU_Byte5 : 0|8@1+ (1,0) [0|0] "" Vector__XXX
 SG_ GST_ACU_Byte6 : 0|8@1+ (1,0) [0|0] "" Vector__XXX
 SG_ GST_ACU_Byte7 : 0|8@1+ (1,0) [0|0] "" Vector__XXX
 SG_ GST_ACU_Byte1 : 0|8@1+ (1,0) [0|0] "" Vector__XXX
 SG_ GST_ECS_Byte0 : 0|8@1+ (1,0) [0|0] "" Vector__XXX
 SG_ GST_ECS_Byte2 : 0|8@1+ (1,0) [0|0] "" Vector__XXX
 SG_ GST_ECS_Byte3 : 0|8@1+ (1,0) [0|0] "" Vector__XXX
 SG_ GST_ECS_Byte4 : 0|8@1+ (1,0) [0|0] "" Vector__XXX
 SG_ GST_ECS_Byte5 : 0|8@1+ (1,0) [0|0] "" Vector__XXX
 SG_ GST_ECS_Byte6 : 0|8@1+ (1,0) [0|0] "" Vector__XXX
 SG_ GST_ECS_Byte7 : 0|8@1+ (1,0) [0|0] "" Vector__XXX
 SG_ GST_ECS_Byte1 : 0|8@1+ (1,0) [0|0] "" Vector__XXX

CM_ SG_ 3221225472 PA_FrRtWrngAlrmReq "PA_FrontRightWarningAlarmRequest";
CM_ SG_ 3221225472 PA_RrLftWrngAlrmReq "PA_RearLeftWarningAlarmRequest";
CM_ SG_ 3221225472 PA_RrCtrWrngAlrmReq "PA_RearCenterWarningAlarmRequest";
CM_ SG_ 3221225472 PA_RrRtWrngAlrmReq "PA_RearRightWarningAlarmRequest";
CM_ SG_ 3221225472 PA_Sta "PA_Status";
CM_ SG_ 3221225472 PA_TestModSta "PA_TestModeStatus";
CM_ SG_ 3221225472 PA_StrAnglReq "PA_SteeringAngleRequest";
CM_ SG_ 3221225472 ADAS_CMD_Crc10Val "ADAS_CMD_CyclicRedundancyCheck10Value ##2G##FCA - FCA11 - CR_FCA_ChkSum";
CM_ SG_ 3221225472 ADAS_CMD_AlvCnt10Val "ADAS_CMD_AliveCounter10Value ##2G##FCA - FCA11 - CR_FCA_Alive";
CM_ SG_ 3221225472 FCA_OnOffEquipSta "FCA_OnOffEquipmentStatus ##2G##FCA - FCA12 - FCA_USM";
CM_ SG_ 3221225472 FCA_SysFlrSta "FCA_SystemFailureStatus ##2G##FCA - FCA11 - FCA_Failinfo";
CM_ SG_ 3221225472 FCA_WrngLvlSta "FCA_WarningLevelStatus ##2G##FCA - FCA11 - CF_VSM_Warn";
CM_ SG_ 3221225472 FCA_VehStpReq "FCA_VehicleStopRequest ##2G##FCA - FCA11 - FCA_StopReq";
CM_ SG_ 3221225472 FCA_StbltActvReq "FCA_SeatBeltActivateRequest ##2G##FCA - FCA11 - CF_VSM_BeltCmd";
CM_ SG_ 3221225472 FCA_HydrlcBstAsstReq "FCA_HydraulicBoostAssistRequest ##2G##FCA - FCA11 - CF_VSM_HBACmd";
CM_ SG_ 3221225472 FCA_DclReqVal "FCA_DecelerationRequestValue ##2G##FCA - FCA11 - CR_VSM_DecCmd";
CM_ SG_ 3221225472 FCA_PrefillActvReq "FCA_PrefillActivateRequest ##2G##FCA - FCA11 - CF_VSM_Prefill";
CM_ SG_ 3221225472 FCA_PartialActvReq "FCA_PartialActivateRequest";
CM_ SG_ 3221225472 FCA_FullActvReq "FCA_FullActivateRequest";
CM_ SG_ 3221225472 FCA_SnstvtyModRetVal "FCA_SensitivityModeReturnValue ##2G##FCA - FCA12 - FCA_DrvSetState";
CM_ SG_ 3221225472 FCA_WrngSndSta "FCA warning sound status";
CM_ SG_ 3221225472 FCA_RelVel "FCA_RelativeVelocity ##2G##FCA - FCA11_FS - FCA_RelativeVelocity";
CM_ SG_ 3221225472 FCA_TimetoCllsn "FCA_TimetoCollision ##2G##FCA - FCA11_FS - FCA_TimetoCollision";
CM_ SG_ 3221225472 Nmode_FCAOff_Sta "Nmode_FCAOff_Status ##2G##FCA - FCA12 - Nmode_FCAOff_Status";
CM_ SG_ 3221225472 FCA_Jnctn_OnOffEquipSta "FCA_Junction_OnOffEquipStatus";
CM_ SG_ 3221225472 FCA_WrngTrgtDis "FCA_WarningTargetDisplay";
CM_ SG_ 3221225472 ADAS_DRV_FCA_Plus_Sta "����ī�޶�, ���淹�̴� �� ������ ���̴�/������ ������ ǻ�� Ʈ���� ���� FCA-Car Ÿ�� �� ���� ����/���� ���� ȸ�� �Ұ��� ���θ� �Ǵ��Ͽ� FCA-Car/Ped/Cyc+ Flag�� ���";
CM_ SG_ 3221225472 ECS_Crc3Val "ECS_CyclicRedundancyCheck3Value";
CM_ SG_ 3221225472 ECSIVSS_RREstDmpVelVal "ECSIVSS_RearRightEstimatedDamperVelocity";
CM_ SG_ 3221225472 ECSIVSS_DmpCtrlrErrSta "ECSIVSS_DamperControllerErrorStatus";
CM_ SG_ 3221225472 ECSIVSS_IVSSCtrlrErrSta "ECSIVSS_IVSSControllerErrorStatus";
CM_ SG_ 3221225472 ECSIVSS_AntRollCtrlSta "ECSIVSS_Anti-rollcontrolStatus";
CM_ SG_ 3221225472 ECSIVSS_FLCtrlSta "ECS Control Status - Front Left";
CM_ SG_ 3221225472 ECSIVSS_FRCtrlSta "ECS Control Status - Front Right";
CM_ SG_ 3221225472 ECSIVSS_RLCtrlSta "ECS Control Status - Rear Left";
CM_ SG_ 3221225472 ECSIVSS_RRCtrlSta "ECS Control Status - Rear Right";
CM_ SG_ 3221225472 ECS_AlvCnt3Val "ECS_AliveCounter3Value";
CM_ SG_ 3221225472 ECSIVSS_FLFinCurrentVal "ECSIVSS_FrontLeftFinalCurrentValue";
CM_ SG_ 3221225472 ECSIVSS_FRFinCurrentVal "ECSIVSS_FrontRightFinalCurrentValue";
CM_ SG_ 3221225472 ECSIVSS_RLFinCurrentVal "ECSIVSS_RearLeftFinalCurrentValue";
CM_ SG_ 3221225472 ECSIVSS_RRFinCurrentVal "ECSIVSS_RearRightFinalCurrentValue";
CM_ SG_ 3221225472 ECSIVSS_FLEstDmpVelVal "ECSIVSS_FrontLeftEstimatedDamperVelocity";
CM_ SG_ 3221225472 ECSIVSS_FREstDmpVelVal "ECSIVSS_FrontRightEstimatedDamperVelocity";
CM_ SG_ 3221225472 ECSIVSS_RLEstDmpVelVal "ECSIVSS_RearLeftEstimatedDamperVelocity";
CM_ SG_ 3221225472 ADAS_PRK_Crc3Val "ADAS_PRK_CyclicRedundancyCheck3Value";
CM_ SG_ 3221225472 RSPA_LftTrgtPosY "RSPA_LeftTargetPosY";
CM_ SG_ 3221225472 RSPA_Sta "RSPA_Status";
CM_ SG_ 3221225472 RSPA_Actv "RSPA_Actvation";
CM_ SG_ 3221225472 RSPA_TrgtGearSta "RSPA_TargetGearStatus";
CM_ SG_ 3221225472 RSPA_EpbReq "RSPA_EPBRequest";
CM_ SG_ 3221225472 RSPA_ExtLampReq "RSPA_ExternalLampRequest";
CM_ SG_ 3221225472 RSPA_CrankingReq "RSPA_CrankingRequest";
CM_ SG_ 3221225472 RSPA_IdOutWarnReq "RSPA_IdOutWarningRequest";
CM_ SG_ 3221225472 RSPA_IndBlnkReq "RSPA_IndicatorBlinkingRequest";
CM_ SG_ 3221225472 RSPA_SysOff "RSPA System status flag";
CM_ SG_ 3221225472 RSPA_DccCmd "RSPA_DccelerationCommand";
CM_ SG_ 3221225472 RSPA_StopReq "RSPA_StopRequest";
CM_ SG_ 3221225472 RSPA_SelDevInfo "Selected Remote Device Information";
CM_ SG_ 3221225472 RSPA_SelFuncInfo "Selected RSPA Function Information";
CM_ SG_ 3221225472 RSPA_TrgtVehSpdVal "RSPA_TargetVehicleSpeedValue";
CM_ SG_ 3221225472 ADAS_PRK_AlvCnt3Val "ADAS_PRK_AliveCounter3Value";
CM_ SG_ 3221225472 RSPA_AddtnlAccelActv "RSPA_AdditionalAccelarationActivation";
CM_ SG_ 3221225472 RSPA_Opt "RSPA_Option";
CM_ SG_ 3221225472 RSPA_TrgtTqVal "RSPA_TargetTorqueValue";
CM_ SG_ 3221225472 RSPA_DCTTrgtTqVal "RSPA_DCTTargetTorqueValue";
CM_ SG_ 3221225472 RSPA_RtTrgtDir "RSPA_RightTargetDirection";
CM_ SG_ 3221225472 RSPA_LftTrgtDir "RSPA_LeftTargetDirection";
CM_ SG_ 3221225472 RSPA_AvnDis "RSPA_AvnDisplay";
CM_ SG_ 3221225472 RSPA_AvnModDis "RSPA_AvnModeDisplay";
CM_ SG_ 3221225472 RSPA_AvnModNumDis "RSPA_AvnModeNumberDisplay";
CM_ SG_ 3221225472 RSPA_AvnSubViewDis "RSPA_AvnSubViewDisplay";
CM_ SG_ 3221225472 RSPA_AvnModADLDis "RSPA_AvnModeAngleDLeftDisplay";
CM_ SG_ 3221225472 RSPA_AvnModPDFLDis "RSPA_AvnModePerpenDicularFowardLeftDisplay";
CM_ SG_ 3221225472 RSPA_AvnModPLDis "RSPA_AvnModeParallelLeftDisplay";
CM_ SG_ 3221225472 RSPA_AvnModPDRLDis "RSPA_AvnModPerpenDicularRearLeftDisplay";
CM_ SG_ 3221225472 RSPA_AvnModPDRRDis "RSPA_AvnModePerpenDicularRearRightDisplay";
CM_ SG_ 3221225472 RSPA_AvnModPRDis "RSPA_AvnModeParallelRightDisplay";
CM_ SG_ 3221225472 RSPA_AvnModPDFRDis "RSPA_AvnModePerpenDicularForwardRightDisplay";
CM_ SG_ 3221225472 RSPA_AvnModADRDis "RSPA_AvnModeAngleDRightDisplay";
CM_ SG_ 3221225472 RSPA_CamDis "RSPA_CameraDisplay";
CM_ SG_ 3221225472 RSPA_AvnHmiDis "RSPA_AvnHmiDisplay";
CM_ SG_ 3221225472 RSPA_BxHght "RSPA_BoxHeight";
CM_ SG_ 3221225472 RSPA_BxWidth "RSPA_BoxWidth";
CM_ SG_ 3221225472 RSPA_RtTrgtPosX "RSPA_RightTargetPosX";
CM_ SG_ 3221225472 RSPA_RtTrgtPosY "RSPA_RightTargetPosY";
CM_ SG_ 3221225472 RSPA_LftTrgtPosX "RSPA_LeftTargetPosX";
CM_ SG_ 3221225472 IAU_DigitalKeyOpt "Digital Key Option Signal";
CM_ SG_ 3221225472 IAU_ProfileIDRVal "This signal Indicate the Current detected Profile ID by IAU.";
CM_ SG_ 3221225472 IAU_DigitalKeyProcessingSta "Digital Key USM settitng Process State";
CM_ SG_ 3221225472 IAU_DigitalKeyExit "Digital Key USM setting Exit Condition";
CM_ SG_ 3221225472 IAU_DigitalKeyEnblRVal "Digital Key Function Enable / Disable flag (Fob is required for changing flag)";
CM_ SG_ 3221225472 IAU_OwnerPhnRegRVal "Vehicle Owner's Phone is Registered for Digital Key function";
CM_ SG_ 3221225472 IAU_NFCCard1RegRVal "NFC Card 1 is Registered for Digital Key function";
CM_ SG_ 3221225472 IAU_NFCCard2RegRVal "NFC Card 2 is Registered for Digital Key function";
CM_ SG_ 3221225472 IAU_RdyToSendAuthDataSta "This signal is sent when IAU is ready to send Authentication data";
CM_ SG_ 3221225472 IAU_OptTyp "IAU Option Info(NFC, FP, BLE, etc)";
CM_ SG_ 3221225472 IAU_ProfileIDParingRVal "This signal Indicate if the Current ProfileID is paired with Digital Key Device or not.";
CM_ SG_ 3221225472 MODE_MDPS_SET "This signal is for setting MDPS mode in the individual mode";
CM_ SG_ 3221225472 MODE_ECS_SET "This signal is for setting ECS mode in the individual mode.";
CM_ SG_ 3221225472 MODE_4WD_SET "This signal is for setting 4WD mode in the individual mode.";
CM_ SG_ 3221225472 MODE_BRAKE_SET "Request for Brake custom mode";
CM_ SG_ 3221225472 MODE_ENG_SET "This signal is for setting Engine mode in the individual mode";
CM_ SG_ 3221225472 PSB_Crc1Val "PSB_CyclicRedundancyCheck1Value";
CM_ SG_ 3221225472 PSB_AlvCnt1Val "PSB_AliveCounter1Value";
CM_ SG_ 3221225472 PSB_LHFlrSta "PSB_LeftHandedFailureStatus";
CM_ SG_ 3221225472 PSB_LHActvSta "PSB_LeftHandedActiveStatus";
CM_ SG_ 3221225472 PSB_RHFlrSta "PSB_RightHandedFailureStatus";
CM_ SG_ 3221225472 PSB_RHActvSta "PSB_RightHandedActiveStatus";
CM_ SG_ 3221225472 PSB_ActForAcu "PSB_ActiveForAcu";
CM_ SG_ 3221225472 POS_V2_Offset "Information for Position moving distance during Position Age.
-Transmitting Map Matching Moving Distance(m) of Vehicles for 200ms by this signal";
CM_ SG_ 3221225472 POS_V2_PathIndex "Information for Index of current path: If this number differs from one specified in previous POSITION message, vehicle left the original path.";
CM_ SG_ 3221225472 POS_V2_CyclicCounter "Information for Cyclic counter of this message type: Reconstructor can use this value to detect missing messages.";
CM_ SG_ 3221225472 POS_V2_RangeAvgSpeed "Information for Range camera average speed
(km/h)
This is used when entering the range camera area.";
CM_ SG_ 3221225472 POS_V2_CurrAltitude100m "Information for altitude(height) value of current position in 100m unit";
CM_ SG_ 3221225472 POS_V2_CurrAltitude1m "Information for altitude(height) value of current position in 1m unit";
CM_ SG_ 3221225472 POS_V2_CurrFuncRoadClass "Information for Functional Road Class of Current Position indicates relative importance of the road in the routing network and lower values indicate higher priority";
CM_ SG_ 3221225472 POS_V2_CurrFormOfWay "Information for Link Class Value of current position";
CM_ SG_ 3221225472 POS_V2_CurrDirectionLanes "Information for the Number of lanes in driving direction of current position";
CM_ SG_ 3221225472 POS_V2_CurrSpeedLimit "Information for Current Link Speed Limit of current position expressed as kph or mph according to META_SpeedUnit";
CM_ SG_ 3221225472 POS_V2_CurrTrafficSpeed "Information for the traffic speed of the current position expressed as kph or mph according to META speed unit";
CM_ SG_ 3221225472 VCU_Crc5Val "VCU_CyclicRedundancyCheck5Value";
CM_ SG_ 3221225472 VCU_EnergyFlowSta "VCU_EnergyFlowStatus ##2G##VCU - VCU5 - CF_Vcu_EvMod";
CM_ SG_ 3221225472 VCU_SbwWarnSndSta "VCU_SbwWarningSoundStatus ##2G##VCU - VCU20 - CF_Vcu_SbwWarnSnd";
CM_ SG_ 3221225472 VCU_EcoGuide_DispReq "VCU_EcoGuide_DisplayRequest ##2G##VCU - VCU7 - CF_Vcu_SmartEcoDisp";
CM_ SG_ 3221225472 VCU_EcoGuide_ApsGaugeVal "VCU_EcoGuide_ApsGaugeValue ##2G##VCU - VCU7 - CR_Vcu_SmartEcoLvl";
CM_ SG_ 3221225472 VCU_EcoGuide_EcoGaugeVal "VCU_EcoGuide_EcoGaugeValue ##2G##VCU - VCU7 - CR_Vcu_SmartEcoRng";
CM_ SG_ 3221225472 VCU_TgSocDteAcChgVal "VCU_TargetSocDte(Sc/Ac)ChargerValue ##2G##VCU - VCU19 - CR_Vcu_TgSocDte_AcChg";
CM_ SG_ 3221225472 VCU_TgSocDteDcChgVal "VCU_TargetSocDte(Qc/Dc)ChargerValue ##2G##VCU - VCU19 - CR_Vcu_TgSocDte_DcChg";
CM_ SG_ 3221225472 VCU_DistFromRegenDispReq "VCU_DistanceFromRegenerationDisplayRequest ##2G##VCU - VCU7 - CR_Vcu_RegenRangeAddSet";
CM_ SG_ 3221225472 VCU_DistFromRegenVal "VCU_DistanceFromRegenerationValue ##2G##VCU - VCU7 - CR_Vcu_RegenRangeAdd";
CM_ SG_ 3221225472 VCU_AlvCnt5Val "VCU_AliveCounter5Value";
CM_ SG_ 3221225472 VCU_DrvStyle_DispReq "VCU_DriveStyle_DisplayRequest ##2G##VCU - VCU7 - CF_Vcu_FueEffStat";
CM_ SG_ 3221225472 VCU_DrvStyle_HighLightSta "VCU_DriveStyle_HighLightStatus ##2G##VCU - VCU7 - CF_Vcu_FueEffStatBox";
CM_ SG_ 3221225472 VCU_DrvStyle_EcoVal "VCU_DriveStyle_EcoValue ##2G##VCU - VCU7 - CR_Vcu_HighFueEff_Pc";
CM_ SG_ 3221225472 VCU_DrvStyle_NonEcoVal "VCU_DriveStyle_NonEcoValue ##2G##VCU - VCU7 - CR_Vcu_LowFueEff_Pc";
CM_ SG_ 3221225472 VCU_DrvStyle_NorVal "VCU_DriveStyle_NorValue ##2G##VCU - VCU7 - CR_Vcu_NorFueEff_Pc";
CM_ SG_ 3221225472 VCU_EcoPotential_EcoVal "VCU_EcoPotential_EcoValue ##2G##VCU - VCU20 - CR_Vcu_EcoPotential_Eco";
CM_ SG_ 3221225472 VCU_EcoPotential_NorVal "VCU_EcoPotential_NormalValue ##2G##VCU - VCU20 - CR_Vcu_EcoPotential_Normal";
CM_ SG_ 3221225472 VCU_EcoPotential_SptVal "VCU_EcoPotential_SportValue ##2G##VCU - VCU20 - CR_Vcu_EcoPotential_Sport";
CM_ SG_ 3221225472 VCU_InstFuelEcoVal_Per100km "VCU_InstantFuelEconomy(kWh/100km) ##2G##VCU - VCU5 - CR_Vcu_FuelEco_KP100km";
CM_ SG_ 3221225472 VCU_InstFuelEcoVal_PerkWh "VCU_InstantFuelEconomyValue_(km/kWh) ##2G##VCU - VCU5 - CR_Vcu_FuelEco_KPK";
CM_ SG_ 3221225472 VCU_CO2RdcTripDistVal "VCU_CO2ReductionTripDistanceValue ##2G##VCU - VCU4 - CF_Vcu_CO2RdcTripDist";
CM_ SG_ 3221225472 VCU_EvDrvRdyCluDispSta "VCU_EvDriveReadyClusterDisplayStatus ##2G##VCU - VCU1 - CF_Vcu_EvRdyClu";
CM_ SG_ 3221225472 VCU_CO2RdcVal "VCU_CO2ReductionValue ##2G##VCU - VCU4 - CF_Vcu_CO2Rdc";
CM_ SG_ 3221225472 VCU_PwrDnModeSta "VCU_PowerDownModeStatus ##2G##VCU - VCU5 - CF_Vcu_PwrDnMode";
CM_ SG_ 3221225472 VCU_CluWarnMsgSta "VCU_ClusterWarningMessageStatus ##2G##VCU - VCU7 - CF_Vcu_WarnMsg";
CM_ SG_ 3221225472 VCU_DteOffDispSta "VCU_DteOffDisplayStatus ##2G##VCU - VCU5 - CF_Vcu_DteOff";
CM_ SG_ 3221225472 VCU_LowSocAlertSta "VCU_LowSocAlertStatus ##2G##VCU - VCU3 - CF_Vcu_LowSocAlert";
CM_ SG_ 3221225472 VCU_VcrmReq "VCU_VcrmRequest ##2G##VCU - VCU3 - CF_Vcu_Vcrm_Req";
CM_ SG_ 3221225472 VCU_PdlWarnMsgSta "VCU_PaddleWarningMassageStatus";
CM_ SG_ 3221225472 VCU_VirtualApsActSta "VCU_VirtualApsActivatedStatus ##2G##VCU - VCU1 - CF_Vcu_EstApsSel";
CM_ SG_ 3221225472 VCU_VirtualApsVal "VCU_VirtualApsValue ##2G##VCU - VCU1 - CR_Vcu_EstAccPed_PC";
CM_ SG_ 3221225472 VCU_ServiceLampReq "VCU_SeviceLampRequest ##2G##VCU - VCU5 - CF_Vcu_SerLamp";
CM_ SG_ 3221225472 VCU_ServiceModeSta "VCU_ServiceModeStatus ##2G##VCU - VCU2 - CF_Vcu_ServiceMod";
CM_ SG_ 3221225472 VCU_NPosWshModSta "VCU_NPositionWashModeStatus";
CM_ SG_ 3221225472 VCU_PowerTrainType "VCU_PowerTrainType";
CM_ SG_ 3221225472 VCU_DteBaseVal "VCU_DteBaseValue ##2G##VCU - VCU1 - CR_Vcu_DistEmpty_km(VCU6 - CR_Vcu_DistEmpty_km)";
CM_ SG_ 3221225472 VCU_AvnDteOnCalcSta "VCU_AvnDteOnCalculationStatus ##2G##VCU - VCU1 - CF_Vcu_AvnDteCalc(VCU6 - CF_Vcu_AvnDteCalc)";
CM_ SG_ 3221225472 VCU_SbwWarnMsgSta "VCU_SbwWarningMessageStatus ##2G##VCU - VCU20 - CF_Vcu_SbwWarnMsg";
CM_ SG_ 3221225472 VCU_DteNaviRouteVal "VCU_DteNaviRouteValue ##2G##VCU - VCU3 - CR_Vcu_DistEmptyAvn_km";
CM_ SG_ 3221225472 VCU_DteAddVal "VCU_DteAddedValue ##2G##VCU - VCU1 - CR_Vcu_DistEmptyAdd_km(VCU6 - CR_Vcu_DistEmptyAdd_km)";
CM_ SG_ 3221225472 VCU_PwrGaugeVal "VCU_PowerGaugeValue ##2G##VCU - VCU5 - CR_Vcu_TqMotClu_Pc";
CM_ SG_ 3221225472 HU_DistanceUnit "Request to set CLU Distance Unit";
CM_ SG_ 3221225472 HU_MicActivity "HU send this signal to eCall for MIC using status.
eCall unit stop the diagonosis when received 0x1:Activated from HU
Otherwise, eCall unit keep diagnosis every 1 sec. and HU can not use MIC";
CM_ SG_ 3221225472 AVN_RSPA_CancelInput "Request Signal to cancel RSPA function";
CM_ SG_ 3221225472 AVN_RSPA_ModeSetStat "Signal for User's RSPA mode setting
RSPA ��� ���� �޴� ���� ��� (������ ����)";
CM_ SG_ 3221225472 AVN_RSPA_Disp_Rdy "Signal to inform RSPA of AVN's display ready status
(RSPA ȭ�� ǥ�� ����/�Ұ��� ���¸� �˸��� ���� ��ȣ)";
CM_ SG_ 3221225472 CF_AVN_ProfileIDRValue "This signal is User ID value in H/Unit.";
CM_ SG_ 3221225472 HazardFromHUSVM "This signal is for Hazard control";
CM_ SG_ 3221225472 OMUOSMirCtrl "This signal is for the OutSide Mirror Control (Fold or Unfold)";
CM_ SG_ 3221225472 AVN_PDW_Input "This signal is for the PDW softkey";
CM_ SG_ 3221225472 AVN_RSPA_Input "This signal means RSPA softkey input(on/off)";
CM_ SG_ 3221225472 AVN_ParkingSW "This signal means whether ParkingSwich pressed or not";
CM_ SG_ 3221225472 HU_AliveStatus "Information of the status of Head Unit
0x00 : Headunit is booting so, Headunit cant display any state
0x01 : Headunit is normal state, Headunit could display according to MM CAN  command.
0x02 : Headunit is doing their internal process, so Headunit cant communicate with other node.
For CLU/SCC/eCall
-AVN System transmission signal";
CM_ SG_ 3221225472 C_MtnAlertClu "This signal is for check TMS active status";
BA_DEF_ BO_  "GenMsgEVName" STRING ;
BA_DEF_ BO_  "UsrMsgIDSforwardDeviation" INT 0 100;
BA_DEF_ BO_  "UsrMsgIDSbackwardDeviation" INT 50 1000;
BA_DEF_ BO_  "GenMsgCycleTime" INT 0 2000;
BA_DEF_ BO_  "GenMsgStartDelayTime" INT 0 2000;
BA_DEF_ BO_  "GenMsgSendType" ENUM  "Cyclic","NoMsgSendType";
BA_DEF_ BO_  "GenMsgCycleTimeFast" INT 0 500;
BA_DEF_ BO_  "GenMsgDelayTime" INT 0 20;
BA_DEF_ BO_  "GenMsgILSupport" ENUM  "No","Yes";
BA_DEF_ BO_  "GenMsgNrOfRepetition" INT 0 3;
BA_DEF_ BO_  "VFrameFormat" ENUM  "StandardCAN","ExtendedCAN","reserved","reserved","reserved","reserved","reserved","reserved","reserved","reserved","reserved","reserved","reserved","reserved","StandardCAN_FD","ExtendedCAN_FD";
BA_DEF_ SG_  "UserSigValidity" ENUM  "B+","ACC","IG","IG1","IG2","IG3","IG1 or IG2","IG1 or IG3","Undef";
BA_DEF_ SG_  "UsrSigPurpose" ENUM  "Undef","FN","DIAG","DIAG(Req)","DIAG(Res)","DIAG(Phy)","DEV","CCP(Req)","CCP(Res)","NM","TP";
BA_DEF_ SG_  "GenSigStartValue" INT 0 1215752192;
BA_DEF_ SG_  "NetworkRequest" ENUM  "Yes","No";
BA_DEF_ SG_  "NetworkRequestHoldingTime" INT 0 65535;
BA_DEF_ SG_  "Description" STRING ;
BA_DEF_ SG_  "Version" STRING ;
BA_DEF_ SG_  "GenSigEnvVarType" ENUM  "Int","Float","Undef";
BA_DEF_ SG_  "GenSigSendType" ENUM  "Cyclic","OnWrite","OnWriteWithRepetition","OnChange","OnChangeWithRepetition","IfActive","IfActiveWithRepetition","NoSigSendType","OnChangeAndIfActive","OnChangeAndIfActiveWithRepetition";
BA_DEF_ SG_  "GwSigLatencyTime" INT 0 65536;
BA_DEF_ SG_  "GwSigMissingSourceType" ENUM  "Undef","OldValue","DefaultValue","InitialValue";
BA_DEF_ SG_  "NWM-WakeupAllowed" ENUM  "<n.a.>";
BA_DEF_ SG_  "RoutingFactor" INT 1 1215752192;
BA_DEF_REL_ BU_SG_REL_  "GenSigTimeoutTime" INT 0 7000;
BA_DEF_DEF_  "GenMsgEVName" "@Signame";
BA_DEF_DEF_  "UsrMsgIDSforwardDeviation" 10;
BA_DEF_DEF_  "UsrMsgIDSbackwardDeviation" 100;
BA_DEF_DEF_  "GenMsgCycleTime" 200;
BA_DEF_DEF_  "GenMsgStartDelayTime" 0;
BA_DEF_DEF_  "GenMsgSendType" "NoMsgSendType";
BA_DEF_DEF_  "GenMsgCycleTimeFast" 40;
BA_DEF_DEF_  "GenMsgDelayTime" 20;
BA_DEF_DEF_  "GenMsgILSupport" "Yes";
BA_DEF_DEF_  "GenMsgNrOfRepetition" 3;
BA_DEF_DEF_  "VFrameFormat" "StandardCAN";
BA_DEF_DEF_  "UserSigValidity" "IG";
BA_DEF_DEF_  "UsrSigPurpose" "FN";
BA_DEF_DEF_  "GenSigStartValue" 0;
BA_DEF_DEF_  "NetworkRequest" "No";
BA_DEF_DEF_  "NetworkRequestHoldingTime" 0;
BA_DEF_DEF_  "Description" "";
BA_DEF_DEF_  "Version" "";
BA_DEF_DEF_  "GenSigEnvVarType" "Undef";
BA_DEF_DEF_  "GenSigSendType" "NoSigSendType";
BA_DEF_DEF_  "GwSigLatencyTime" 40;
BA_DEF_DEF_  "GwSigMissingSourceType" "Undef";
BA_DEF_DEF_  "NWM-WakeupAllowed" "<n.a.>";
BA_DEF_DEF_  "RoutingFactor" 1;
BA_DEF_DEF_REL_ "GenSigTimeoutTime" 500;
BA_ "Version" SG_ 3221225472 PA_FrRtWrngAlrmReq "17.11.00";
BA_ "RoutingFactor" SG_ 3221225472 PA_FrRtWrngAlrmReq 5;
BA_ "UserSigValidity" SG_ 3221225472 PA_FrRtWrngAlrmReq 3;
BA_ "Description" SG_ 3221225472 PA_FrRtWrngAlrmReq "This signal is used for front right warning alarm of PA/PDW for EXP AMP";
BA_ "Version" SG_ 3221225472 PA_RrLftWrngAlrmReq "17.11.00";
BA_ "RoutingFactor" SG_ 3221225472 PA_RrLftWrngAlrmReq 5;
BA_ "UserSigValidity" SG_ 3221225472 PA_RrLftWrngAlrmReq 3;
BA_ "Description" SG_ 3221225472 PA_RrLftWrngAlrmReq "This signal is used for rear left warning alarm of PA/PDW for EXP AMP";
BA_ "Version" SG_ 3221225472 PA_RrCtrWrngAlrmReq "17.11.00";
BA_ "RoutingFactor" SG_ 3221225472 PA_RrCtrWrngAlrmReq 5;
BA_ "UserSigValidity" SG_ 3221225472 PA_RrCtrWrngAlrmReq 3;
BA_ "Description" SG_ 3221225472 PA_RrCtrWrngAlrmReq "This signal is used for rear center warning alarm of PA/PDW for EXP AMP";
BA_ "Version" SG_ 3221225472 PA_RrRtWrngAlrmReq "17.11.00";
BA_ "RoutingFactor" SG_ 3221225472 PA_RrRtWrngAlrmReq 5;
BA_ "UserSigValidity" SG_ 3221225472 PA_RrRtWrngAlrmReq 3;
BA_ "Description" SG_ 3221225472 PA_RrRtWrngAlrmReq "This signal is used for rear right warning alarm of PA/PDW for EXP AMP";
BA_ "Version" SG_ 3221225472 PA_Sta "17.12.03";
BA_ "RoutingFactor" SG_ 3221225472 PA_Sta 5;
BA_ "UserSigValidity" SG_ 3221225472 PA_Sta 3;
BA_ "GenSigStartValue" SG_ 3221225472 PA_Sta 1;
BA_ "Description" SG_ 3221225472 PA_Sta "This signal indicates the status of the PA steering activation machine. 



 <Fuction>

0H : Reserved

1H : Initial value after ignition

2H : Request of a new start status after an abort of the MDPS

3H : StandBy status of the PA function. No error and ";
BA_ "Version" SG_ 3221225472 PA_TestModSta "17.11.00";
BA_ "RoutingFactor" SG_ 3221225472 PA_TestModSta 5;
BA_ "UserSigValidity" SG_ 3221225472 PA_TestModSta 3;
BA_ "Description" SG_ 3221225472 PA_TestModSta "This signal indicates the status of the �� MDPS Activation control for testing the PA system��";
BA_ "Version" SG_ 3221225472 PA_StrAnglReq "17.11.00";
BA_ "RoutingFactor" SG_ 3221225472 PA_StrAnglReq 5;
BA_ "UserSigValidity" SG_ 3221225472 PA_StrAnglReq 3;
BA_ "Description" SG_ 3221225472 PA_StrAnglReq "This value is used to set a steering wheel position target for the PA function. The signal is signed 16bits.



Conversion: (PH) = (HEX) x 0.1 (for 0< HEX < 32767) OR

(HEX - 65536) x 0.1 (for HEX > 32767)";
BA_ "Version" SG_ 3221225472 ADAS_CMD_Crc10Val "18.11.08";
BA_ "RoutingFactor" SG_ 3221225472 ADAS_CMD_Crc10Val 5;
BA_ "UserSigValidity" SG_ 3221225472 ADAS_CMD_Crc10Val 3;
BA_ "GenSigStartValue" SG_ 3221225472 ADAS_CMD_Crc10Val 65535;
BA_ "Description" SG_ 3221225472 ADAS_CMD_Crc10Val "The data area for CRC calculation is based on the data length (DLC) of the message DB.

The CRC shall be calculated over the entire data block (excluding the CRC bytes) including the user data, alive counter and Data ID

 

- CRC Polynomial (0x1021) , In";
BA_ "Version" SG_ 3221225472 ADAS_CMD_AlvCnt10Val "18.11.08";
BA_ "RoutingFactor" SG_ 3221225472 ADAS_CMD_AlvCnt10Val 5;
BA_ "UserSigValidity" SG_ 3221225472 ADAS_CMD_AlvCnt10Val 3;
BA_ "Description" SG_ 3221225472 ADAS_CMD_AlvCnt10Val "For the first transmission request for a data element the counter shall be initialized with 0 and shall be incremented by 1 for every subsequent send request. 

When the counter reaches the maximum value(0xFF), then it shall restart with 0 for the next s";
BA_ "Version" SG_ 3221225472 FCA_OnOffEquipSta "17.12.00";
BA_ "RoutingFactor" SG_ 3221225472 FCA_OnOffEquipSta 5;
BA_ "UserSigValidity" SG_ 3221225472 FCA_OnOffEquipSta 3;
BA_ "Description" SG_ 3221225472 FCA_OnOffEquipSta "This signal describes the FCA Function.

- �ý��� ���� ���� �� �ý��� on/off ����";
BA_ "Version" SG_ 3221225472 FCA_SysFlrSta "19.03.07";
BA_ "RoutingFactor" SG_ 3221225472 FCA_SysFlrSta 5;
BA_ "UserSigValidity" SG_ 3221225472 FCA_SysFlrSta 3;
BA_ "Description" SG_ 3221225472 FCA_SysFlrSta "This signal describes the failure information of FCA Function.

- �ý��� ���� �Ǵ� ī�޶�/���̴�/�ý��� ������� ����

0x1:Front View Camera Blockage for sensor fusion without ADAS_DRV

0x4:Front View Camera Blockage for Front View Camera only

0x5:Front";
BA_ "Version" SG_ 3221225472 FCA_WrngLvlSta "17.12.00";
BA_ "RoutingFactor" SG_ 3221225472 FCA_WrngLvlSta 5;
BA_ "UserSigValidity" SG_ 3221225472 FCA_WrngLvlSta 3;
BA_ "Description" SG_ 3221225472 FCA_WrngLvlSta "Request CLU to activate the corresponding warning device(s) according to the FCA warning level.

- FCA 1��/2��/3�� �۵� ���� ǥ�ÿ� ������ȣ";
BA_ "Version" SG_ 3221225472 FCA_VehStpReq "17.12.00";
BA_ "RoutingFactor" SG_ 3221225472 FCA_VehStpReq 5;
BA_ "UserSigValidity" SG_ 3221225472 FCA_VehStpReq 3;
BA_ "Description" SG_ 3221225472 FCA_VehStpReq "A control request flag for vehicle stop. FCA expects vehicle to be controlled to a complete stop and hold its state by ESC.



- FCA ������Ȳ ������ ���� ���� ������ ���� ��ȣ";
BA_ "Version" SG_ 3221225472 FCA_StbltActvReq "17.12.00";
BA_ "RoutingFactor" SG_ 3221225472 FCA_StbltActvReq 5;
BA_ "UserSigValidity" SG_ 3221225472 FCA_StbltActvReq 3;
BA_ "Description" SG_ 3221225472 FCA_StbltActvReq "Depending on the driving situation, FCA tells PSB to release(no alert), retract or pull the seat belt for occupant protection or warning.

- FCA ������Ȳ�� ��Ʈ��Ʈ �۵��� ���� ���� ��ȣ";
BA_ "Version" SG_ 3221225472 FCA_HydrlcBstAsstReq "17.12.00";
BA_ "RoutingFactor" SG_ 3221225472 FCA_HydrlcBstAsstReq 5;
BA_ "UserSigValidity" SG_ 3221225472 FCA_HydrlcBstAsstReq 3;
BA_ "Description" SG_ 3221225472 FCA_HydrlcBstAsstReq "Depending on the driving situation, FCA tells ESC to use lowered HBA (Hydraulic Boost Assist) threshold to sensitize the HBA entrance. 

The boost assist function is more easily activated than under normal driving condition.

- FCA ������Ȳ�� HBA �۵��� ";
BA_ "Version" SG_ 3221225472 FCA_DclReqVal "17.12.00";
BA_ "RoutingFactor" SG_ 3221225472 FCA_DclReqVal 5;
BA_ "UserSigValidity" SG_ 3221225472 FCA_DclReqVal 3;
BA_ "Description" SG_ 3221225472 FCA_DclReqVal "Depending on the driving situation, FCA gives ESC the deceleration command. ESC maintains the deceleration.

- FCA ������ ���� �䱸 ���ӵ� ��";
BA_ "Version" SG_ 3221225472 FCA_PrefillActvReq "17.12.00";
BA_ "RoutingFactor" SG_ 3221225472 FCA_PrefillActvReq 5;
BA_ "UserSigValidity" SG_ 3221225472 FCA_PrefillActvReq 3;
BA_ "Description" SG_ 3221225472 FCA_PrefillActvReq "A control requeset flag for FCA first warning. (Audible Warning)

- FCA 1�� ������Ȳ ��û��ȣ";
BA_ "Version" SG_ 3221225472 FCA_PartialActvReq "17.11.00";
BA_ "RoutingFactor" SG_ 3221225472 FCA_PartialActvReq 5;
BA_ "UserSigValidity" SG_ 3221225472 FCA_PartialActvReq 3;
BA_ "Description" SG_ 3221225472 FCA_PartialActvReq "A control requeset flag for FCA second warning. (Partial braking)

- FCA 2�� ������Ȳ ��û��ȣ";
BA_ "Version" SG_ 3221225472 FCA_FullActvReq "17.11.00";
BA_ "RoutingFactor" SG_ 3221225472 FCA_FullActvReq 5;
BA_ "UserSigValidity" SG_ 3221225472 FCA_FullActvReq 3;
BA_ "Description" SG_ 3221225472 FCA_FullActvReq "A control requeset flag for FCA third warning. (Full braking)

- FCA 3�� ������Ȳ ��û��ȣ";
BA_ "Version" SG_ 3221225472 FCA_SnstvtyModRetVal "17.12.00";
BA_ "RoutingFactor" SG_ 3221225472 FCA_SnstvtyModRetVal 5;
BA_ "UserSigValidity" SG_ 3221225472 FCA_SnstvtyModRetVal 3;
BA_ "Description" SG_ 3221225472 FCA_SnstvtyModRetVal "This signal is FCA sensitive set mode switch(USM) info return value to cluster.

- FCA �ΰ��� ���� ���� USM ���� ����ġ ������ ���� ��";
BA_ "Version" SG_ 3221225472 FCA_WrngSndSta "18.12.04";
BA_ "RoutingFactor" SG_ 3221225472 FCA_WrngSndSta 5;
BA_ "UserSigValidity" SG_ 3221225472 FCA_WrngSndSta 3;
BA_ "Description" SG_ 3221225472 FCA_WrngSndSta "FCA warning sound status";
BA_ "Version" SG_ 3221225472 FCA_RelVel "17.12.00";
BA_ "RoutingFactor" SG_ 3221225472 FCA_RelVel 5;
BA_ "UserSigValidity" SG_ 3221225472 FCA_RelVel 3;
BA_ "Description" SG_ 3221225472 FCA_RelVel "This signal indicates the relative velocity between the host vehicle and a forward vehicle.







(PH) = ((HEX)-0FFH)*0.1 [m/s/digit]



       = (HEX)*0.1 [m/s/digit] - 25.5 [m/s]



CAN Message Physical range : Max. Relative velocity : 0x1FE(25.5m/s),";
BA_ "Version" SG_ 3221225472 FCA_TimetoCllsn "19.06.03";
BA_ "RoutingFactor" SG_ 3221225472 FCA_TimetoCllsn 5;
BA_ "UserSigValidity" SG_ 3221225472 FCA_TimetoCllsn 3;
BA_ "GenSigStartValue" SG_ 3221225472 FCA_TimetoCllsn 254;
BA_ "Description" SG_ 3221225472 FCA_TimetoCllsn "This signal indicates predictive time to Collision between the host vehicle and a forward vehicle.







(PH) = 10*(HEX) [ms]



CAN Message Physical range : 0 ~ 2540 [ms], Resolution : 10ms";
BA_ "Version" SG_ 3221225472 Nmode_FCAOff_Sta "17.12.00";
BA_ "RoutingFactor" SG_ 3221225472 Nmode_FCAOff_Sta 5;
BA_ "UserSigValidity" SG_ 3221225472 Nmode_FCAOff_Sta 3;
BA_ "Description" SG_ 3221225472 Nmode_FCAOff_Sta "This signal describes status of FCA off when Nmode on";
BA_ "Version" SG_ 3221225472 FCA_Jnctn_OnOffEquipSta "17.11.00";
BA_ "RoutingFactor" SG_ 3221225472 FCA_Jnctn_OnOffEquipSta 5;
BA_ "UserSigValidity" SG_ 3221225472 FCA_Jnctn_OnOffEquipSta 3;
BA_ "Description" SG_ 3221225472 FCA_Jnctn_OnOffEquipSta "This signal describes the FCA-JC Function.

- �ý��� ���� ���� �� �ý��� on/off ����";
BA_ "Version" SG_ 3221225472 FCA_WrngTrgtDis "17.12.03";
BA_ "RoutingFactor" SG_ 3221225472 FCA_WrngTrgtDis 5;
BA_ "UserSigValidity" SG_ 3221225472 FCA_WrngTrgtDis 3;
BA_ "Description" SG_ 3221225472 FCA_WrngTrgtDis "Request CLU to activate the corresponding warning device(s) according to the type of FCA warning target.

- FCA ��� ��� ������ ǥ�� ������ȣ";
BA_ "Version" SG_ 3221225472 ADAS_DRV_FCA_Plus_Sta "18.08.06";
BA_ "RoutingFactor" SG_ 3221225472 ADAS_DRV_FCA_Plus_Sta 5;
BA_ "UserSigValidity" SG_ 3221225472 ADAS_DRV_FCA_Plus_Sta 3;
BA_ "Description" SG_ 3221225472 ADAS_DRV_FCA_Plus_Sta "����ī�޶�, ���淹�̴� �� ������ ���̴�/������ ������ ǻ�� Ʈ���� ���� FCA-Car Ÿ�� �� ���� ����/���� ���� ȸ�� �Ұ��� ���θ� �Ǵ��Ͽ� FCA-Car/Ped/Cyc+ Flag�� �����";
BA_ "Version" SG_ 3221225472 ECS_Crc3Val "18.11.08";
BA_ "RoutingFactor" SG_ 3221225472 ECS_Crc3Val 5;
BA_ "UserSigValidity" SG_ 3221225472 ECS_Crc3Val 3;
BA_ "GenSigStartValue" SG_ 3221225472 ECS_Crc3Val 65535;
BA_ "Description" SG_ 3221225472 ECS_Crc3Val "The data area for CRC calculation is based on the data length (DLC) of the message DB.

The CRC shall be calculated over the entire data block (excluding the CRC bytes) including the user data, alive counter and Data ID

 

- CRC Polynomial (0x1021) , In";
BA_ "Version" SG_ 3221225472 ECSIVSS_RREstDmpVelVal "18.03.06";
BA_ "RoutingFactor" SG_ 3221225472 ECSIVSS_RREstDmpVelVal 5;
BA_ "UserSigValidity" SG_ 3221225472 ECSIVSS_RREstDmpVelVal 3;
BA_ "Description" SG_ 3221225472 ECSIVSS_RREstDmpVelVal "Estimated Damper Velocity - RR

- Physical Range: -640 mm/s ~ 635 mm/s with factor 1";
BA_ "Version" SG_ 3221225472 ECSIVSS_DmpCtrlrErrSta "18.07.04";
BA_ "RoutingFactor" SG_ 3221225472 ECSIVSS_DmpCtrlrErrSta 5;
BA_ "UserSigValidity" SG_ 3221225472 ECSIVSS_DmpCtrlrErrSta 3;
BA_ "Description" SG_ 3221225472 ECSIVSS_DmpCtrlrErrSta "ECS Damper Controller Error Status";
BA_ "Version" SG_ 3221225472 ECSIVSS_IVSSCtrlrErrSta "18.07.04";
BA_ "RoutingFactor" SG_ 3221225472 ECSIVSS_IVSSCtrlrErrSta 5;
BA_ "UserSigValidity" SG_ 3221225472 ECSIVSS_IVSSCtrlrErrSta 3;
BA_ "Description" SG_ 3221225472 ECSIVSS_IVSSCtrlrErrSta "IVSS Controller Error Status";
BA_ "Version" SG_ 3221225472 ECSIVSS_AntRollCtrlSta "18.07.04";
BA_ "RoutingFactor" SG_ 3221225472 ECSIVSS_AntRollCtrlSta 5;
BA_ "UserSigValidity" SG_ 3221225472 ECSIVSS_AntRollCtrlSta 3;
BA_ "Description" SG_ 3221225472 ECSIVSS_AntRollCtrlSta "Anti-Roll Control Activation Status";
BA_ "Version" SG_ 3221225472 ECSIVSS_FLCtrlSta "18.12.01";
BA_ "RoutingFactor" SG_ 3221225472 ECSIVSS_FLCtrlSta 5;
BA_ "UserSigValidity" SG_ 3221225472 ECSIVSS_FLCtrlSta 3;
BA_ "Description" SG_ 3221225472 ECSIVSS_FLCtrlSta "ECS Control System Status - FL";
BA_ "Version" SG_ 3221225472 ECSIVSS_FRCtrlSta "18.12.01";
BA_ "RoutingFactor" SG_ 3221225472 ECSIVSS_FRCtrlSta 5;
BA_ "UserSigValidity" SG_ 3221225472 ECSIVSS_FRCtrlSta 3;
BA_ "Description" SG_ 3221225472 ECSIVSS_FRCtrlSta "ECS Control System Status ? FR";
BA_ "Version" SG_ 3221225472 ECSIVSS_RLCtrlSta "18.12.01";
BA_ "RoutingFactor" SG_ 3221225472 ECSIVSS_RLCtrlSta 5;
BA_ "UserSigValidity" SG_ 3221225472 ECSIVSS_RLCtrlSta 3;
BA_ "Description" SG_ 3221225472 ECSIVSS_RLCtrlSta "ECS Control System Status ? RL";
BA_ "Version" SG_ 3221225472 ECSIVSS_RRCtrlSta "18.12.01";
BA_ "RoutingFactor" SG_ 3221225472 ECSIVSS_RRCtrlSta 5;
BA_ "UserSigValidity" SG_ 3221225472 ECSIVSS_RRCtrlSta 3;
BA_ "Description" SG_ 3221225472 ECSIVSS_RRCtrlSta "ECS Control System Status - RR";
BA_ "Version" SG_ 3221225472 ECS_AlvCnt3Val "18.11.08";
BA_ "RoutingFactor" SG_ 3221225472 ECS_AlvCnt3Val 5;
BA_ "UserSigValidity" SG_ 3221225472 ECS_AlvCnt3Val 3;
BA_ "Description" SG_ 3221225472 ECS_AlvCnt3Val "For the first transmission request for a data element the counter shall be initialized with 0 and shall be incremented by 1 for every subsequent send request. 

When the counter reaches the maximum value(0xFF), then it shall restart with 0 for the next s";
BA_ "Version" SG_ 3221225472 ECSIVSS_FLFinCurrentVal "18.11.01";
BA_ "RoutingFactor" SG_ 3221225472 ECSIVSS_FLFinCurrentVal 5;
BA_ "UserSigValidity" SG_ 3221225472 ECSIVSS_FLFinCurrentVal 3;
BA_ "Description" SG_ 3221225472 ECSIVSS_FLFinCurrentVal "ECS Final Current FL (%)

- 0%: Full Soft, 100%: Full Hard

- 0x00~0xC8:0~100%/0xC9~0xFE:Not used/0xFF:Invalid";
BA_ "Version" SG_ 3221225472 ECSIVSS_FRFinCurrentVal "18.11.01";
BA_ "RoutingFactor" SG_ 3221225472 ECSIVSS_FRFinCurrentVal 5;
BA_ "UserSigValidity" SG_ 3221225472 ECSIVSS_FRFinCurrentVal 3;
BA_ "Description" SG_ 3221225472 ECSIVSS_FRFinCurrentVal "ECS Final Current FR (%)

- 0%: Full Soft, 100%: Full Hard

- 0x00~0xC8:0~100%/0xC9~0xFE:Not used/0xFF:Invalid";
BA_ "Version" SG_ 3221225472 ECSIVSS_RLFinCurrentVal "18.11.01";
BA_ "RoutingFactor" SG_ 3221225472 ECSIVSS_RLFinCurrentVal 5;
BA_ "UserSigValidity" SG_ 3221225472 ECSIVSS_RLFinCurrentVal 3;
BA_ "Description" SG_ 3221225472 ECSIVSS_RLFinCurrentVal "ECS Final Current RL (%)

- 0%: Full Soft, 100%: Full Hard

- 0x00~0xC8:0~100%/0xC9~0xFE:Not used/0xFF:Invalid";
BA_ "Version" SG_ 3221225472 ECSIVSS_RRFinCurrentVal "18.11.01";
BA_ "RoutingFactor" SG_ 3221225472 ECSIVSS_RRFinCurrentVal 5;
BA_ "UserSigValidity" SG_ 3221225472 ECSIVSS_RRFinCurrentVal 3;
BA_ "Description" SG_ 3221225472 ECSIVSS_RRFinCurrentVal "ECS Final Current RR (%)

- 0%: Full Soft, 100%: Full Hard

- 0x00~0xC8:0~100%/0xC9~0xFE:Not used/0xFF:Invalid";
BA_ "Version" SG_ 3221225472 ECSIVSS_FLEstDmpVelVal "18.03.06";
BA_ "RoutingFactor" SG_ 3221225472 ECSIVSS_FLEstDmpVelVal 5;
BA_ "UserSigValidity" SG_ 3221225472 ECSIVSS_FLEstDmpVelVal 3;
BA_ "Description" SG_ 3221225472 ECSIVSS_FLEstDmpVelVal "Estimated Damper Velocity - FL

- Physical Range: -640 mm/s ~ 635 mm/s with factor 1";
BA_ "Version" SG_ 3221225472 ECSIVSS_FREstDmpVelVal "18.03.06";
BA_ "RoutingFactor" SG_ 3221225472 ECSIVSS_FREstDmpVelVal 5;
BA_ "UserSigValidity" SG_ 3221225472 ECSIVSS_FREstDmpVelVal 3;
BA_ "Description" SG_ 3221225472 ECSIVSS_FREstDmpVelVal "Estimated Damper Velocity - FR

- Physical Range: -640 mm/s ~ 635 mm/s with factor 1";
BA_ "Version" SG_ 3221225472 ECSIVSS_RLEstDmpVelVal "18.03.06";
BA_ "RoutingFactor" SG_ 3221225472 ECSIVSS_RLEstDmpVelVal 5;
BA_ "UserSigValidity" SG_ 3221225472 ECSIVSS_RLEstDmpVelVal 3;
BA_ "Description" SG_ 3221225472 ECSIVSS_RLEstDmpVelVal "Estimated Damper Velocity - RL

- Physical Range: -640 mm/s ~ 635 mm/s with factor 1";
BA_ "Version" SG_ 3221225472 ADAS_PRK_Crc3Val "18.11.08";
BA_ "RoutingFactor" SG_ 3221225472 ADAS_PRK_Crc3Val 5;
BA_ "UserSigValidity" SG_ 3221225472 ADAS_PRK_Crc3Val 3;
BA_ "GenSigStartValue" SG_ 3221225472 ADAS_PRK_Crc3Val 65535;
BA_ "Description" SG_ 3221225472 ADAS_PRK_Crc3Val "The data area for CRC calculation is based on the data length (DLC) of the message DB.

The CRC shall be calculated over the entire data block (excluding the CRC bytes) including the user data, alive counter and Data ID

 

- CRC Polynomial (0x1021) , In";
BA_ "Version" SG_ 3221225472 RSPA_LftTrgtPosY "18.12.07";
BA_ "RoutingFactor" SG_ 3221225472 RSPA_LftTrgtPosY 5;
BA_ "UserSigValidity" SG_ 3221225472 RSPA_LftTrgtPosY 3;
BA_ "Description" SG_ 3221225472 RSPA_LftTrgtPosY "AVM ǥ�� ���� �������� ��ġ Y ��ǥ";
BA_ "Version" SG_ 3221225472 RSPA_Sta "19.03.11";
BA_ "RoutingFactor" SG_ 3221225472 RSPA_Sta 5;
BA_ "UserSigValidity" SG_ 3221225472 RSPA_Sta 3;
BA_ "GenSigStartValue" SG_ 3221225472 RSPA_Sta 1;
BA_ "Description" SG_ 3221225472 RSPA_Sta "���� RSPA�� ����";
BA_ "Version" SG_ 3221225472 RSPA_Actv "17.11.00";
BA_ "RoutingFactor" SG_ 3221225472 RSPA_Actv 5;
BA_ "UserSigValidity" SG_ 3221225472 RSPA_Actv 3;
BA_ "Description" SG_ 3221225472 RSPA_Actv "RSPA's activation information";
BA_ "Version" SG_ 3221225472 RSPA_TrgtGearSta "17.11.00";
BA_ "RoutingFactor" SG_ 3221225472 RSPA_TrgtGearSta 5;
BA_ "UserSigValidity" SG_ 3221225472 RSPA_TrgtGearSta 3;
BA_ "Description" SG_ 3221225472 RSPA_TrgtGearSta "��ǥ ���Ӵ� 

(��ǥ ���Ӵ� 100ms ������ Idle �� ����, ��ǥ�� rising ���� 500ms ���)";
BA_ "Version" SG_ 3221225472 RSPA_EpbReq "19.03.11";
BA_ "RoutingFactor" SG_ 3221225472 RSPA_EpbReq 5;
BA_ "UserSigValidity" SG_ 3221225472 RSPA_EpbReq 3;
BA_ "Description" SG_ 3221225472 RSPA_EpbReq "EPB ü��/���� ��û (AHB ��ȸ)";
BA_ "Version" SG_ 3221225472 RSPA_ExtLampReq "17.11.00";
BA_ "RoutingFactor" SG_ 3221225472 RSPA_ExtLampReq 5;
BA_ "UserSigValidity" SG_ 3221225472 RSPA_ExtLampReq 3;
BA_ "Description" SG_ 3221225472 RSPA_ExtLampReq "������, �������õ� ���� ��û (RSPA ��)

Type1:���� 1ȸ Normal Blinking

Type2:���� 2ȸ Normal Blinking

Type3:���� 3ȸ Normal Blinking

Type4:���� ���������� Normal Blinking";
BA_ "Version" SG_ 3221225472 RSPA_CrankingReq "17.11.00";
BA_ "RoutingFactor" SG_ 3221225472 RSPA_CrankingReq 5;
BA_ "UserSigValidity" SG_ 3221225472 RSPA_CrankingReq 3;
BA_ "Description" SG_ 3221225472 RSPA_CrankingReq "�õ���� õ�� ��û (RSPA ��)";
BA_ "Version" SG_ 3221225472 RSPA_IdOutWarnReq "17.11.00";
BA_ "RoutingFactor" SG_ 3221225472 RSPA_IdOutWarnReq 5;
BA_ "UserSigValidity" SG_ 3221225472 RSPA_IdOutWarnReq 3;
BA_ "Description" SG_ 3221225472 RSPA_IdOutWarnReq "ID out ���� ���� ��û (RSPA ��)";
BA_ "Version" SG_ 3221225472 RSPA_IndBlnkReq "17.11.00";
BA_ "RoutingFactor" SG_ 3221225472 RSPA_IndBlnkReq 5;
BA_ "UserSigValidity" SG_ 3221225472 RSPA_IndBlnkReq 3;
BA_ "Description" SG_ 3221225472 RSPA_IndBlnkReq "FOB blinking request during RSPA mode";
BA_ "Version" SG_ 3221225472 RSPA_SysOff "18.12.07";
BA_ "RoutingFactor" SG_ 3221225472 RSPA_SysOff 5;
BA_ "UserSigValidity" SG_ 3221225472 RSPA_SysOff 3;
BA_ "Description" SG_ 3221225472 RSPA_SysOff "System off status for Smartphone display before RSPA control";
BA_ "Version" SG_ 3221225472 RSPA_DccCmd "17.11.00";
BA_ "RoutingFactor" SG_ 3221225472 RSPA_DccCmd 5;
BA_ "UserSigValidity" SG_ 3221225472 RSPA_DccCmd 3;
BA_ "Description" SG_ 3221225472 RSPA_DccCmd "��ǥ ���ӵ�, ���� ���� �ÿ���(when RSPA_VS=0) ���ӵ� �������";
BA_ "Version" SG_ 3221225472 RSPA_StopReq "17.11.00";
BA_ "RoutingFactor" SG_ 3221225472 RSPA_StopReq 5;
BA_ "UserSigValidity" SG_ 3221225472 RSPA_StopReq 3;
BA_ "Description" SG_ 3221225472 RSPA_StopReq "A control request flag for vehicle stop. RSPA expects vehicle to be controlled to a complete stop and hold its state.";
BA_ "Version" SG_ 3221225472 RSPA_SelDevInfo "18.12.07";
BA_ "RoutingFactor" SG_ 3221225472 RSPA_SelDevInfo 5;
BA_ "UserSigValidity" SG_ 3221225472 RSPA_SelDevInfo 3;
BA_ "Description" SG_ 3221225472 RSPA_SelDevInfo "Device information for Remote Control in operation of RSPA";
BA_ "Version" SG_ 3221225472 RSPA_SelFuncInfo "18.12.07";
BA_ "RoutingFactor" SG_ 3221225472 RSPA_SelFuncInfo 5;
BA_ "UserSigValidity" SG_ 3221225472 RSPA_SelFuncInfo 3;
BA_ "Description" SG_ 3221225472 RSPA_SelFuncInfo "Function information in operation of RSPA for SmartPhone control";
BA_ "Version" SG_ 3221225472 RSPA_TrgtVehSpdVal "18.07.01";
BA_ "RoutingFactor" SG_ 3221225472 RSPA_TrgtVehSpdVal 5;
BA_ "UserSigValidity" SG_ 3221225472 RSPA_TrgtVehSpdVal 3;
BA_ "Description" SG_ 3221225472 RSPA_TrgtVehSpdVal "���� ��û��, ���� �������� ���� (0 �� 10.23)";
BA_ "Version" SG_ 3221225472 ADAS_PRK_AlvCnt3Val "18.11.08";
BA_ "RoutingFactor" SG_ 3221225472 ADAS_PRK_AlvCnt3Val 5;
BA_ "UserSigValidity" SG_ 3221225472 ADAS_PRK_AlvCnt3Val 3;
BA_ "Description" SG_ 3221225472 ADAS_PRK_AlvCnt3Val "For the first transmission request for a data element the counter shall be initialized with 0 and shall be incremented by 1 for every subsequent send request. 

When the counter reaches the maximum value(0xFF), then it shall restart with 0 for the next s";
BA_ "Version" SG_ 3221225472 RSPA_AddtnlAccelActv "17.11.00";
BA_ "RoutingFactor" SG_ 3221225472 RSPA_AddtnlAccelActv 5;
BA_ "UserSigValidity" SG_ 3221225472 RSPA_AddtnlAccelActv 3;
BA_ "Description" SG_ 3221225472 RSPA_AddtnlAccelActv "RSPA additional acceleration control ON";
BA_ "Version" SG_ 3221225472 RSPA_Opt "17.12.03";
BA_ "RoutingFactor" SG_ 3221225472 RSPA_Opt 5;
BA_ "UserSigValidity" SG_ 3221225472 RSPA_Opt 3;
BA_ "Description" SG_ 3221225472 RSPA_Opt "RSPA Option applied information";
BA_ "Version" SG_ 3221225472 RSPA_TrgtTqVal "19.06.00";
BA_ "RoutingFactor" SG_ 3221225472 RSPA_TrgtTqVal 5;
BA_ "UserSigValidity" SG_ 3221225472 RSPA_TrgtTqVal 3;
BA_ "Description" SG_ 3221225472 RSPA_TrgtTqVal "RSPA request EMS/HCU/VCU/FCU torque value (Nm)

Init value : 00h

If MSB is 1, this signal is - value.

else, this signal is +value.

0~10bit is used for absolute value.";
BA_ "Version" SG_ 3221225472 RSPA_DCTTrgtTqVal "17.11.00";
BA_ "RoutingFactor" SG_ 3221225472 RSPA_DCTTrgtTqVal 5;
BA_ "UserSigValidity" SG_ 3221225472 RSPA_DCTTrgtTqVal 3;
BA_ "Description" SG_ 3221225472 RSPA_DCTTrgtTqVal "Init value : 00h

Value : 0 �� 99.6094 [%]

Physical range : 00h �� FFh  

Conversion : (PH) = 0.390625 * (HEX) [%]";
BA_ "Version" SG_ 3221225472 RSPA_RtTrgtDir "18.07.01";
BA_ "RoutingFactor" SG_ 3221225472 RSPA_RtTrgtDir 5;
BA_ "UserSigValidity" SG_ 3221225472 RSPA_RtTrgtDir 3;
BA_ "Description" SG_ 3221225472 RSPA_RtTrgtDir "SVM ǥ�� ������ ���� ���� ����";
BA_ "Version" SG_ 3221225472 RSPA_LftTrgtDir "18.07.01";
BA_ "RoutingFactor" SG_ 3221225472 RSPA_LftTrgtDir 5;
BA_ "UserSigValidity" SG_ 3221225472 RSPA_LftTrgtDir 3;
BA_ "Description" SG_ 3221225472 RSPA_LftTrgtDir "SVM ǥ�� ���� ���� ���� ����";
BA_ "Version" SG_ 3221225472 RSPA_AvnDis "17.11.00";
BA_ "RoutingFactor" SG_ 3221225472 RSPA_AvnDis 5;
BA_ "UserSigValidity" SG_ 3221225472 RSPA_AvnDis 3;
BA_ "Description" SG_ 3221225472 RSPA_AvnDis "AVN ȭ�� ��� ��û (RSPA ��)

'-CGW routing �ʿ� (CCAN to MMCAN)";
BA_ "Version" SG_ 3221225472 RSPA_AvnModDis "17.11.00";
BA_ "RoutingFactor" SG_ 3221225472 RSPA_AvnModDis 5;
BA_ "UserSigValidity" SG_ 3221225472 RSPA_AvnModDis 3;
BA_ "Description" SG_ 3221225472 RSPA_AvnModDis "AVN���� ��弱�� �޴� ǥ���� ���� ����/���� ���� ����

'-CGW routing �ʿ� (CCAN to MMCAN)";
BA_ "Version" SG_ 3221225472 RSPA_AvnModNumDis "17.11.00";
BA_ "RoutingFactor" SG_ 3221225472 RSPA_AvnModNumDis 5;
BA_ "UserSigValidity" SG_ 3221225472 RSPA_AvnModNumDis 3;
BA_ "Description" SG_ 3221225472 RSPA_AvnModNumDis "AVN���� ǥ���ؾ��� ��� ���� �޴��� ���� ���� ����

'-CGW routing �ʿ� (CCAN to MMCAN)";
BA_ "Version" SG_ 3221225472 RSPA_AvnSubViewDis "17.11.00";
BA_ "RoutingFactor" SG_ 3221225472 RSPA_AvnSubViewDis 5;
BA_ "UserSigValidity" SG_ 3221225472 RSPA_AvnSubViewDis 3;
BA_ "Description" SG_ 3221225472 RSPA_AvnSubViewDis "AVN���� ǥ���ؾ��� Topview���� ��ü�̹��� ��¿�û

'-CGW routing �ʿ� (CCAN to MMCAN)";
BA_ "Version" SG_ 3221225472 RSPA_AvnModADLDis "17.11.00";
BA_ "RoutingFactor" SG_ 3221225472 RSPA_AvnModADLDis 5;
BA_ "UserSigValidity" SG_ 3221225472 RSPA_AvnModADLDis 3;
BA_ "Description" SG_ 3221225472 RSPA_AvnModADLDis "AVN���� ǥ���ϴ� �缱�Ĺ����� (����/����) ��弱�� �޴��� ����ɿ��� ǥ�� ����

'-CGW routing �ʿ� (CCAN to MMCAN)";
BA_ "Version" SG_ 3221225472 RSPA_AvnModPDFLDis "17.11.00";
BA_ "RoutingFactor" SG_ 3221225472 RSPA_AvnModPDFLDis 5;
BA_ "UserSigValidity" SG_ 3221225472 RSPA_AvnModPDFLDis 3;
BA_ "Description" SG_ 3221225472 RSPA_AvnModPDFLDis "AVN���� ǥ���ϴ� ������������ (����/����) ��弱�� �޴��� ����ɿ��� ǥ�� ����

'-CGW routing �ʿ� (CCAN to MMCAN)";
BA_ "Version" SG_ 3221225472 RSPA_AvnModPLDis "17.11.00";
BA_ "RoutingFactor" SG_ 3221225472 RSPA_AvnModPLDis 5;
BA_ "UserSigValidity" SG_ 3221225472 RSPA_AvnModPLDis 3;
BA_ "Description" SG_ 3221225472 RSPA_AvnModPLDis "AVN���� ǥ���ϴ� �����Ĺ����� (����/����) ��弱�� �޴��� ����ɿ��� ǥ�� ����

'-CGW routing �ʿ� (CCAN to MMCAN)";
BA_ "Version" SG_ 3221225472 RSPA_AvnModPDRLDis "17.11.00";
BA_ "RoutingFactor" SG_ 3221225472 RSPA_AvnModPDRLDis 5;
BA_ "UserSigValidity" SG_ 3221225472 RSPA_AvnModPDRLDis 3;
BA_ "Description" SG_ 3221225472 RSPA_AvnModPDRLDis "AVN���� ǥ���ϴ� �����Ĺ����� (����/����) ��弱�� �޴��� ����ɿ��� ǥ�� ����

'-CGW routing �ʿ� (CCAN to MMCAN)";
BA_ "Version" SG_ 3221225472 RSPA_AvnModPDRRDis "17.11.00";
BA_ "RoutingFactor" SG_ 3221225472 RSPA_AvnModPDRRDis 5;
BA_ "UserSigValidity" SG_ 3221225472 RSPA_AvnModPDRRDis 3;
BA_ "Description" SG_ 3221225472 RSPA_AvnModPDRRDis "AVN���� ǥ���ϴ� �����Ĺ���� (����/����) ��弱�� �޴��� ����ɿ��� ǥ�� ����

'-CGW routing �ʿ� (CCAN to MMCAN)";
BA_ "Version" SG_ 3221225472 RSPA_AvnModPRDis "17.11.00";
BA_ "RoutingFactor" SG_ 3221225472 RSPA_AvnModPRDis 5;
BA_ "UserSigValidity" SG_ 3221225472 RSPA_AvnModPRDis 3;
BA_ "Description" SG_ 3221225472 RSPA_AvnModPRDis "AVN���� ǥ���ϴ� �����Ĺ���� (����/����) ��弱�� �޴��� ����ɿ��� ǥ�� ����

'-CGW routing �ʿ� (CCAN to MMCAN)";
BA_ "Version" SG_ 3221225472 RSPA_AvnModPDFRDis "17.11.00";
BA_ "RoutingFactor" SG_ 3221225472 RSPA_AvnModPDFRDis 5;
BA_ "UserSigValidity" SG_ 3221225472 RSPA_AvnModPDFRDis 3;
BA_ "Description" SG_ 3221225472 RSPA_AvnModPDFRDis "AVN���� ǥ���ϴ� ����������� (����/����) ��弱�� �޴��� ����ɿ��� ǥ�� ����

'-CGW routing �ʿ� (CCAN to MMCAN)";
BA_ "Version" SG_ 3221225472 RSPA_AvnModADRDis "17.11.00";
BA_ "RoutingFactor" SG_ 3221225472 RSPA_AvnModADRDis 5;
BA_ "UserSigValidity" SG_ 3221225472 RSPA_AvnModADRDis 3;
BA_ "Description" SG_ 3221225472 RSPA_AvnModADRDis "AVN���� ǥ���ϴ� �缱�Ĺ���� (����/����) ��弱�� �޴��� ����ɿ��� ǥ�� ����

'-CGW routing �ʿ� (CCAN to MMCAN)";
BA_ "Version" SG_ 3221225472 RSPA_CamDis "17.11.00";
BA_ "RoutingFactor" SG_ 3221225472 RSPA_CamDis 5;
BA_ "UserSigValidity" SG_ 3221225472 RSPA_CamDis 3;
BA_ "Description" SG_ 3221225472 RSPA_CamDis "RSPA �۵� �� AVM/RVM�� AVN�� ����� ���� �� ��� ��û";
BA_ "Version" SG_ 3221225472 RSPA_CnclTyp "18.05.02";
BA_ "RoutingFactor" SG_ 3221225472 RSPA_CnclTyp 5;
BA_ "UserSigValidity" SG_ 3221225472 RSPA_CnclTyp 3;
BA_ "Description" SG_ 3221225472 RSPA_CnclTyp "RSPA Cancel Type

RSPA�� ���� ȭ�� ���� ���� ��û ��ȣ�� ������ Ÿ�ֿ̹� ���";
BA_ "Version" SG_ 3221225472 RSPA_AvnHmiDis "18.12.01";
BA_ "RoutingFactor" SG_ 3221225472 RSPA_AvnHmiDis 5;
BA_ "UserSigValidity" SG_ 3221225472 RSPA_AvnHmiDis 3;
BA_ "Description" SG_ 3221225472 RSPA_AvnHmiDis "AVN���� ǥ���ϴ� RSPA HMI ǥ�� ����

'-CGW routing �ʿ� (CCAN to MMCAN)";
BA_ "Version" SG_ 3221225472 RSPA_BxHght "17.11.00";
BA_ "RoutingFactor" SG_ 3221225472 RSPA_BxHght 5;
BA_ "UserSigValidity" SG_ 3221225472 RSPA_BxHght 3;
BA_ "Description" SG_ 3221225472 RSPA_BxHght "AVM ǥ�� ��ǥ�������� ����";
BA_ "Version" SG_ 3221225472 RSPA_BxWidth "17.11.00";
BA_ "RoutingFactor" SG_ 3221225472 RSPA_BxWidth 5;
BA_ "UserSigValidity" SG_ 3221225472 RSPA_BxWidth 3;
BA_ "Description" SG_ 3221225472 RSPA_BxWidth "AVM ǥ�� ��ǥ�������� �ʺ�";
BA_ "Version" SG_ 3221225472 RSPA_RtTrgtPosX "18.12.07";
BA_ "RoutingFactor" SG_ 3221225472 RSPA_RtTrgtPosX 5;
BA_ "UserSigValidity" SG_ 3221225472 RSPA_RtTrgtPosX 3;
BA_ "Description" SG_ 3221225472 RSPA_RtTrgtPosX "AVM ǥ�� ������ �������� ��ġ X ��ǥ";
BA_ "Version" SG_ 3221225472 RSPA_RtTrgtPosY "18.12.07";
BA_ "RoutingFactor" SG_ 3221225472 RSPA_RtTrgtPosY 5;
BA_ "UserSigValidity" SG_ 3221225472 RSPA_RtTrgtPosY 3;
BA_ "Description" SG_ 3221225472 RSPA_RtTrgtPosY "AVM ǥ�� ������ �������� ��ġ Y ��ǥ";
BA_ "Version" SG_ 3221225472 RSPA_LftTrgtPosX "18.12.07";
BA_ "RoutingFactor" SG_ 3221225472 RSPA_LftTrgtPosX 5;
BA_ "UserSigValidity" SG_ 3221225472 RSPA_LftTrgtPosX 3;
BA_ "Description" SG_ 3221225472 RSPA_LftTrgtPosX "AVM ǥ�� ���� �������� ��ġ X ��ǥ";
BA_ "Version" SG_ 3221225472 IAU_DigitalKeyOpt "17.12.08";
BA_ "NetworkRequestHoldingTime" SG_ 3221225472 IAU_DigitalKeyOpt 5000;
BA_ "NetworkRequest" SG_ 3221225472 IAU_DigitalKeyOpt 0;
BA_ "UserSigValidity" SG_ 3221225472 IAU_DigitalKeyOpt 0;
BA_ "GenSigSendType" SG_ 3221225472 IAU_DigitalKeyOpt 4;
BA_ "Version" SG_ 3221225472 IAU_ProfileIDRVal "17.12.08";
BA_ "NetworkRequestHoldingTime" SG_ 3221225472 IAU_ProfileIDRVal 5000;
BA_ "NetworkRequest" SG_ 3221225472 IAU_ProfileIDRVal 0;
BA_ "UserSigValidity" SG_ 3221225472 IAU_ProfileIDRVal 0;
BA_ "GenSigSendType" SG_ 3221225472 IAU_ProfileIDRVal 4;
BA_ "Version" SG_ 3221225472 IAU_ISKLearnState "18.08.05";
BA_ "NetworkRequestHoldingTime" SG_ 3221225472 IAU_ISKLearnState 5000;
BA_ "NetworkRequest" SG_ 3221225472 IAU_ISKLearnState 0;
BA_ "UserSigValidity" SG_ 3221225472 IAU_ISKLearnState 0;
BA_ "GenSigSendType" SG_ 3221225472 IAU_ISKLearnState 4;
BA_ "Description" SG_ 3221225472 IAU_ISKLearnState "This signal is State of IAU Learning";
BA_ "Version" SG_ 3221225472 IAU_DigitalKeyProcessingSta "19.03.05";
BA_ "NetworkRequestHoldingTime" SG_ 3221225472 IAU_DigitalKeyProcessingSta 5000;
BA_ "NetworkRequest" SG_ 3221225472 IAU_DigitalKeyProcessingSta 0;
BA_ "UserSigValidity" SG_ 3221225472 IAU_DigitalKeyProcessingSta 3;
BA_ "GenSigSendType" SG_ 3221225472 IAU_DigitalKeyProcessingSta 4;
BA_ "Version" SG_ 3221225472 IAU_DigitalKeyExit "19.03.05";
BA_ "NetworkRequestHoldingTime" SG_ 3221225472 IAU_DigitalKeyExit 5000;
BA_ "NetworkRequest" SG_ 3221225472 IAU_DigitalKeyExit 0;
BA_ "UserSigValidity" SG_ 3221225472 IAU_DigitalKeyExit 3;
BA_ "GenSigSendType" SG_ 3221225472 IAU_DigitalKeyExit 4;
BA_ "Description" SG_ 3221225472 IAU_DigitalKeyExit "Digital Key USM setting Exit Condition";
BA_ "Version" SG_ 3221225472 IAU_DigitalKeyEnblRVal "17.12.08";
BA_ "NetworkRequestHoldingTime" SG_ 3221225472 IAU_DigitalKeyEnblRVal 5000;
BA_ "NetworkRequest" SG_ 3221225472 IAU_DigitalKeyEnblRVal 0;
BA_ "UserSigValidity" SG_ 3221225472 IAU_DigitalKeyEnblRVal 0;
BA_ "GenSigSendType" SG_ 3221225472 IAU_DigitalKeyEnblRVal 4;
BA_ "Version" SG_ 3221225472 IAU_OwnerPhnRegRVal "17.12.08";
BA_ "NetworkRequestHoldingTime" SG_ 3221225472 IAU_OwnerPhnRegRVal 5000;
BA_ "NetworkRequest" SG_ 3221225472 IAU_OwnerPhnRegRVal 0;
BA_ "UserSigValidity" SG_ 3221225472 IAU_OwnerPhnRegRVal 0;
BA_ "GenSigSendType" SG_ 3221225472 IAU_OwnerPhnRegRVal 4;
BA_ "Version" SG_ 3221225472 IAU_NFCCard1RegRVal "17.12.08";
BA_ "NetworkRequestHoldingTime" SG_ 3221225472 IAU_NFCCard1RegRVal 5000;
BA_ "NetworkRequest" SG_ 3221225472 IAU_NFCCard1RegRVal 0;
BA_ "UserSigValidity" SG_ 3221225472 IAU_NFCCard1RegRVal 0;
BA_ "GenSigSendType" SG_ 3221225472 IAU_NFCCard1RegRVal 4;
BA_ "Version" SG_ 3221225472 IAU_NFCCard2RegRVal "17.12.08";
BA_ "NetworkRequestHoldingTime" SG_ 3221225472 IAU_NFCCard2RegRVal 5000;
BA_ "NetworkRequest" SG_ 3221225472 IAU_NFCCard2RegRVal 0;
BA_ "UserSigValidity" SG_ 3221225472 IAU_NFCCard2RegRVal 0;
BA_ "GenSigSendType" SG_ 3221225472 IAU_NFCCard2RegRVal 4;
BA_ "Version" SG_ 3221225472 IAU_RdyToSendAuthDataSta "17.12.08";
BA_ "NetworkRequestHoldingTime" SG_ 3221225472 IAU_RdyToSendAuthDataSta 5000;
BA_ "NetworkRequest" SG_ 3221225472 IAU_RdyToSendAuthDataSta 0;
BA_ "UserSigValidity" SG_ 3221225472 IAU_RdyToSendAuthDataSta 0;
BA_ "GenSigSendType" SG_ 3221225472 IAU_RdyToSendAuthDataSta 4;
BA_ "Version" SG_ 3221225472 IAU_OptTyp "17.12.08";
BA_ "NetworkRequestHoldingTime" SG_ 3221225472 IAU_OptTyp 5000;
BA_ "NetworkRequest" SG_ 3221225472 IAU_OptTyp 0;
BA_ "UserSigValidity" SG_ 3221225472 IAU_OptTyp 0;
BA_ "GenSigSendType" SG_ 3221225472 IAU_OptTyp 4;
BA_ "Version" SG_ 3221225472 IAU_NFCKeyReminder "18.08.05";
BA_ "NetworkRequestHoldingTime" SG_ 3221225472 IAU_NFCKeyReminder 5;
BA_ "NetworkRequest" SG_ 3221225472 IAU_NFCKeyReminder 0;
BA_ "UserSigValidity" SG_ 3221225472 IAU_NFCKeyReminder 0;
BA_ "GenSigSendType" SG_ 3221225472 IAU_NFCKeyReminder 4;
BA_ "Description" SG_ 3221225472 IAU_NFCKeyReminder "This signal indicates whether digital key locate on WPC or not";
BA_ "Version" SG_ 3221225472 IAU_NFCDeactivation "18.08.05";
BA_ "NetworkRequestHoldingTime" SG_ 3221225472 IAU_NFCDeactivation 5;
BA_ "NetworkRequest" SG_ 3221225472 IAU_NFCDeactivation 0;
BA_ "UserSigValidity" SG_ 3221225472 IAU_NFCDeactivation 0;
BA_ "GenSigSendType" SG_ 3221225472 IAU_NFCDeactivation 4;
BA_ "Description" SG_ 3221225472 IAU_NFCDeactivation "NFC Deactivation Siganl";
BA_ "Version" SG_ 3221225472 IAU_DISPWrng "18.12.08";
BA_ "NetworkRequestHoldingTime" SG_ 3221225472 IAU_DISPWrng 5000;
BA_ "NetworkRequest" SG_ 3221225472 IAU_DISPWrng 0;
BA_ "UserSigValidity" SG_ 3221225472 IAU_DISPWrng 0;
BA_ "GenSigSendType" SG_ 3221225472 IAU_DISPWrng 4;
BA_ "Description" SG_ 3221225472 IAU_DISPWrng "This siganl warning from IAU";
BA_ "Version" SG_ 3221225472 IAU_ConStat "18.12.08";
BA_ "NetworkRequestHoldingTime" SG_ 3221225472 IAU_ConStat 5000;
BA_ "NetworkRequest" SG_ 3221225472 IAU_ConStat 0;
BA_ "UserSigValidity" SG_ 3221225472 IAU_ConStat 0;
BA_ "GenSigSendType" SG_ 3221225472 IAU_ConStat 4;
BA_ "Description" SG_ 3221225472 IAU_ConStat "Connection Status among RSPA, IAU, BLE and SmartPhone";
BA_ "Version" SG_ 3221225472 IAU_LftDrHndLockDetected "18.08.07";
BA_ "NetworkRequestHoldingTime" SG_ 3221225472 IAU_LftDrHndLockDetected 5000;
BA_ "NetworkRequest" SG_ 3221225472 IAU_LftDrHndLockDetected 0;
BA_ "UserSigValidity" SG_ 3221225472 IAU_LftDrHndLockDetected 0;
BA_ "GenSigSendType" SG_ 3221225472 IAU_LftDrHndLockDetected 4;
BA_ "Version" SG_ 3221225472 IAU_LftDrHndUnlockDetected "18.08.07";
BA_ "NetworkRequestHoldingTime" SG_ 3221225472 IAU_LftDrHndUnlockDetected 5000;
BA_ "NetworkRequest" SG_ 3221225472 IAU_LftDrHndUnlockDetected 0;
BA_ "UserSigValidity" SG_ 3221225472 IAU_LftDrHndUnlockDetected 0;
BA_ "GenSigSendType" SG_ 3221225472 IAU_LftDrHndUnlockDetected 4;
BA_ "Version" SG_ 3221225472 IAU_RtDrHndLockDetected "18.08.07";
BA_ "NetworkRequestHoldingTime" SG_ 3221225472 IAU_RtDrHndLockDetected 5000;
BA_ "NetworkRequest" SG_ 3221225472 IAU_RtDrHndLockDetected 0;
BA_ "UserSigValidity" SG_ 3221225472 IAU_RtDrHndLockDetected 0;
BA_ "GenSigSendType" SG_ 3221225472 IAU_RtDrHndLockDetected 4;
BA_ "Version" SG_ 3221225472 IAU_RtDrHndUnlockDetected "18.08.07";
BA_ "NetworkRequestHoldingTime" SG_ 3221225472 IAU_RtDrHndUnlockDetected 5000;
BA_ "NetworkRequest" SG_ 3221225472 IAU_RtDrHndUnlockDetected 0;
BA_ "UserSigValidity" SG_ 3221225472 IAU_RtDrHndUnlockDetected 0;
BA_ "GenSigSendType" SG_ 3221225472 IAU_RtDrHndUnlockDetected 4;
BA_ "Version" SG_ 3221225472 IAU_ProfileIDParingRVal "17.12.08";
BA_ "NetworkRequestHoldingTime" SG_ 3221225472 IAU_ProfileIDParingRVal 5000;
BA_ "NetworkRequest" SG_ 3221225472 IAU_ProfileIDParingRVal 0;
BA_ "UserSigValidity" SG_ 3221225472 IAU_ProfileIDParingRVal 0;
BA_ "GenSigSendType" SG_ 3221225472 IAU_ProfileIDParingRVal 4;
BA_ "Version" SG_ 3221225472 EPB_Logger1_Byte0 "18.08.01";
BA_ "NetworkRequestHoldingTime" SG_ 3221225472 EPB_Logger1_Byte0 5000;
BA_ "NetworkRequest" SG_ 3221225472 EPB_Logger1_Byte0 0;
BA_ "UserSigValidity" SG_ 3221225472 EPB_Logger1_Byte0 0;
BA_ "GenSigSendType" SG_ 3221225472 EPB_Logger1_Byte0 2;
BA_ "UsrSigPurpose" SG_ 3221225472 EPB_Logger1_Byte0 6;
BA_ "Version" SG_ 3221225472 EPB_Logger1_Byte2 "18.08.01";
BA_ "NetworkRequestHoldingTime" SG_ 3221225472 EPB_Logger1_Byte2 5000;
BA_ "NetworkRequest" SG_ 3221225472 EPB_Logger1_Byte2 0;
BA_ "UserSigValidity" SG_ 3221225472 EPB_Logger1_Byte2 0;
BA_ "GenSigSendType" SG_ 3221225472 EPB_Logger1_Byte2 2;
BA_ "UsrSigPurpose" SG_ 3221225472 EPB_Logger1_Byte2 6;
BA_ "Version" SG_ 3221225472 EPB_Logger1_Byte3 "18.08.01";
BA_ "NetworkRequestHoldingTime" SG_ 3221225472 EPB_Logger1_Byte3 5000;
BA_ "NetworkRequest" SG_ 3221225472 EPB_Logger1_Byte3 0;
BA_ "UserSigValidity" SG_ 3221225472 EPB_Logger1_Byte3 0;
BA_ "GenSigSendType" SG_ 3221225472 EPB_Logger1_Byte3 2;
BA_ "UsrSigPurpose" SG_ 3221225472 EPB_Logger1_Byte3 6;
BA_ "Version" SG_ 3221225472 EPB_Logger1_Byte4 "18.08.01";
BA_ "NetworkRequestHoldingTime" SG_ 3221225472 EPB_Logger1_Byte4 5000;
BA_ "NetworkRequest" SG_ 3221225472 EPB_Logger1_Byte4 0;
BA_ "UserSigValidity" SG_ 3221225472 EPB_Logger1_Byte4 0;
BA_ "GenSigSendType" SG_ 3221225472 EPB_Logger1_Byte4 2;
BA_ "UsrSigPurpose" SG_ 3221225472 EPB_Logger1_Byte4 6;
BA_ "Version" SG_ 3221225472 EPB_Logger1_Byte5 "18.08.01";
BA_ "NetworkRequestHoldingTime" SG_ 3221225472 EPB_Logger1_Byte5 5000;
BA_ "NetworkRequest" SG_ 3221225472 EPB_Logger1_Byte5 0;
BA_ "UserSigValidity" SG_ 3221225472 EPB_Logger1_Byte5 0;
BA_ "GenSigSendType" SG_ 3221225472 EPB_Logger1_Byte5 2;
BA_ "UsrSigPurpose" SG_ 3221225472 EPB_Logger1_Byte5 6;
BA_ "Version" SG_ 3221225472 EPB_Logger1_Byte6 "18.08.01";
BA_ "NetworkRequestHoldingTime" SG_ 3221225472 EPB_Logger1_Byte6 5000;
BA_ "NetworkRequest" SG_ 3221225472 EPB_Logger1_Byte6 0;
BA_ "UserSigValidity" SG_ 3221225472 EPB_Logger1_Byte6 0;
BA_ "GenSigSendType" SG_ 3221225472 EPB_Logger1_Byte6 2;
BA_ "UsrSigPurpose" SG_ 3221225472 EPB_Logger1_Byte6 6;
BA_ "Version" SG_ 3221225472 EPB_Logger1_Byte7 "18.08.01";
BA_ "NetworkRequestHoldingTime" SG_ 3221225472 EPB_Logger1_Byte7 5000;
BA_ "NetworkRequest" SG_ 3221225472 EPB_Logger1_Byte7 0;
BA_ "UserSigValidity" SG_ 3221225472 EPB_Logger1_Byte7 0;
BA_ "GenSigSendType" SG_ 3221225472 EPB_Logger1_Byte7 2;
BA_ "UsrSigPurpose" SG_ 3221225472 EPB_Logger1_Byte7 6;
BA_ "Version" SG_ 3221225472 EPB_Logger1_Byte1 "18.08.01";
BA_ "NetworkRequestHoldingTime" SG_ 3221225472 EPB_Logger1_Byte1 5000;
BA_ "NetworkRequest" SG_ 3221225472 EPB_Logger1_Byte1 0;
BA_ "UserSigValidity" SG_ 3221225472 EPB_Logger1_Byte1 0;
BA_ "GenSigSendType" SG_ 3221225472 EPB_Logger1_Byte1 2;
BA_ "UsrSigPurpose" SG_ 3221225472 EPB_Logger1_Byte1 6;
BA_ "Version" SG_ 3221225472 EPB_Logger0_Byte0 "18.08.01";
BA_ "NetworkRequestHoldingTime" SG_ 3221225472 EPB_Logger0_Byte0 5000;
BA_ "NetworkRequest" SG_ 3221225472 EPB_Logger0_Byte0 0;
BA_ "UserSigValidity" SG_ 3221225472 EPB_Logger0_Byte0 0;
BA_ "GenSigSendType" SG_ 3221225472 EPB_Logger0_Byte0 2;
BA_ "UsrSigPurpose" SG_ 3221225472 EPB_Logger0_Byte0 6;
BA_ "Version" SG_ 3221225472 EPB_Logger0_Byte2 "18.08.01";
BA_ "NetworkRequestHoldingTime" SG_ 3221225472 EPB_Logger0_Byte2 5000;
BA_ "NetworkRequest" SG_ 3221225472 EPB_Logger0_Byte2 0;
BA_ "UserSigValidity" SG_ 3221225472 EPB_Logger0_Byte2 0;
BA_ "GenSigSendType" SG_ 3221225472 EPB_Logger0_Byte2 2;
BA_ "UsrSigPurpose" SG_ 3221225472 EPB_Logger0_Byte2 6;
BA_ "Version" SG_ 3221225472 EPB_Logger0_Byte3 "18.08.01";
BA_ "NetworkRequestHoldingTime" SG_ 3221225472 EPB_Logger0_Byte3 5000;
BA_ "NetworkRequest" SG_ 3221225472 EPB_Logger0_Byte3 0;
BA_ "UserSigValidity" SG_ 3221225472 EPB_Logger0_Byte3 0;
BA_ "GenSigSendType" SG_ 3221225472 EPB_Logger0_Byte3 2;
BA_ "UsrSigPurpose" SG_ 3221225472 EPB_Logger0_Byte3 6;
BA_ "Version" SG_ 3221225472 EPB_Logger0_Byte4 "18.08.01";
BA_ "NetworkRequestHoldingTime" SG_ 3221225472 EPB_Logger0_Byte4 5000;
BA_ "NetworkRequest" SG_ 3221225472 EPB_Logger0_Byte4 0;
BA_ "UserSigValidity" SG_ 3221225472 EPB_Logger0_Byte4 0;
BA_ "GenSigSendType" SG_ 3221225472 EPB_Logger0_Byte4 2;
BA_ "UsrSigPurpose" SG_ 3221225472 EPB_Logger0_Byte4 6;
BA_ "Version" SG_ 3221225472 EPB_Logger0_Byte5 "18.08.01";
BA_ "NetworkRequestHoldingTime" SG_ 3221225472 EPB_Logger0_Byte5 5000;
BA_ "NetworkRequest" SG_ 3221225472 EPB_Logger0_Byte5 0;
BA_ "UserSigValidity" SG_ 3221225472 EPB_Logger0_Byte5 0;
BA_ "GenSigSendType" SG_ 3221225472 EPB_Logger0_Byte5 2;
BA_ "UsrSigPurpose" SG_ 3221225472 EPB_Logger0_Byte5 6;
BA_ "Version" SG_ 3221225472 EPB_Logger0_Byte6 "18.08.01";
BA_ "NetworkRequestHoldingTime" SG_ 3221225472 EPB_Logger0_Byte6 5000;
BA_ "NetworkRequest" SG_ 3221225472 EPB_Logger0_Byte6 0;
BA_ "UserSigValidity" SG_ 3221225472 EPB_Logger0_Byte6 0;
BA_ "GenSigSendType" SG_ 3221225472 EPB_Logger0_Byte6 2;
BA_ "UsrSigPurpose" SG_ 3221225472 EPB_Logger0_Byte6 6;
BA_ "Version" SG_ 3221225472 EPB_Logger0_Byte7 "18.08.01";
BA_ "NetworkRequestHoldingTime" SG_ 3221225472 EPB_Logger0_Byte7 5000;
BA_ "NetworkRequest" SG_ 3221225472 EPB_Logger0_Byte7 0;
BA_ "UserSigValidity" SG_ 3221225472 EPB_Logger0_Byte7 0;
BA_ "GenSigSendType" SG_ 3221225472 EPB_Logger0_Byte7 2;
BA_ "UsrSigPurpose" SG_ 3221225472 EPB_Logger0_Byte7 6;
BA_ "Version" SG_ 3221225472 EPB_Logger0_Byte1 "18.08.01";
BA_ "NetworkRequestHoldingTime" SG_ 3221225472 EPB_Logger0_Byte1 5000;
BA_ "NetworkRequest" SG_ 3221225472 EPB_Logger0_Byte1 0;
BA_ "UserSigValidity" SG_ 3221225472 EPB_Logger0_Byte1 0;
BA_ "GenSigSendType" SG_ 3221225472 EPB_Logger0_Byte1 2;
BA_ "UsrSigPurpose" SG_ 3221225472 EPB_Logger0_Byte1 6;
BA_ "Version" SG_ 3221225472 MODE_MDPS_SET "18.09.04";
BA_ "UserSigValidity" SG_ 3221225472 MODE_MDPS_SET 3;
BA_ "GenSigStartValue" SG_ 3221225472 MODE_MDPS_SET 7;
BA_ "GenSigSendType" SG_ 3221225472 MODE_MDPS_SET 4;
BA_ "Version" SG_ 3221225472 MODE_ECS_SET "18.09.04";
BA_ "UserSigValidity" SG_ 3221225472 MODE_ECS_SET 3;
BA_ "GenSigStartValue" SG_ 3221225472 MODE_ECS_SET 7;
BA_ "GenSigSendType" SG_ 3221225472 MODE_ECS_SET 4;
BA_ "Version" SG_ 3221225472 MODE_4WD_SET "18.09.04";
BA_ "UserSigValidity" SG_ 3221225472 MODE_4WD_SET 3;
BA_ "GenSigStartValue" SG_ 3221225472 MODE_4WD_SET 7;
BA_ "GenSigSendType" SG_ 3221225472 MODE_4WD_SET 4;
BA_ "Version" SG_ 3221225472 MODE_BRAKE_SET "18.09.04";
BA_ "UserSigValidity" SG_ 3221225472 MODE_BRAKE_SET 3;
BA_ "GenSigSendType" SG_ 3221225472 MODE_BRAKE_SET 4;
BA_ "Version" SG_ 3221225472 MODE_ENG_SET "18.09.04";
BA_ "UserSigValidity" SG_ 3221225472 MODE_ENG_SET 3;
BA_ "GenSigStartValue" SG_ 3221225472 MODE_ENG_SET 7;
BA_ "GenSigSendType" SG_ 3221225472 MODE_ENG_SET 4;
BA_ "Version" SG_ 3221225472 EPB_DTO_Byte0 "18.08.01";
BA_ "NetworkRequestHoldingTime" SG_ 3221225472 EPB_DTO_Byte0 5000;
BA_ "NetworkRequest" SG_ 3221225472 EPB_DTO_Byte0 0;
BA_ "UserSigValidity" SG_ 3221225472 EPB_DTO_Byte0 0;
BA_ "GenSigSendType" SG_ 3221225472 EPB_DTO_Byte0 2;
BA_ "UsrSigPurpose" SG_ 3221225472 EPB_DTO_Byte0 6;
BA_ "Version" SG_ 3221225472 EPB_DTO_Byte2 "18.08.01";
BA_ "NetworkRequestHoldingTime" SG_ 3221225472 EPB_DTO_Byte2 5000;
BA_ "NetworkRequest" SG_ 3221225472 EPB_DTO_Byte2 0;
BA_ "UserSigValidity" SG_ 3221225472 EPB_DTO_Byte2 0;
BA_ "GenSigSendType" SG_ 3221225472 EPB_DTO_Byte2 2;
BA_ "UsrSigPurpose" SG_ 3221225472 EPB_DTO_Byte2 6;
BA_ "Version" SG_ 3221225472 EPB_DTO_Byte3 "18.08.01";
BA_ "NetworkRequestHoldingTime" SG_ 3221225472 EPB_DTO_Byte3 5000;
BA_ "NetworkRequest" SG_ 3221225472 EPB_DTO_Byte3 0;
BA_ "UserSigValidity" SG_ 3221225472 EPB_DTO_Byte3 0;
BA_ "GenSigSendType" SG_ 3221225472 EPB_DTO_Byte3 2;
BA_ "UsrSigPurpose" SG_ 3221225472 EPB_DTO_Byte3 6;
BA_ "Version" SG_ 3221225472 EPB_DTO_Byte4 "18.08.01";
BA_ "NetworkRequestHoldingTime" SG_ 3221225472 EPB_DTO_Byte4 5000;
BA_ "NetworkRequest" SG_ 3221225472 EPB_DTO_Byte4 0;
BA_ "UserSigValidity" SG_ 3221225472 EPB_DTO_Byte4 0;
BA_ "GenSigSendType" SG_ 3221225472 EPB_DTO_Byte4 2;
BA_ "UsrSigPurpose" SG_ 3221225472 EPB_DTO_Byte4 6;
BA_ "Version" SG_ 3221225472 EPB_DTO_Byte5 "18.08.01";
BA_ "NetworkRequestHoldingTime" SG_ 3221225472 EPB_DTO_Byte5 5000;
BA_ "NetworkRequest" SG_ 3221225472 EPB_DTO_Byte5 0;
BA_ "UserSigValidity" SG_ 3221225472 EPB_DTO_Byte5 0;
BA_ "GenSigSendType" SG_ 3221225472 EPB_DTO_Byte5 2;
BA_ "UsrSigPurpose" SG_ 3221225472 EPB_DTO_Byte5 6;
BA_ "Version" SG_ 3221225472 EPB_DTO_Byte6 "18.08.01";
BA_ "NetworkRequestHoldingTime" SG_ 3221225472 EPB_DTO_Byte6 5000;
BA_ "NetworkRequest" SG_ 3221225472 EPB_DTO_Byte6 0;
BA_ "UserSigValidity" SG_ 3221225472 EPB_DTO_Byte6 0;
BA_ "GenSigSendType" SG_ 3221225472 EPB_DTO_Byte6 2;
BA_ "UsrSigPurpose" SG_ 3221225472 EPB_DTO_Byte6 6;
BA_ "Version" SG_ 3221225472 EPB_DTO_Byte7 "18.08.01";
BA_ "NetworkRequestHoldingTime" SG_ 3221225472 EPB_DTO_Byte7 5000;
BA_ "NetworkRequest" SG_ 3221225472 EPB_DTO_Byte7 0;
BA_ "UserSigValidity" SG_ 3221225472 EPB_DTO_Byte7 0;
BA_ "GenSigSendType" SG_ 3221225472 EPB_DTO_Byte7 2;
BA_ "UsrSigPurpose" SG_ 3221225472 EPB_DTO_Byte7 6;
BA_ "Version" SG_ 3221225472 EPB_DTO_Byte1 "18.08.01";
BA_ "NetworkRequestHoldingTime" SG_ 3221225472 EPB_DTO_Byte1 5000;
BA_ "NetworkRequest" SG_ 3221225472 EPB_DTO_Byte1 0;
BA_ "UserSigValidity" SG_ 3221225472 EPB_DTO_Byte1 0;
BA_ "GenSigSendType" SG_ 3221225472 EPB_DTO_Byte1 2;
BA_ "UsrSigPurpose" SG_ 3221225472 EPB_DTO_Byte1 6;
BA_ "Version" SG_ 3221225472 EPB_CRO_Byte0 "18.08.01";
BA_ "NetworkRequestHoldingTime" SG_ 3221225472 EPB_CRO_Byte0 5000;
BA_ "NetworkRequest" SG_ 3221225472 EPB_CRO_Byte0 0;
BA_ "UserSigValidity" SG_ 3221225472 EPB_CRO_Byte0 0;
BA_ "GenSigSendType" SG_ 3221225472 EPB_CRO_Byte0 2;
BA_ "UsrSigPurpose" SG_ 3221225472 EPB_CRO_Byte0 6;
BA_ "Version" SG_ 3221225472 EPB_CRO_Byte2 "18.08.01";
BA_ "NetworkRequestHoldingTime" SG_ 3221225472 EPB_CRO_Byte2 5000;
BA_ "NetworkRequest" SG_ 3221225472 EPB_CRO_Byte2 0;
BA_ "UserSigValidity" SG_ 3221225472 EPB_CRO_Byte2 0;
BA_ "GenSigSendType" SG_ 3221225472 EPB_CRO_Byte2 2;
BA_ "UsrSigPurpose" SG_ 3221225472 EPB_CRO_Byte2 6;
BA_ "Version" SG_ 3221225472 EPB_CRO_Byte3 "18.08.01";
BA_ "NetworkRequestHoldingTime" SG_ 3221225472 EPB_CRO_Byte3 5000;
BA_ "NetworkRequest" SG_ 3221225472 EPB_CRO_Byte3 0;
BA_ "UserSigValidity" SG_ 3221225472 EPB_CRO_Byte3 0;
BA_ "GenSigSendType" SG_ 3221225472 EPB_CRO_Byte3 2;
BA_ "UsrSigPurpose" SG_ 3221225472 EPB_CRO_Byte3 6;
BA_ "Version" SG_ 3221225472 EPB_CRO_Byte4 "18.08.01";
BA_ "NetworkRequestHoldingTime" SG_ 3221225472 EPB_CRO_Byte4 5000;
BA_ "NetworkRequest" SG_ 3221225472 EPB_CRO_Byte4 0;
BA_ "UserSigValidity" SG_ 3221225472 EPB_CRO_Byte4 0;
BA_ "GenSigSendType" SG_ 3221225472 EPB_CRO_Byte4 2;
BA_ "UsrSigPurpose" SG_ 3221225472 EPB_CRO_Byte4 6;
BA_ "Version" SG_ 3221225472 EPB_CRO_Byte5 "18.08.01";
BA_ "NetworkRequestHoldingTime" SG_ 3221225472 EPB_CRO_Byte5 5000;
BA_ "NetworkRequest" SG_ 3221225472 EPB_CRO_Byte5 0;
BA_ "UserSigValidity" SG_ 3221225472 EPB_CRO_Byte5 0;
BA_ "GenSigSendType" SG_ 3221225472 EPB_CRO_Byte5 2;
BA_ "UsrSigPurpose" SG_ 3221225472 EPB_CRO_Byte5 6;
BA_ "Version" SG_ 3221225472 EPB_CRO_Byte6 "18.08.01";
BA_ "NetworkRequestHoldingTime" SG_ 3221225472 EPB_CRO_Byte6 5000;
BA_ "NetworkRequest" SG_ 3221225472 EPB_CRO_Byte6 0;
BA_ "UserSigValidity" SG_ 3221225472 EPB_CRO_Byte6 0;
BA_ "GenSigSendType" SG_ 3221225472 EPB_CRO_Byte6 2;
BA_ "UsrSigPurpose" SG_ 3221225472 EPB_CRO_Byte6 6;
BA_ "Version" SG_ 3221225472 EPB_CRO_Byte7 "18.08.01";
BA_ "NetworkRequestHoldingTime" SG_ 3221225472 EPB_CRO_Byte7 5000;
BA_ "NetworkRequest" SG_ 3221225472 EPB_CRO_Byte7 0;
BA_ "UserSigValidity" SG_ 3221225472 EPB_CRO_Byte7 0;
BA_ "GenSigSendType" SG_ 3221225472 EPB_CRO_Byte7 2;
BA_ "UsrSigPurpose" SG_ 3221225472 EPB_CRO_Byte7 6;
BA_ "Version" SG_ 3221225472 EPB_CRO_Byte1 "18.08.01";
BA_ "NetworkRequestHoldingTime" SG_ 3221225472 EPB_CRO_Byte1 5000;
BA_ "NetworkRequest" SG_ 3221225472 EPB_CRO_Byte1 0;
BA_ "UserSigValidity" SG_ 3221225472 EPB_CRO_Byte1 0;
BA_ "GenSigSendType" SG_ 3221225472 EPB_CRO_Byte1 2;
BA_ "UsrSigPurpose" SG_ 3221225472 EPB_CRO_Byte1 6;
BA_ "Version" SG_ 3221225472 EPB_Logger5_Byte0 "18.08.01";
BA_ "NetworkRequestHoldingTime" SG_ 3221225472 EPB_Logger5_Byte0 5000;
BA_ "NetworkRequest" SG_ 3221225472 EPB_Logger5_Byte0 0;
BA_ "UserSigValidity" SG_ 3221225472 EPB_Logger5_Byte0 0;
BA_ "GenSigSendType" SG_ 3221225472 EPB_Logger5_Byte0 2;
BA_ "UsrSigPurpose" SG_ 3221225472 EPB_Logger5_Byte0 6;
BA_ "Version" SG_ 3221225472 EPB_Logger5_Byte2 "18.08.01";
BA_ "NetworkRequestHoldingTime" SG_ 3221225472 EPB_Logger5_Byte2 5000;
BA_ "NetworkRequest" SG_ 3221225472 EPB_Logger5_Byte2 0;
BA_ "UserSigValidity" SG_ 3221225472 EPB_Logger5_Byte2 0;
BA_ "GenSigSendType" SG_ 3221225472 EPB_Logger5_Byte2 2;
BA_ "UsrSigPurpose" SG_ 3221225472 EPB_Logger5_Byte2 6;
BA_ "Version" SG_ 3221225472 EPB_Logger5_Byte3 "18.08.01";
BA_ "NetworkRequestHoldingTime" SG_ 3221225472 EPB_Logger5_Byte3 5000;
BA_ "NetworkRequest" SG_ 3221225472 EPB_Logger5_Byte3 0;
BA_ "UserSigValidity" SG_ 3221225472 EPB_Logger5_Byte3 0;
BA_ "GenSigSendType" SG_ 3221225472 EPB_Logger5_Byte3 2;
BA_ "UsrSigPurpose" SG_ 3221225472 EPB_Logger5_Byte3 6;
BA_ "Version" SG_ 3221225472 EPB_Logger5_Byte4 "18.08.01";
BA_ "NetworkRequestHoldingTime" SG_ 3221225472 EPB_Logger5_Byte4 5000;
BA_ "NetworkRequest" SG_ 3221225472 EPB_Logger5_Byte4 0;
BA_ "UserSigValidity" SG_ 3221225472 EPB_Logger5_Byte4 0;
BA_ "GenSigSendType" SG_ 3221225472 EPB_Logger5_Byte4 2;
BA_ "UsrSigPurpose" SG_ 3221225472 EPB_Logger5_Byte4 6;
BA_ "Version" SG_ 3221225472 EPB_Logger5_Byte5 "18.08.01";
BA_ "NetworkRequestHoldingTime" SG_ 3221225472 EPB_Logger5_Byte5 5000;
BA_ "NetworkRequest" SG_ 3221225472 EPB_Logger5_Byte5 0;
BA_ "UserSigValidity" SG_ 3221225472 EPB_Logger5_Byte5 0;
BA_ "GenSigSendType" SG_ 3221225472 EPB_Logger5_Byte5 2;
BA_ "UsrSigPurpose" SG_ 3221225472 EPB_Logger5_Byte5 6;
BA_ "Version" SG_ 3221225472 EPB_Logger5_Byte6 "18.08.01";
BA_ "NetworkRequestHoldingTime" SG_ 3221225472 EPB_Logger5_Byte6 5000;
BA_ "NetworkRequest" SG_ 3221225472 EPB_Logger5_Byte6 0;
BA_ "UserSigValidity" SG_ 3221225472 EPB_Logger5_Byte6 0;
BA_ "GenSigSendType" SG_ 3221225472 EPB_Logger5_Byte6 2;
BA_ "UsrSigPurpose" SG_ 3221225472 EPB_Logger5_Byte6 6;
BA_ "Version" SG_ 3221225472 EPB_Logger5_Byte7 "18.08.01";
BA_ "NetworkRequestHoldingTime" SG_ 3221225472 EPB_Logger5_Byte7 5000;
BA_ "NetworkRequest" SG_ 3221225472 EPB_Logger5_Byte7 0;
BA_ "UserSigValidity" SG_ 3221225472 EPB_Logger5_Byte7 0;
BA_ "GenSigSendType" SG_ 3221225472 EPB_Logger5_Byte7 2;
BA_ "UsrSigPurpose" SG_ 3221225472 EPB_Logger5_Byte7 6;
BA_ "Version" SG_ 3221225472 EPB_Logger5_Byte1 "18.08.01";
BA_ "NetworkRequestHoldingTime" SG_ 3221225472 EPB_Logger5_Byte1 5000;
BA_ "NetworkRequest" SG_ 3221225472 EPB_Logger5_Byte1 0;
BA_ "UserSigValidity" SG_ 3221225472 EPB_Logger5_Byte1 0;
BA_ "GenSigSendType" SG_ 3221225472 EPB_Logger5_Byte1 2;
BA_ "UsrSigPurpose" SG_ 3221225472 EPB_Logger5_Byte1 6;
BA_ "Version" SG_ 3221225472 EPB_Logger4_Byte0 "18.08.01";
BA_ "NetworkRequestHoldingTime" SG_ 3221225472 EPB_Logger4_Byte0 5000;
BA_ "NetworkRequest" SG_ 3221225472 EPB_Logger4_Byte0 0;
BA_ "UserSigValidity" SG_ 3221225472 EPB_Logger4_Byte0 0;
BA_ "GenSigSendType" SG_ 3221225472 EPB_Logger4_Byte0 2;
BA_ "UsrSigPurpose" SG_ 3221225472 EPB_Logger4_Byte0 6;
BA_ "Version" SG_ 3221225472 EPB_Logger4_Byte2 "18.08.01";
BA_ "NetworkRequestHoldingTime" SG_ 3221225472 EPB_Logger4_Byte2 5000;
BA_ "NetworkRequest" SG_ 3221225472 EPB_Logger4_Byte2 0;
BA_ "UserSigValidity" SG_ 3221225472 EPB_Logger4_Byte2 0;
BA_ "GenSigSendType" SG_ 3221225472 EPB_Logger4_Byte2 2;
BA_ "UsrSigPurpose" SG_ 3221225472 EPB_Logger4_Byte2 6;
BA_ "Version" SG_ 3221225472 EPB_Logger4_Byte3 "18.08.01";
BA_ "NetworkRequestHoldingTime" SG_ 3221225472 EPB_Logger4_Byte3 5000;
BA_ "NetworkRequest" SG_ 3221225472 EPB_Logger4_Byte3 0;
BA_ "UserSigValidity" SG_ 3221225472 EPB_Logger4_Byte3 0;
BA_ "GenSigSendType" SG_ 3221225472 EPB_Logger4_Byte3 2;
BA_ "UsrSigPurpose" SG_ 3221225472 EPB_Logger4_Byte3 6;
BA_ "Version" SG_ 3221225472 EPB_Logger4_Byte4 "18.08.01";
BA_ "NetworkRequestHoldingTime" SG_ 3221225472 EPB_Logger4_Byte4 5000;
BA_ "NetworkRequest" SG_ 3221225472 EPB_Logger4_Byte4 0;
BA_ "UserSigValidity" SG_ 3221225472 EPB_Logger4_Byte4 0;
BA_ "GenSigSendType" SG_ 3221225472 EPB_Logger4_Byte4 2;
BA_ "UsrSigPurpose" SG_ 3221225472 EPB_Logger4_Byte4 6;
BA_ "Version" SG_ 3221225472 EPB_Logger4_Byte5 "18.08.01";
BA_ "NetworkRequestHoldingTime" SG_ 3221225472 EPB_Logger4_Byte5 5000;
BA_ "NetworkRequest" SG_ 3221225472 EPB_Logger4_Byte5 0;
BA_ "UserSigValidity" SG_ 3221225472 EPB_Logger4_Byte5 0;
BA_ "GenSigSendType" SG_ 3221225472 EPB_Logger4_Byte5 2;
BA_ "UsrSigPurpose" SG_ 3221225472 EPB_Logger4_Byte5 6;
BA_ "Version" SG_ 3221225472 EPB_Logger4_Byte6 "18.08.01";
BA_ "NetworkRequestHoldingTime" SG_ 3221225472 EPB_Logger4_Byte6 5000;
BA_ "NetworkRequest" SG_ 3221225472 EPB_Logger4_Byte6 0;
BA_ "UserSigValidity" SG_ 3221225472 EPB_Logger4_Byte6 0;
BA_ "GenSigSendType" SG_ 3221225472 EPB_Logger4_Byte6 2;
BA_ "UsrSigPurpose" SG_ 3221225472 EPB_Logger4_Byte6 6;
BA_ "Version" SG_ 3221225472 EPB_Logger4_Byte7 "18.08.01";
BA_ "NetworkRequestHoldingTime" SG_ 3221225472 EPB_Logger4_Byte7 5000;
BA_ "NetworkRequest" SG_ 3221225472 EPB_Logger4_Byte7 0;
BA_ "UserSigValidity" SG_ 3221225472 EPB_Logger4_Byte7 0;
BA_ "GenSigSendType" SG_ 3221225472 EPB_Logger4_Byte7 2;
BA_ "UsrSigPurpose" SG_ 3221225472 EPB_Logger4_Byte7 6;
BA_ "Version" SG_ 3221225472 EPB_Logger4_Byte1 "18.08.01";
BA_ "NetworkRequestHoldingTime" SG_ 3221225472 EPB_Logger4_Byte1 5000;
BA_ "NetworkRequest" SG_ 3221225472 EPB_Logger4_Byte1 0;
BA_ "UserSigValidity" SG_ 3221225472 EPB_Logger4_Byte1 0;
BA_ "GenSigSendType" SG_ 3221225472 EPB_Logger4_Byte1 2;
BA_ "UsrSigPurpose" SG_ 3221225472 EPB_Logger4_Byte1 6;
BA_ "Version" SG_ 3221225472 EPB_Logger3_Byte0 "18.08.01";
BA_ "NetworkRequestHoldingTime" SG_ 3221225472 EPB_Logger3_Byte0 5000;
BA_ "NetworkRequest" SG_ 3221225472 EPB_Logger3_Byte0 0;
BA_ "UserSigValidity" SG_ 3221225472 EPB_Logger3_Byte0 0;
BA_ "GenSigSendType" SG_ 3221225472 EPB_Logger3_Byte0 2;
BA_ "UsrSigPurpose" SG_ 3221225472 EPB_Logger3_Byte0 6;
BA_ "Version" SG_ 3221225472 EPB_Logger3_Byte2 "18.08.01";
BA_ "NetworkRequestHoldingTime" SG_ 3221225472 EPB_Logger3_Byte2 5000;
BA_ "NetworkRequest" SG_ 3221225472 EPB_Logger3_Byte2 0;
BA_ "UserSigValidity" SG_ 3221225472 EPB_Logger3_Byte2 0;
BA_ "GenSigSendType" SG_ 3221225472 EPB_Logger3_Byte2 2;
BA_ "UsrSigPurpose" SG_ 3221225472 EPB_Logger3_Byte2 6;
BA_ "Version" SG_ 3221225472 EPB_Logger3_Byte3 "18.08.01";
BA_ "NetworkRequestHoldingTime" SG_ 3221225472 EPB_Logger3_Byte3 5000;
BA_ "NetworkRequest" SG_ 3221225472 EPB_Logger3_Byte3 0;
BA_ "UserSigValidity" SG_ 3221225472 EPB_Logger3_Byte3 0;
BA_ "GenSigSendType" SG_ 3221225472 EPB_Logger3_Byte3 2;
BA_ "UsrSigPurpose" SG_ 3221225472 EPB_Logger3_Byte3 6;
BA_ "Version" SG_ 3221225472 EPB_Logger3_Byte4 "18.08.01";
BA_ "NetworkRequestHoldingTime" SG_ 3221225472 EPB_Logger3_Byte4 5000;
BA_ "NetworkRequest" SG_ 3221225472 EPB_Logger3_Byte4 0;
BA_ "UserSigValidity" SG_ 3221225472 EPB_Logger3_Byte4 0;
BA_ "GenSigSendType" SG_ 3221225472 EPB_Logger3_Byte4 2;
BA_ "UsrSigPurpose" SG_ 3221225472 EPB_Logger3_Byte4 6;
BA_ "Version" SG_ 3221225472 EPB_Logger3_Byte5 "18.08.01";
BA_ "NetworkRequestHoldingTime" SG_ 3221225472 EPB_Logger3_Byte5 5000;
BA_ "NetworkRequest" SG_ 3221225472 EPB_Logger3_Byte5 0;
BA_ "UserSigValidity" SG_ 3221225472 EPB_Logger3_Byte5 0;
BA_ "GenSigSendType" SG_ 3221225472 EPB_Logger3_Byte5 2;
BA_ "UsrSigPurpose" SG_ 3221225472 EPB_Logger3_Byte5 6;
BA_ "Version" SG_ 3221225472 EPB_Logger3_Byte6 "18.08.01";
BA_ "NetworkRequestHoldingTime" SG_ 3221225472 EPB_Logger3_Byte6 5000;
BA_ "NetworkRequest" SG_ 3221225472 EPB_Logger3_Byte6 0;
BA_ "UserSigValidity" SG_ 3221225472 EPB_Logger3_Byte6 0;
BA_ "GenSigSendType" SG_ 3221225472 EPB_Logger3_Byte6 2;
BA_ "UsrSigPurpose" SG_ 3221225472 EPB_Logger3_Byte6 6;
BA_ "Version" SG_ 3221225472 EPB_Logger3_Byte7 "18.08.01";
BA_ "NetworkRequestHoldingTime" SG_ 3221225472 EPB_Logger3_Byte7 5000;
BA_ "NetworkRequest" SG_ 3221225472 EPB_Logger3_Byte7 0;
BA_ "UserSigValidity" SG_ 3221225472 EPB_Logger3_Byte7 0;
BA_ "GenSigSendType" SG_ 3221225472 EPB_Logger3_Byte7 2;
BA_ "UsrSigPurpose" SG_ 3221225472 EPB_Logger3_Byte7 6;
BA_ "Version" SG_ 3221225472 EPB_Logger3_Byte1 "18.08.01";
BA_ "NetworkRequestHoldingTime" SG_ 3221225472 EPB_Logger3_Byte1 5000;
BA_ "NetworkRequest" SG_ 3221225472 EPB_Logger3_Byte1 0;
BA_ "UserSigValidity" SG_ 3221225472 EPB_Logger3_Byte1 0;
BA_ "GenSigSendType" SG_ 3221225472 EPB_Logger3_Byte1 2;
BA_ "UsrSigPurpose" SG_ 3221225472 EPB_Logger3_Byte1 6;
BA_ "Version" SG_ 3221225472 EPB_Logger2_Byte0 "18.08.01";
BA_ "NetworkRequestHoldingTime" SG_ 3221225472 EPB_Logger2_Byte0 5000;
BA_ "NetworkRequest" SG_ 3221225472 EPB_Logger2_Byte0 0;
BA_ "UserSigValidity" SG_ 3221225472 EPB_Logger2_Byte0 0;
BA_ "GenSigSendType" SG_ 3221225472 EPB_Logger2_Byte0 2;
BA_ "UsrSigPurpose" SG_ 3221225472 EPB_Logger2_Byte0 6;
BA_ "Version" SG_ 3221225472 EPB_Logger2_Byte2 "18.08.01";
BA_ "NetworkRequestHoldingTime" SG_ 3221225472 EPB_Logger2_Byte2 5000;
BA_ "NetworkRequest" SG_ 3221225472 EPB_Logger2_Byte2 0;
BA_ "UserSigValidity" SG_ 3221225472 EPB_Logger2_Byte2 0;
BA_ "GenSigSendType" SG_ 3221225472 EPB_Logger2_Byte2 2;
BA_ "UsrSigPurpose" SG_ 3221225472 EPB_Logger2_Byte2 6;
BA_ "Version" SG_ 3221225472 EPB_Logger2_Byte3 "18.08.01";
BA_ "NetworkRequestHoldingTime" SG_ 3221225472 EPB_Logger2_Byte3 5000;
BA_ "NetworkRequest" SG_ 3221225472 EPB_Logger2_Byte3 0;
BA_ "UserSigValidity" SG_ 3221225472 EPB_Logger2_Byte3 0;
BA_ "GenSigSendType" SG_ 3221225472 EPB_Logger2_Byte3 2;
BA_ "UsrSigPurpose" SG_ 3221225472 EPB_Logger2_Byte3 6;
BA_ "Version" SG_ 3221225472 EPB_Logger2_Byte4 "18.08.01";
BA_ "NetworkRequestHoldingTime" SG_ 3221225472 EPB_Logger2_Byte4 5000;
BA_ "NetworkRequest" SG_ 3221225472 EPB_Logger2_Byte4 0;
BA_ "UserSigValidity" SG_ 3221225472 EPB_Logger2_Byte4 0;
BA_ "GenSigSendType" SG_ 3221225472 EPB_Logger2_Byte4 2;
BA_ "UsrSigPurpose" SG_ 3221225472 EPB_Logger2_Byte4 6;
BA_ "Version" SG_ 3221225472 EPB_Logger2_Byte5 "18.08.01";
BA_ "NetworkRequestHoldingTime" SG_ 3221225472 EPB_Logger2_Byte5 5000;
BA_ "NetworkRequest" SG_ 3221225472 EPB_Logger2_Byte5 0;
BA_ "UserSigValidity" SG_ 3221225472 EPB_Logger2_Byte5 0;
BA_ "GenSigSendType" SG_ 3221225472 EPB_Logger2_Byte5 2;
BA_ "UsrSigPurpose" SG_ 3221225472 EPB_Logger2_Byte5 6;
BA_ "Version" SG_ 3221225472 EPB_Logger2_Byte6 "18.08.01";
BA_ "NetworkRequestHoldingTime" SG_ 3221225472 EPB_Logger2_Byte6 5000;
BA_ "NetworkRequest" SG_ 3221225472 EPB_Logger2_Byte6 0;
BA_ "UserSigValidity" SG_ 3221225472 EPB_Logger2_Byte6 0;
BA_ "GenSigSendType" SG_ 3221225472 EPB_Logger2_Byte6 2;
BA_ "UsrSigPurpose" SG_ 3221225472 EPB_Logger2_Byte6 6;
BA_ "Version" SG_ 3221225472 EPB_Logger2_Byte7 "18.08.01";
BA_ "NetworkRequestHoldingTime" SG_ 3221225472 EPB_Logger2_Byte7 5000;
BA_ "NetworkRequest" SG_ 3221225472 EPB_Logger2_Byte7 0;
BA_ "UserSigValidity" SG_ 3221225472 EPB_Logger2_Byte7 0;
BA_ "GenSigSendType" SG_ 3221225472 EPB_Logger2_Byte7 2;
BA_ "UsrSigPurpose" SG_ 3221225472 EPB_Logger2_Byte7 6;
BA_ "Version" SG_ 3221225472 EPB_Logger2_Byte1 "18.08.01";
BA_ "NetworkRequestHoldingTime" SG_ 3221225472 EPB_Logger2_Byte1 5000;
BA_ "NetworkRequest" SG_ 3221225472 EPB_Logger2_Byte1 0;
BA_ "UserSigValidity" SG_ 3221225472 EPB_Logger2_Byte1 0;
BA_ "GenSigSendType" SG_ 3221225472 EPB_Logger2_Byte1 2;
BA_ "UsrSigPurpose" SG_ 3221225472 EPB_Logger2_Byte1 6;
BA_ "Version" SG_ 3221225472 EPB_Logger9_Byte0 "18.08.01";
BA_ "NetworkRequestHoldingTime" SG_ 3221225472 EPB_Logger9_Byte0 5000;
BA_ "NetworkRequest" SG_ 3221225472 EPB_Logger9_Byte0 0;
BA_ "UserSigValidity" SG_ 3221225472 EPB_Logger9_Byte0 0;
BA_ "GenSigSendType" SG_ 3221225472 EPB_Logger9_Byte0 2;
BA_ "UsrSigPurpose" SG_ 3221225472 EPB_Logger9_Byte0 6;
BA_ "Version" SG_ 3221225472 EPB_Logger9_Byte2 "18.08.01";
BA_ "NetworkRequestHoldingTime" SG_ 3221225472 EPB_Logger9_Byte2 5000;
BA_ "NetworkRequest" SG_ 3221225472 EPB_Logger9_Byte2 0;
BA_ "UserSigValidity" SG_ 3221225472 EPB_Logger9_Byte2 0;
BA_ "GenSigSendType" SG_ 3221225472 EPB_Logger9_Byte2 2;
BA_ "UsrSigPurpose" SG_ 3221225472 EPB_Logger9_Byte2 6;
BA_ "Version" SG_ 3221225472 EPB_Logger9_Byte3 "18.08.01";
BA_ "NetworkRequestHoldingTime" SG_ 3221225472 EPB_Logger9_Byte3 5000;
BA_ "NetworkRequest" SG_ 3221225472 EPB_Logger9_Byte3 0;
BA_ "UserSigValidity" SG_ 3221225472 EPB_Logger9_Byte3 0;
BA_ "GenSigSendType" SG_ 3221225472 EPB_Logger9_Byte3 2;
BA_ "UsrSigPurpose" SG_ 3221225472 EPB_Logger9_Byte3 6;
BA_ "Version" SG_ 3221225472 EPB_Logger9_Byte4 "18.08.01";
BA_ "NetworkRequestHoldingTime" SG_ 3221225472 EPB_Logger9_Byte4 5000;
BA_ "NetworkRequest" SG_ 3221225472 EPB_Logger9_Byte4 0;
BA_ "UserSigValidity" SG_ 3221225472 EPB_Logger9_Byte4 0;
BA_ "GenSigSendType" SG_ 3221225472 EPB_Logger9_Byte4 2;
BA_ "UsrSigPurpose" SG_ 3221225472 EPB_Logger9_Byte4 6;
BA_ "Version" SG_ 3221225472 EPB_Logger9_Byte5 "18.08.01";
BA_ "NetworkRequestHoldingTime" SG_ 3221225472 EPB_Logger9_Byte5 5000;
BA_ "NetworkRequest" SG_ 3221225472 EPB_Logger9_Byte5 0;
BA_ "UserSigValidity" SG_ 3221225472 EPB_Logger9_Byte5 0;
BA_ "GenSigSendType" SG_ 3221225472 EPB_Logger9_Byte5 2;
BA_ "UsrSigPurpose" SG_ 3221225472 EPB_Logger9_Byte5 6;
BA_ "Version" SG_ 3221225472 EPB_Logger9_Byte6 "18.08.01";
BA_ "NetworkRequestHoldingTime" SG_ 3221225472 EPB_Logger9_Byte6 5000;
BA_ "NetworkRequest" SG_ 3221225472 EPB_Logger9_Byte6 0;
BA_ "UserSigValidity" SG_ 3221225472 EPB_Logger9_Byte6 0;
BA_ "GenSigSendType" SG_ 3221225472 EPB_Logger9_Byte6 2;
BA_ "UsrSigPurpose" SG_ 3221225472 EPB_Logger9_Byte6 6;
BA_ "Version" SG_ 3221225472 EPB_Logger9_Byte7 "18.08.01";
BA_ "NetworkRequestHoldingTime" SG_ 3221225472 EPB_Logger9_Byte7 5000;
BA_ "NetworkRequest" SG_ 3221225472 EPB_Logger9_Byte7 0;
BA_ "UserSigValidity" SG_ 3221225472 EPB_Logger9_Byte7 0;
BA_ "GenSigSendType" SG_ 3221225472 EPB_Logger9_Byte7 2;
BA_ "UsrSigPurpose" SG_ 3221225472 EPB_Logger9_Byte7 6;
BA_ "Version" SG_ 3221225472 EPB_Logger9_Byte1 "18.08.01";
BA_ "NetworkRequestHoldingTime" SG_ 3221225472 EPB_Logger9_Byte1 5000;
BA_ "NetworkRequest" SG_ 3221225472 EPB_Logger9_Byte1 0;
BA_ "UserSigValidity" SG_ 3221225472 EPB_Logger9_Byte1 0;
BA_ "GenSigSendType" SG_ 3221225472 EPB_Logger9_Byte1 2;
BA_ "UsrSigPurpose" SG_ 3221225472 EPB_Logger9_Byte1 6;
BA_ "Version" SG_ 3221225472 EPB_Logger8_Byte0 "18.08.01";
BA_ "NetworkRequestHoldingTime" SG_ 3221225472 EPB_Logger8_Byte0 5000;
BA_ "NetworkRequest" SG_ 3221225472 EPB_Logger8_Byte0 0;
BA_ "UserSigValidity" SG_ 3221225472 EPB_Logger8_Byte0 0;
BA_ "GenSigSendType" SG_ 3221225472 EPB_Logger8_Byte0 2;
BA_ "UsrSigPurpose" SG_ 3221225472 EPB_Logger8_Byte0 6;
BA_ "Version" SG_ 3221225472 EPB_Logger8_Byte2 "18.08.01";
BA_ "NetworkRequestHoldingTime" SG_ 3221225472 EPB_Logger8_Byte2 5000;
BA_ "NetworkRequest" SG_ 3221225472 EPB_Logger8_Byte2 0;
BA_ "UserSigValidity" SG_ 3221225472 EPB_Logger8_Byte2 0;
BA_ "GenSigSendType" SG_ 3221225472 EPB_Logger8_Byte2 2;
BA_ "UsrSigPurpose" SG_ 3221225472 EPB_Logger8_Byte2 6;
BA_ "Version" SG_ 3221225472 EPB_Logger8_Byte3 "18.08.01";
BA_ "NetworkRequestHoldingTime" SG_ 3221225472 EPB_Logger8_Byte3 5000;
BA_ "NetworkRequest" SG_ 3221225472 EPB_Logger8_Byte3 0;
BA_ "UserSigValidity" SG_ 3221225472 EPB_Logger8_Byte3 0;
BA_ "GenSigSendType" SG_ 3221225472 EPB_Logger8_Byte3 2;
BA_ "UsrSigPurpose" SG_ 3221225472 EPB_Logger8_Byte3 6;
BA_ "Version" SG_ 3221225472 EPB_Logger8_Byte4 "18.08.01";
BA_ "NetworkRequestHoldingTime" SG_ 3221225472 EPB_Logger8_Byte4 5000;
BA_ "NetworkRequest" SG_ 3221225472 EPB_Logger8_Byte4 0;
BA_ "UserSigValidity" SG_ 3221225472 EPB_Logger8_Byte4 0;
BA_ "GenSigSendType" SG_ 3221225472 EPB_Logger8_Byte4 2;
BA_ "UsrSigPurpose" SG_ 3221225472 EPB_Logger8_Byte4 6;
BA_ "Version" SG_ 3221225472 EPB_Logger8_Byte5 "18.08.01";
BA_ "NetworkRequestHoldingTime" SG_ 3221225472 EPB_Logger8_Byte5 5000;
BA_ "NetworkRequest" SG_ 3221225472 EPB_Logger8_Byte5 0;
BA_ "UserSigValidity" SG_ 3221225472 EPB_Logger8_Byte5 0;
BA_ "GenSigSendType" SG_ 3221225472 EPB_Logger8_Byte5 2;
BA_ "UsrSigPurpose" SG_ 3221225472 EPB_Logger8_Byte5 6;
BA_ "Version" SG_ 3221225472 EPB_Logger8_Byte6 "18.08.01";
BA_ "NetworkRequestHoldingTime" SG_ 3221225472 EPB_Logger8_Byte6 5000;
BA_ "NetworkRequest" SG_ 3221225472 EPB_Logger8_Byte6 0;
BA_ "UserSigValidity" SG_ 3221225472 EPB_Logger8_Byte6 0;
BA_ "GenSigSendType" SG_ 3221225472 EPB_Logger8_Byte6 2;
BA_ "UsrSigPurpose" SG_ 3221225472 EPB_Logger8_Byte6 6;
BA_ "Version" SG_ 3221225472 EPB_Logger8_Byte7 "18.08.01";
BA_ "NetworkRequestHoldingTime" SG_ 3221225472 EPB_Logger8_Byte7 5000;
BA_ "NetworkRequest" SG_ 3221225472 EPB_Logger8_Byte7 0;
BA_ "UserSigValidity" SG_ 3221225472 EPB_Logger8_Byte7 0;
BA_ "GenSigSendType" SG_ 3221225472 EPB_Logger8_Byte7 2;
BA_ "UsrSigPurpose" SG_ 3221225472 EPB_Logger8_Byte7 6;
BA_ "Version" SG_ 3221225472 EPB_Logger8_Byte1 "18.08.01";
BA_ "NetworkRequestHoldingTime" SG_ 3221225472 EPB_Logger8_Byte1 5000;
BA_ "NetworkRequest" SG_ 3221225472 EPB_Logger8_Byte1 0;
BA_ "UserSigValidity" SG_ 3221225472 EPB_Logger8_Byte1 0;
BA_ "GenSigSendType" SG_ 3221225472 EPB_Logger8_Byte1 2;
BA_ "UsrSigPurpose" SG_ 3221225472 EPB_Logger8_Byte1 6;
BA_ "Version" SG_ 3221225472 EPB_Logger7_Byte0 "18.08.01";
BA_ "NetworkRequestHoldingTime" SG_ 3221225472 EPB_Logger7_Byte0 5000;
BA_ "NetworkRequest" SG_ 3221225472 EPB_Logger7_Byte0 0;
BA_ "UserSigValidity" SG_ 3221225472 EPB_Logger7_Byte0 0;
BA_ "GenSigSendType" SG_ 3221225472 EPB_Logger7_Byte0 2;
BA_ "UsrSigPurpose" SG_ 3221225472 EPB_Logger7_Byte0 6;
BA_ "Version" SG_ 3221225472 EPB_Logger7_Byte2 "18.08.01";
BA_ "NetworkRequestHoldingTime" SG_ 3221225472 EPB_Logger7_Byte2 5000;
BA_ "NetworkRequest" SG_ 3221225472 EPB_Logger7_Byte2 0;
BA_ "UserSigValidity" SG_ 3221225472 EPB_Logger7_Byte2 0;
BA_ "GenSigSendType" SG_ 3221225472 EPB_Logger7_Byte2 2;
BA_ "UsrSigPurpose" SG_ 3221225472 EPB_Logger7_Byte2 6;
BA_ "Version" SG_ 3221225472 EPB_Logger7_Byte3 "18.08.01";
BA_ "NetworkRequestHoldingTime" SG_ 3221225472 EPB_Logger7_Byte3 5000;
BA_ "NetworkRequest" SG_ 3221225472 EPB_Logger7_Byte3 0;
BA_ "UserSigValidity" SG_ 3221225472 EPB_Logger7_Byte3 0;
BA_ "GenSigSendType" SG_ 3221225472 EPB_Logger7_Byte3 2;
BA_ "UsrSigPurpose" SG_ 3221225472 EPB_Logger7_Byte3 6;
BA_ "Version" SG_ 3221225472 EPB_Logger7_Byte4 "18.08.01";
BA_ "NetworkRequestHoldingTime" SG_ 3221225472 EPB_Logger7_Byte4 5000;
BA_ "NetworkRequest" SG_ 3221225472 EPB_Logger7_Byte4 0;
BA_ "UserSigValidity" SG_ 3221225472 EPB_Logger7_Byte4 0;
BA_ "GenSigSendType" SG_ 3221225472 EPB_Logger7_Byte4 2;
BA_ "UsrSigPurpose" SG_ 3221225472 EPB_Logger7_Byte4 6;
BA_ "Version" SG_ 3221225472 EPB_Logger7_Byte5 "18.08.01";
BA_ "NetworkRequestHoldingTime" SG_ 3221225472 EPB_Logger7_Byte5 5000;
BA_ "NetworkRequest" SG_ 3221225472 EPB_Logger7_Byte5 0;
BA_ "UserSigValidity" SG_ 3221225472 EPB_Logger7_Byte5 0;
BA_ "GenSigSendType" SG_ 3221225472 EPB_Logger7_Byte5 2;
BA_ "UsrSigPurpose" SG_ 3221225472 EPB_Logger7_Byte5 6;
BA_ "Version" SG_ 3221225472 EPB_Logger7_Byte6 "18.08.01";
BA_ "NetworkRequestHoldingTime" SG_ 3221225472 EPB_Logger7_Byte6 5000;
BA_ "NetworkRequest" SG_ 3221225472 EPB_Logger7_Byte6 0;
BA_ "UserSigValidity" SG_ 3221225472 EPB_Logger7_Byte6 0;
BA_ "GenSigSendType" SG_ 3221225472 EPB_Logger7_Byte6 2;
BA_ "UsrSigPurpose" SG_ 3221225472 EPB_Logger7_Byte6 6;
BA_ "Version" SG_ 3221225472 EPB_Logger7_Byte7 "18.08.01";
BA_ "NetworkRequestHoldingTime" SG_ 3221225472 EPB_Logger7_Byte7 5000;
BA_ "NetworkRequest" SG_ 3221225472 EPB_Logger7_Byte7 0;
BA_ "UserSigValidity" SG_ 3221225472 EPB_Logger7_Byte7 0;
BA_ "GenSigSendType" SG_ 3221225472 EPB_Logger7_Byte7 2;
BA_ "UsrSigPurpose" SG_ 3221225472 EPB_Logger7_Byte7 6;
BA_ "Version" SG_ 3221225472 EPB_Logger7_Byte1 "18.08.01";
BA_ "NetworkRequestHoldingTime" SG_ 3221225472 EPB_Logger7_Byte1 5000;
BA_ "NetworkRequest" SG_ 3221225472 EPB_Logger7_Byte1 0;
BA_ "UserSigValidity" SG_ 3221225472 EPB_Logger7_Byte1 0;
BA_ "GenSigSendType" SG_ 3221225472 EPB_Logger7_Byte1 2;
BA_ "UsrSigPurpose" SG_ 3221225472 EPB_Logger7_Byte1 6;
BA_ "Version" SG_ 3221225472 EPB_Logger6_Byte0 "18.08.01";
BA_ "NetworkRequestHoldingTime" SG_ 3221225472 EPB_Logger6_Byte0 5000;
BA_ "NetworkRequest" SG_ 3221225472 EPB_Logger6_Byte0 0;
BA_ "UserSigValidity" SG_ 3221225472 EPB_Logger6_Byte0 0;
BA_ "GenSigSendType" SG_ 3221225472 EPB_Logger6_Byte0 2;
BA_ "UsrSigPurpose" SG_ 3221225472 EPB_Logger6_Byte0 6;
BA_ "Version" SG_ 3221225472 EPB_Logger6_Byte2 "18.08.01";
BA_ "NetworkRequestHoldingTime" SG_ 3221225472 EPB_Logger6_Byte2 5000;
BA_ "NetworkRequest" SG_ 3221225472 EPB_Logger6_Byte2 0;
BA_ "UserSigValidity" SG_ 3221225472 EPB_Logger6_Byte2 0;
BA_ "GenSigSendType" SG_ 3221225472 EPB_Logger6_Byte2 2;
BA_ "UsrSigPurpose" SG_ 3221225472 EPB_Logger6_Byte2 6;
BA_ "Version" SG_ 3221225472 EPB_Logger6_Byte3 "18.08.01";
BA_ "NetworkRequestHoldingTime" SG_ 3221225472 EPB_Logger6_Byte3 5000;
BA_ "NetworkRequest" SG_ 3221225472 EPB_Logger6_Byte3 0;
BA_ "UserSigValidity" SG_ 3221225472 EPB_Logger6_Byte3 0;
BA_ "GenSigSendType" SG_ 3221225472 EPB_Logger6_Byte3 2;
BA_ "UsrSigPurpose" SG_ 3221225472 EPB_Logger6_Byte3 6;
BA_ "Version" SG_ 3221225472 EPB_Logger6_Byte4 "18.08.01";
BA_ "NetworkRequestHoldingTime" SG_ 3221225472 EPB_Logger6_Byte4 5000;
BA_ "NetworkRequest" SG_ 3221225472 EPB_Logger6_Byte4 0;
BA_ "UserSigValidity" SG_ 3221225472 EPB_Logger6_Byte4 0;
BA_ "GenSigSendType" SG_ 3221225472 EPB_Logger6_Byte4 2;
BA_ "UsrSigPurpose" SG_ 3221225472 EPB_Logger6_Byte4 6;
BA_ "Version" SG_ 3221225472 EPB_Logger6_Byte5 "18.08.01";
BA_ "NetworkRequestHoldingTime" SG_ 3221225472 EPB_Logger6_Byte5 5000;
BA_ "NetworkRequest" SG_ 3221225472 EPB_Logger6_Byte5 0;
BA_ "UserSigValidity" SG_ 3221225472 EPB_Logger6_Byte5 0;
BA_ "GenSigSendType" SG_ 3221225472 EPB_Logger6_Byte5 2;
BA_ "UsrSigPurpose" SG_ 3221225472 EPB_Logger6_Byte5 6;
BA_ "Version" SG_ 3221225472 EPB_Logger6_Byte6 "18.08.01";
BA_ "NetworkRequestHoldingTime" SG_ 3221225472 EPB_Logger6_Byte6 5000;
BA_ "NetworkRequest" SG_ 3221225472 EPB_Logger6_Byte6 0;
BA_ "UserSigValidity" SG_ 3221225472 EPB_Logger6_Byte6 0;
BA_ "GenSigSendType" SG_ 3221225472 EPB_Logger6_Byte6 2;
BA_ "UsrSigPurpose" SG_ 3221225472 EPB_Logger6_Byte6 6;
BA_ "Version" SG_ 3221225472 EPB_Logger6_Byte7 "18.08.01";
BA_ "NetworkRequestHoldingTime" SG_ 3221225472 EPB_Logger6_Byte7 5000;
BA_ "NetworkRequest" SG_ 3221225472 EPB_Logger6_Byte7 0;
BA_ "UserSigValidity" SG_ 3221225472 EPB_Logger6_Byte7 0;
BA_ "GenSigSendType" SG_ 3221225472 EPB_Logger6_Byte7 2;
BA_ "UsrSigPurpose" SG_ 3221225472 EPB_Logger6_Byte7 6;
BA_ "Version" SG_ 3221225472 EPB_Logger6_Byte1 "18.08.01";
BA_ "NetworkRequestHoldingTime" SG_ 3221225472 EPB_Logger6_Byte1 5000;
BA_ "NetworkRequest" SG_ 3221225472 EPB_Logger6_Byte1 0;
BA_ "UserSigValidity" SG_ 3221225472 EPB_Logger6_Byte1 0;
BA_ "GenSigSendType" SG_ 3221225472 EPB_Logger6_Byte1 2;
BA_ "UsrSigPurpose" SG_ 3221225472 EPB_Logger6_Byte1 6;
BA_ "Version" SG_ 3221225472 PSB_Crc1Val "18.11.08";
BA_ "UserSigValidity" SG_ 3221225472 PSB_Crc1Val 0;
BA_ "Description" SG_ 3221225472 PSB_Crc1Val "The data area for CRC calculation is based on the data length (DLC) of the message DB.

The CRC shall be calculated over the entire data block (excluding the CRC bytes) including the user data, alive counter and Data ID 

 

- CRC Polynomial (0x1D) , Ini";
BA_ "Version" SG_ 3221225472 PSB_AlvCnt1Val "18.11.08";
BA_ "UserSigValidity" SG_ 3221225472 PSB_AlvCnt1Val 0;
BA_ "Description" SG_ 3221225472 PSB_AlvCnt1Val "For the first transmission request for a data element the counter shall be initialized with 0 and shall be incremented by 1

for every subsequent send request. When the counter reaches the maximum value(0xE), then it shall restart with 0 for the next sen";
BA_ "Version" SG_ 3221225472 PSB_LHFlrSta "18.02.03";
BA_ "UserSigValidity" SG_ 3221225472 PSB_LHFlrSta 0;
BA_ "Description" SG_ 3221225472 PSB_LHFlrSta "Information about availability of PSB_LH (LH Pre-Safe S/Belt).";
BA_ "Version" SG_ 3221225472 PSB_LHActvSta "18.02.03";
BA_ "UserSigValidity" SG_ 3221225472 PSB_LHActvSta 0;
BA_ "Description" SG_ 3221225472 PSB_LHActvSta "Seat belt active state. This signal is for the monitoring of Pre-Safe S/Belt.

If there is a request, but no realization by the Pre-Safe S/Belt -> failure entry in the SCC(Radar).";
BA_ "Version" SG_ 3221225472 PSB_RHFlrSta "18.02.03";
BA_ "UserSigValidity" SG_ 3221225472 PSB_RHFlrSta 0;
BA_ "Description" SG_ 3221225472 PSB_RHFlrSta "Information about availability of PSB_RH (LH Pre-Safe S/Belt).";
BA_ "Version" SG_ 3221225472 PSB_RHActvSta "18.02.03";
BA_ "UserSigValidity" SG_ 3221225472 PSB_RHActvSta 0;
BA_ "Description" SG_ 3221225472 PSB_RHActvSta "Seat belt active state. This signal is for the monitoring of Pre-Safe S/Belt.

If there is a request, but no realization by the Pre-Safe S/Belt -> failure entry in the SCC(Radar).";
BA_ "Version" SG_ 3221225472 PSB_ActForAcu "18.02.03";
BA_ "UserSigValidity" SG_ 3221225472 PSB_ActForAcu 0;
BA_ "Description" SG_ 3221225472 PSB_ActForAcu "This signal indicates status of Pre-Safe S/Belt activation by ACU commends.";
BA_ "Version" SG_ 3221225472 GST_LPI_DCU_ESC_IEB_Byte0 "19.01.06";
BA_ "NetworkRequestHoldingTime" SG_ 3221225472 GST_LPI_DCU_ESC_IEB_Byte0 5000;
BA_ "NetworkRequest" SG_ 3221225472 GST_LPI_DCU_ESC_IEB_Byte0 0;
BA_ "UserSigValidity" SG_ 3221225472 GST_LPI_DCU_ESC_IEB_Byte0 0;
BA_ "GenSigSendType" SG_ 3221225472 GST_LPI_DCU_ESC_IEB_Byte0 2;
BA_ "UsrSigPurpose" SG_ 3221225472 GST_LPI_DCU_ESC_IEB_Byte0 2;
BA_ "Version" SG_ 3221225472 GST_LPI_DCU_ESC_IEB_Byte2 "19.01.06";
BA_ "NetworkRequestHoldingTime" SG_ 3221225472 GST_LPI_DCU_ESC_IEB_Byte2 5000;
BA_ "NetworkRequest" SG_ 3221225472 GST_LPI_DCU_ESC_IEB_Byte2 0;
BA_ "UserSigValidity" SG_ 3221225472 GST_LPI_DCU_ESC_IEB_Byte2 0;
BA_ "GenSigSendType" SG_ 3221225472 GST_LPI_DCU_ESC_IEB_Byte2 2;
BA_ "UsrSigPurpose" SG_ 3221225472 GST_LPI_DCU_ESC_IEB_Byte2 2;
BA_ "Version" SG_ 3221225472 GST_LPI_DCU_ESC_IEB_Byte3 "19.01.06";
BA_ "NetworkRequestHoldingTime" SG_ 3221225472 GST_LPI_DCU_ESC_IEB_Byte3 5000;
BA_ "NetworkRequest" SG_ 3221225472 GST_LPI_DCU_ESC_IEB_Byte3 0;
BA_ "UserSigValidity" SG_ 3221225472 GST_LPI_DCU_ESC_IEB_Byte3 0;
BA_ "GenSigSendType" SG_ 3221225472 GST_LPI_DCU_ESC_IEB_Byte3 2;
BA_ "UsrSigPurpose" SG_ 3221225472 GST_LPI_DCU_ESC_IEB_Byte3 2;
BA_ "Version" SG_ 3221225472 GST_LPI_DCU_ESC_IEB_Byte4 "19.01.06";
BA_ "NetworkRequestHoldingTime" SG_ 3221225472 GST_LPI_DCU_ESC_IEB_Byte4 5000;
BA_ "NetworkRequest" SG_ 3221225472 GST_LPI_DCU_ESC_IEB_Byte4 0;
BA_ "UserSigValidity" SG_ 3221225472 GST_LPI_DCU_ESC_IEB_Byte4 0;
BA_ "GenSigSendType" SG_ 3221225472 GST_LPI_DCU_ESC_IEB_Byte4 2;
BA_ "UsrSigPurpose" SG_ 3221225472 GST_LPI_DCU_ESC_IEB_Byte4 2;
BA_ "Version" SG_ 3221225472 GST_LPI_DCU_ESC_IEB_Byte5 "19.01.06";
BA_ "NetworkRequestHoldingTime" SG_ 3221225472 GST_LPI_DCU_ESC_IEB_Byte5 5000;
BA_ "NetworkRequest" SG_ 3221225472 GST_LPI_DCU_ESC_IEB_Byte5 0;
BA_ "UserSigValidity" SG_ 3221225472 GST_LPI_DCU_ESC_IEB_Byte5 0;
BA_ "GenSigSendType" SG_ 3221225472 GST_LPI_DCU_ESC_IEB_Byte5 2;
BA_ "UsrSigPurpose" SG_ 3221225472 GST_LPI_DCU_ESC_IEB_Byte5 2;
BA_ "Version" SG_ 3221225472 GST_LPI_DCU_ESC_IEB_Byte6 "19.01.06";
BA_ "NetworkRequestHoldingTime" SG_ 3221225472 GST_LPI_DCU_ESC_IEB_Byte6 5000;
BA_ "NetworkRequest" SG_ 3221225472 GST_LPI_DCU_ESC_IEB_Byte6 0;
BA_ "UserSigValidity" SG_ 3221225472 GST_LPI_DCU_ESC_IEB_Byte6 0;
BA_ "GenSigSendType" SG_ 3221225472 GST_LPI_DCU_ESC_IEB_Byte6 2;
BA_ "UsrSigPurpose" SG_ 3221225472 GST_LPI_DCU_ESC_IEB_Byte6 2;
BA_ "Version" SG_ 3221225472 GST_LPI_DCU_ESC_IEB_Byte7 "19.01.06";
BA_ "NetworkRequestHoldingTime" SG_ 3221225472 GST_LPI_DCU_ESC_IEB_Byte7 5000;
BA_ "NetworkRequest" SG_ 3221225472 GST_LPI_DCU_ESC_IEB_Byte7 0;
BA_ "UserSigValidity" SG_ 3221225472 GST_LPI_DCU_ESC_IEB_Byte7 0;
BA_ "GenSigSendType" SG_ 3221225472 GST_LPI_DCU_ESC_IEB_Byte7 2;
BA_ "UsrSigPurpose" SG_ 3221225472 GST_LPI_DCU_ESC_IEB_Byte7 2;
BA_ "Version" SG_ 3221225472 GST_LPI_DCU_ESC_IEB_Byte1 "19.01.06";
BA_ "NetworkRequestHoldingTime" SG_ 3221225472 GST_LPI_DCU_ESC_IEB_Byte1 5000;
BA_ "NetworkRequest" SG_ 3221225472 GST_LPI_DCU_ESC_IEB_Byte1 0;
BA_ "UserSigValidity" SG_ 3221225472 GST_LPI_DCU_ESC_IEB_Byte1 0;
BA_ "GenSigSendType" SG_ 3221225472 GST_LPI_DCU_ESC_IEB_Byte1 2;
BA_ "UsrSigPurpose" SG_ 3221225472 GST_LPI_DCU_ESC_IEB_Byte1 2;
BA_ "Version" SG_ 3221225472 POS_V2_Offset "18.01.07";
BA_ "UserSigValidity" SG_ 3221225472 POS_V2_Offset 3;
BA_ "GenSigStartValue" SG_ 3221225472 POS_V2_Offset 8191;
BA_ "GenSigSendType" SG_ 3221225472 POS_V2_Offset 4;
BA_ "Description" SG_ 3221225472 POS_V2_Offset "[Default Value]

0x1FFF";
BA_ "Version" SG_ 3221225472 POS_V2_PathIndex "18.01.07";
BA_ "UserSigValidity" SG_ 3221225472 POS_V2_PathIndex 3;
BA_ "GenSigSendType" SG_ 3221225472 POS_V2_PathIndex 4;
BA_ "Description" SG_ 3221225472 POS_V2_PathIndex "[Default Value]

0x0";
BA_ "Version" SG_ 3221225472 POS_V2_CyclicCounter "18.01.07";
BA_ "UserSigValidity" SG_ 3221225472 POS_V2_CyclicCounter 3;
BA_ "GenSigSendType" SG_ 3221225472 POS_V2_CyclicCounter 4;
BA_ "Description" SG_ 3221225472 POS_V2_CyclicCounter "[Default Value]

0x0";
BA_ "Version" SG_ 3221225472 POS_V2_RangeAvgSpeed "18.01.07";
BA_ "UserSigValidity" SG_ 3221225472 POS_V2_RangeAvgSpeed 3;
BA_ "GenSigStartValue" SG_ 3221225472 POS_V2_RangeAvgSpeed 511;
BA_ "GenSigSendType" SG_ 3221225472 POS_V2_RangeAvgSpeed 4;
BA_ "Description" SG_ 3221225472 POS_V2_RangeAvgSpeed "[Default Value]

0x0";
BA_ "Version" SG_ 3221225472 POS_V2_CurrAltitude100m "18.01.07";
BA_ "UserSigValidity" SG_ 3221225472 POS_V2_CurrAltitude100m 3;
BA_ "GenSigStartValue" SG_ 3221225472 POS_V2_CurrAltitude100m 63;
BA_ "GenSigSendType" SG_ 3221225472 POS_V2_CurrAltitude100m 4;
BA_ "Description" SG_ 3221225472 POS_V2_CurrAltitude100m "[Default Vaule]



0x0";
BA_ "Version" SG_ 3221225472 POS_V2_CurrAltitude1m "18.01.07";
BA_ "UserSigValidity" SG_ 3221225472 POS_V2_CurrAltitude1m 3;
BA_ "GenSigStartValue" SG_ 3221225472 POS_V2_CurrAltitude1m 127;
BA_ "GenSigSendType" SG_ 3221225472 POS_V2_CurrAltitude1m 4;
BA_ "Description" SG_ 3221225472 POS_V2_CurrAltitude1m "[Default Vaule]



0x0";
BA_ "Version" SG_ 3221225472 POS_V2_CurrFuncRoadClass "18.01.07";
BA_ "UserSigValidity" SG_ 3221225472 POS_V2_CurrFuncRoadClass 3;
BA_ "GenSigStartValue" SG_ 3221225472 POS_V2_CurrFuncRoadClass 7;
BA_ "GenSigSendType" SG_ 3221225472 POS_V2_CurrFuncRoadClass 4;
BA_ "Description" SG_ 3221225472 POS_V2_CurrFuncRoadClass "[Default Vaule]



0x0";
BA_ "Version" SG_ 3221225472 POS_V2_CurrFormOfWay "18.01.07";
BA_ "UserSigValidity" SG_ 3221225472 POS_V2_CurrFormOfWay 3;
BA_ "GenSigStartValue" SG_ 3221225472 POS_V2_CurrFormOfWay 15;
BA_ "GenSigSendType" SG_ 3221225472 POS_V2_CurrFormOfWay 4;
BA_ "Description" SG_ 3221225472 POS_V2_CurrFormOfWay "[Default Vaule]



0x0";
BA_ "Version" SG_ 3221225472 POS_V2_CurrDirectionLanes "18.01.07";
BA_ "UserSigValidity" SG_ 3221225472 POS_V2_CurrDirectionLanes 3;
BA_ "GenSigStartValue" SG_ 3221225472 POS_V2_CurrDirectionLanes 15;
BA_ "GenSigSendType" SG_ 3221225472 POS_V2_CurrDirectionLanes 4;
BA_ "Description" SG_ 3221225472 POS_V2_CurrDirectionLanes "[Default Vaule]



0x0";
BA_ "Version" SG_ 3221225472 POS_V2_CurrSpeedLimit "18.01.07";
BA_ "UserSigValidity" SG_ 3221225472 POS_V2_CurrSpeedLimit 3;
BA_ "GenSigStartValue" SG_ 3221225472 POS_V2_CurrSpeedLimit 31;
BA_ "GenSigSendType" SG_ 3221225472 POS_V2_CurrSpeedLimit 4;
BA_ "Description" SG_ 3221225472 POS_V2_CurrSpeedLimit "[Default Vaule]



0x0";
BA_ "Version" SG_ 3221225472 POS_V2_CurrTrafficSpeed "18.01.07";
BA_ "UserSigValidity" SG_ 3221225472 POS_V2_CurrTrafficSpeed 3;
BA_ "GenSigStartValue" SG_ 3221225472 POS_V2_CurrTrafficSpeed 31;
BA_ "GenSigSendType" SG_ 3221225472 POS_V2_CurrTrafficSpeed 4;
BA_ "Description" SG_ 3221225472 POS_V2_CurrTrafficSpeed "[Default Vaule]

0x0";
BA_ "Version" SG_ 3221225472 VCU_Crc5Val "19.03.03";
BA_ "RoutingFactor" SG_ 3221225472 VCU_Crc5Val 2;
BA_ "UserSigValidity" SG_ 3221225472 VCU_Crc5Val 7;
BA_ "GenSigStartValue" SG_ 3221225472 VCU_Crc5Val 65535;
BA_ "Description" SG_ 3221225472 VCU_Crc5Val "The CRC checking process calculates the CRC over the entire data block, including the CRC result.

- CRC Polynomial (0x1021) , Initial Value : 0xFFFF, XOR value : 0x0000

- The mathematical expression to 16 bit CRC polynomial is given here. G(x) = x16 + ";
BA_ "Version" SG_ 3221225472 VCU_EnergyFlowSta "19.03.03";
BA_ "RoutingFactor" SG_ 3221225472 VCU_EnergyFlowSta 2;
BA_ "UserSigValidity" SG_ 3221225472 VCU_EnergyFlowSta 7;
BA_ "Description" SG_ 3221225472 VCU_EnergyFlowSta "Energy Flow Display Status";
BA_ "Version" SG_ 3221225472 VCU_SbwWarnSndSta "19.06.02";
BA_ "RoutingFactor" SG_ 3221225472 VCU_SbwWarnSndSta 2;
BA_ "UserSigValidity" SG_ 3221225472 VCU_SbwWarnSndSta 7;
BA_ "Description" SG_ 3221225472 VCU_SbwWarnSndSta "SBW Warning Sound";
BA_ "Version" SG_ 3221225472 VCU_EcoGuide_DispReq "19.03.03";
BA_ "RoutingFactor" SG_ 3221225472 VCU_EcoGuide_DispReq 2;
BA_ "UserSigValidity" SG_ 3221225472 VCU_EcoGuide_DispReq 7;
BA_ "Description" SG_ 3221225472 VCU_EcoGuide_DispReq "Display On/Off";
BA_ "Version" SG_ 3221225472 VCU_EcoGuide_ApsGaugeVal "19.03.03";
BA_ "RoutingFactor" SG_ 3221225472 VCU_EcoGuide_ApsGaugeVal 2;
BA_ "UserSigValidity" SG_ 3221225472 VCU_EcoGuide_ApsGaugeVal 7;
BA_ "Description" SG_ 3221225472 VCU_EcoGuide_ApsGaugeVal "APS Gauge Display for Smart ECO Guide";
BA_ "Version" SG_ 3221225472 VCU_EcoGuide_EcoGaugeVal "19.03.03";
BA_ "RoutingFactor" SG_ 3221225472 VCU_EcoGuide_EcoGaugeVal 2;
BA_ "UserSigValidity" SG_ 3221225472 VCU_EcoGuide_EcoGaugeVal 7;
BA_ "Description" SG_ 3221225472 VCU_EcoGuide_EcoGaugeVal "ECO Range Display for Smart ECO Guide";
BA_ "Version" SG_ 3221225472 VCU_TgSocDteAcChgVal "19.03.03";
BA_ "RoutingFactor" SG_ 3221225472 VCU_TgSocDteAcChgVal 2;
BA_ "UserSigValidity" SG_ 3221225472 VCU_TgSocDteAcChgVal 7;
BA_ "Description" SG_ 3221225472 VCU_TgSocDteAcChgVal "Estimated DTE for slow charger(SC/AC) target SOC";
BA_ "Version" SG_ 3221225472 VCU_TgSocDteDcChgVal "19.03.03";
BA_ "RoutingFactor" SG_ 3221225472 VCU_TgSocDteDcChgVal 2;
BA_ "UserSigValidity" SG_ 3221225472 VCU_TgSocDteDcChgVal 7;
BA_ "Description" SG_ 3221225472 VCU_TgSocDteDcChgVal "Estimated DTE for fast charger(QC/DC) target SOC";
BA_ "Version" SG_ 3221225472 VCU_DistFromRegenDispReq "19.03.03";
BA_ "RoutingFactor" SG_ 3221225472 VCU_DistFromRegenDispReq 2;
BA_ "UserSigValidity" SG_ 3221225472 VCU_DistFromRegenDispReq 7;
BA_ "Description" SG_ 3221225472 VCU_DistFromRegenDispReq "Distance from Regeneration Display status";
BA_ "Version" SG_ 3221225472 VCU_DistFromRegenVal "19.03.03";
BA_ "RoutingFactor" SG_ 3221225472 VCU_DistFromRegenVal 2;
BA_ "UserSigValidity" SG_ 3221225472 VCU_DistFromRegenVal 7;
BA_ "Description" SG_ 3221225472 VCU_DistFromRegenVal "DTE Increment at Regeneration";
BA_ "Version" SG_ 3221225472 VCU_AlvCnt5Val "19.03.03";
BA_ "RoutingFactor" SG_ 3221225472 VCU_AlvCnt5Val 2;
BA_ "UserSigValidity" SG_ 3221225472 VCU_AlvCnt5Val 7;
BA_ "Description" SG_ 3221225472 VCU_AlvCnt5Val "For the first transmission request for a data element the counter shall be initialized with 0 and shall be incremented by 1

for every subsequent send request. When the counter reaches the maximum value(0xFF), then it shall restart with ? for the next se";
BA_ "Version" SG_ 3221225472 VCU_DrvStyle_DispReq "19.03.03";
BA_ "RoutingFactor" SG_ 3221225472 VCU_DrvStyle_DispReq 2;
BA_ "UserSigValidity" SG_ 3221225472 VCU_DrvStyle_DispReq 7;
BA_ "Description" SG_ 3221225472 VCU_DrvStyle_DispReq "Fuel Efficiency Percent Display Status";
BA_ "Version" SG_ 3221225472 VCU_DrvStyle_HighLightSta "19.03.03";
BA_ "RoutingFactor" SG_ 3221225472 VCU_DrvStyle_HighLightSta 2;
BA_ "UserSigValidity" SG_ 3221225472 VCU_DrvStyle_HighLightSta 7;
BA_ "Description" SG_ 3221225472 VCU_DrvStyle_HighLightSta "Fuel Efficiency High Light Status";
BA_ "Version" SG_ 3221225472 VCU_DrvStyle_EcoVal "19.03.03";
BA_ "RoutingFactor" SG_ 3221225472 VCU_DrvStyle_EcoVal 2;
BA_ "UserSigValidity" SG_ 3221225472 VCU_DrvStyle_EcoVal 7;
BA_ "Description" SG_ 3221225472 VCU_DrvStyle_EcoVal "High Fuel Efficiency Percent Value";
BA_ "Version" SG_ 3221225472 VCU_DrvStyle_NonEcoVal "19.03.03";
BA_ "RoutingFactor" SG_ 3221225472 VCU_DrvStyle_NonEcoVal 2;
BA_ "UserSigValidity" SG_ 3221225472 VCU_DrvStyle_NonEcoVal 7;
BA_ "Description" SG_ 3221225472 VCU_DrvStyle_NonEcoVal "Low Fuel Efficiency Percent Value";
BA_ "Version" SG_ 3221225472 VCU_DrvStyle_NorVal "19.03.03";
BA_ "RoutingFactor" SG_ 3221225472 VCU_DrvStyle_NorVal 2;
BA_ "UserSigValidity" SG_ 3221225472 VCU_DrvStyle_NorVal 7;
BA_ "Description" SG_ 3221225472 VCU_DrvStyle_NorVal "Normal Fuel Efficiency Percent Value";
BA_ "Version" SG_ 3221225472 VCU_EcoPotential_EcoVal "19.03.03";
BA_ "RoutingFactor" SG_ 3221225472 VCU_EcoPotential_EcoVal 2;
BA_ "UserSigValidity" SG_ 3221225472 VCU_EcoPotential_EcoVal 7;
BA_ "Description" SG_ 3221225472 VCU_EcoPotential_EcoVal "EcoPotential_Eco";
BA_ "Version" SG_ 3221225472 VCU_EcoPotential_NorVal "19.03.03";
BA_ "RoutingFactor" SG_ 3221225472 VCU_EcoPotential_NorVal 2;
BA_ "UserSigValidity" SG_ 3221225472 VCU_EcoPotential_NorVal 7;
BA_ "Description" SG_ 3221225472 VCU_EcoPotential_NorVal "EcoPotential_Normal";
BA_ "Version" SG_ 3221225472 VCU_EcoPotential_SptVal "19.03.03";
BA_ "RoutingFactor" SG_ 3221225472 VCU_EcoPotential_SptVal 2;
BA_ "UserSigValidity" SG_ 3221225472 VCU_EcoPotential_SptVal 7;
BA_ "Description" SG_ 3221225472 VCU_EcoPotential_SptVal "EcoPotential_Sport";
BA_ "Version" SG_ 3221225472 VCU_InstFuelEcoVal_Per100km "19.03.03";
BA_ "RoutingFactor" SG_ 3221225472 VCU_InstFuelEcoVal_Per100km 2;
BA_ "UserSigValidity" SG_ 3221225472 VCU_InstFuelEcoVal_Per100km 7;
BA_ "Description" SG_ 3221225472 VCU_InstFuelEcoVal_Per100km "Instant Fuel Economy(kWh/100km)";
BA_ "Version" SG_ 3221225472 VCU_InstFuelEcoVal_PerkWh "19.03.03";
BA_ "RoutingFactor" SG_ 3221225472 VCU_InstFuelEcoVal_PerkWh 2;
BA_ "UserSigValidity" SG_ 3221225472 VCU_InstFuelEcoVal_PerkWh 7;
BA_ "Description" SG_ 3221225472 VCU_InstFuelEcoVal_PerkWh "Fuel Economy in EV";
BA_ "Version" SG_ 3221225472 VCU_CO2RdcTripDistVal "19.03.03";
BA_ "RoutingFactor" SG_ 3221225472 VCU_CO2RdcTripDistVal 2;
BA_ "UserSigValidity" SG_ 3221225472 VCU_CO2RdcTripDistVal 7;
BA_ "Description" SG_ 3221225472 VCU_CO2RdcTripDistVal "Trip Distance for CO2 Reduction";
BA_ "Version" SG_ 3221225472 VCU_EvDrvRdyCluDispSta "19.04.00";
BA_ "RoutingFactor" SG_ 3221225472 VCU_EvDrvRdyCluDispSta 2;
BA_ "UserSigValidity" SG_ 3221225472 VCU_EvDrvRdyCluDispSta 7;
BA_ "Description" SG_ 3221225472 VCU_EvDrvRdyCluDispSta "EV Drive Ready for Cluster Display Only";
BA_ "Version" SG_ 3221225472 VCU_CO2RdcVal "19.03.03";
BA_ "RoutingFactor" SG_ 3221225472 VCU_CO2RdcVal 2;
BA_ "UserSigValidity" SG_ 3221225472 VCU_CO2RdcVal 7;
BA_ "Description" SG_ 3221225472 VCU_CO2RdcVal "CO2 Reduction Amount(Integrated Value)";
BA_ "Version" SG_ 3221225472 VCU_PwrDnModeSta "19.03.03";
BA_ "RoutingFactor" SG_ 3221225472 VCU_PwrDnModeSta 2;
BA_ "UserSigValidity" SG_ 3221225472 VCU_PwrDnModeSta 7;
BA_ "Description" SG_ 3221225472 VCU_PwrDnModeSta "Power Down Mode";
BA_ "Version" SG_ 3221225472 VCU_CluWarnMsgSta "19.03.03";
BA_ "RoutingFactor" SG_ 3221225472 VCU_CluWarnMsgSta 2;
BA_ "UserSigValidity" SG_ 3221225472 VCU_CluWarnMsgSta 7;
BA_ "Description" SG_ 3221225472 VCU_CluWarnMsgSta "Cluster Warning Message";
BA_ "Version" SG_ 3221225472 VCU_DteOffDispSta "19.06.02";
BA_ "RoutingFactor" SG_ 3221225472 VCU_DteOffDispSta 2;
BA_ "UserSigValidity" SG_ 3221225472 VCU_DteOffDispSta 7;
BA_ "Description" SG_ 3221225472 VCU_DteOffDispSta "DTE Off('---' Display)";
BA_ "Version" SG_ 3221225472 VCU_LowSocAlertSta "19.03.03";
BA_ "RoutingFactor" SG_ 3221225472 VCU_LowSocAlertSta 2;
BA_ "UserSigValidity" SG_ 3221225472 VCU_LowSocAlertSta 7;
BA_ "Description" SG_ 3221225472 VCU_LowSocAlertSta "Low SOC Alert of High-Voltage Battery";
BA_ "Version" SG_ 3221225472 VCU_VcrmReq "19.03.03";
BA_ "RoutingFactor" SG_ 3221225472 VCU_VcrmReq 2;
BA_ "UserSigValidity" SG_ 3221225472 VCU_VcrmReq 7;
BA_ "Description" SG_ 3221225472 VCU_VcrmReq "VCRM Trigger Signal(Request VCRM Data Logging)";
BA_ "Version" SG_ 3221225472 VCU_PdlWarnMsgSta "19.03.03";
BA_ "RoutingFactor" SG_ 3221225472 VCU_PdlWarnMsgSta 2;
BA_ "UserSigValidity" SG_ 3221225472 VCU_PdlWarnMsgSta 7;
BA_ "Version" SG_ 3221225472 VCU_VirtualApsActSta "19.03.03";
BA_ "RoutingFactor" SG_ 3221225472 VCU_VirtualApsActSta 2;
BA_ "UserSigValidity" SG_ 3221225472 VCU_VirtualApsActSta 7;
BA_ "Description" SG_ 3221225472 VCU_VirtualApsActSta "Virtual APS Activated";
BA_ "Version" SG_ 3221225472 VCU_VirtualApsVal "19.03.03";
BA_ "RoutingFactor" SG_ 3221225472 VCU_VirtualApsVal 2;
BA_ "UserSigValidity" SG_ 3221225472 VCU_VirtualApsVal 7;
BA_ "Description" SG_ 3221225472 VCU_VirtualApsVal "Estimated Accelerator Pedal Value when Auto Cruise Mode";
BA_ "Version" SG_ 3221225472 VCU_ServiceLampReq "19.03.03";
BA_ "RoutingFactor" SG_ 3221225472 VCU_ServiceLampReq 2;
BA_ "UserSigValidity" SG_ 3221225472 VCU_ServiceLampReq 7;
BA_ "Description" SG_ 3221225472 VCU_ServiceLampReq "Sevice Lamp Request";
BA_ "Version" SG_ 3221225472 VCU_ServiceModeSta "19.03.03";
BA_ "RoutingFactor" SG_ 3221225472 VCU_ServiceModeSta 2;
BA_ "UserSigValidity" SG_ 3221225472 VCU_ServiceModeSta 7;
BA_ "Description" SG_ 3221225472 VCU_ServiceModeSta "Service Mode";
BA_ "Version" SG_ 3221225472 VCU_NPosWshModSta "19.07.06";
BA_ "RoutingFactor" SG_ 3221225472 VCU_NPosWshModSta 2;
BA_ "UserSigValidity" SG_ 3221225472 VCU_NPosWshModSta 7;
BA_ "Description" SG_ 3221225472 VCU_NPosWshModSta "N Wash Mode Status";
BA_ "Version" SG_ 3221225472 VCU_PowerTrainType "19.03.03";
BA_ "RoutingFactor" SG_ 3221225472 VCU_PowerTrainType 2;
BA_ "UserSigValidity" SG_ 3221225472 VCU_PowerTrainType 7;
BA_ "Description" SG_ 3221225472 VCU_PowerTrainType "VCU_PowerTrainType";
BA_ "Version" SG_ 3221225472 VCU_DteBaseVal "19.03.03";
BA_ "RoutingFactor" SG_ 3221225472 VCU_DteBaseVal 2;
BA_ "UserSigValidity" SG_ 3221225472 VCU_DteBaseVal 7;
BA_ "Description" SG_ 3221225472 VCU_DteBaseVal "Maximum Drivable Distance_Adaption";
BA_ "Version" SG_ 3221225472 VCU_AvnDteOnCalcSta "19.03.03";
BA_ "RoutingFactor" SG_ 3221225472 VCU_AvnDteOnCalcSta 2;
BA_ "UserSigValidity" SG_ 3221225472 VCU_AvnDteOnCalcSta 7;
BA_ "Description" SG_ 3221225472 VCU_AvnDteOnCalcSta "DTE calculation status";
BA_ "Version" SG_ 3221225472 VCU_SbwWarnMsgSta "19.06.02";
BA_ "RoutingFactor" SG_ 3221225472 VCU_SbwWarnMsgSta 2;
BA_ "UserSigValidity" SG_ 3221225472 VCU_SbwWarnMsgSta 7;
BA_ "Description" SG_ 3221225472 VCU_SbwWarnMsgSta "SBW Warning Message";
BA_ "Version" SG_ 3221225472 VCU_DteNaviRouteVal "19.03.03";
BA_ "RoutingFactor" SG_ 3221225472 VCU_DteNaviRouteVal 2;
BA_ "UserSigValidity" SG_ 3221225472 VCU_DteNaviRouteVal 7;
BA_ "Description" SG_ 3221225472 VCU_DteNaviRouteVal "Drivable distance for calculation AVN DTE";
BA_ "Version" SG_ 3221225472 VCU_DteAddVal "19.03.03";
BA_ "RoutingFactor" SG_ 3221225472 VCU_DteAddVal 2;
BA_ "UserSigValidity" SG_ 3221225472 VCU_DteAddVal 7;
BA_ "Description" SG_ 3221225472 VCU_DteAddVal "Added Drivable Distance by DATC Off";
BA_ "Version" SG_ 3221225472 VCU_PwrGaugeVal "19.03.03";
BA_ "RoutingFactor" SG_ 3221225472 VCU_PwrGaugeVal 2;
BA_ "UserSigValidity" SG_ 3221225472 VCU_PwrGaugeVal 7;
BA_ "Description" SG_ 3221225472 VCU_PwrGaugeVal "Motor Torque Ratio To Cluster

:VCU send this signal to cluster to show motor power status";
BA_ "Version" SG_ 3221225472 HU_DistanceUnit "19.02.08";
BA_ "NetworkRequest" SG_ 3221225472 HU_DistanceUnit 0;
BA_ "UserSigValidity" SG_ 3221225472 HU_DistanceUnit 1;
BA_ "GenSigStartValue" SG_ 3221225472 HU_DistanceUnit 3;
BA_ "GenSigSendType" SG_ 3221225472 HU_DistanceUnit 4;
BA_ "Version" SG_ 3221225472 HU_MicActivity "19.02.08";
BA_ "UserSigValidity" SG_ 3221225472 HU_MicActivity 0;
BA_ "GenSigStartValue" SG_ 3221225472 HU_MicActivity 3;
BA_ "GenSigSendType" SG_ 3221225472 HU_MicActivity 4;
BA_ "Version" SG_ 3221225472 AVN_RSPA_CancelInput "19.05.03";
BA_ "UserSigValidity" SG_ 3221225472 AVN_RSPA_CancelInput 0;
BA_ "GenSigSendType" SG_ 3221225472 AVN_RSPA_CancelInput 4;
BA_ "Version" SG_ 3221225472 AVN_RSPA_ModeSetStat "19.05.03";
BA_ "UserSigValidity" SG_ 3221225472 AVN_RSPA_ModeSetStat 0;
BA_ "GenSigStartValue" SG_ 3221225472 AVN_RSPA_ModeSetStat 15;
BA_ "GenSigSendType" SG_ 3221225472 AVN_RSPA_ModeSetStat 4;
BA_ "Version" SG_ 3221225472 AVN_RSPA_Disp_Rdy "19.05.03";
BA_ "UserSigValidity" SG_ 3221225472 AVN_RSPA_Disp_Rdy 0;
BA_ "GenSigStartValue" SG_ 3221225472 AVN_RSPA_Disp_Rdy 3;
BA_ "GenSigSendType" SG_ 3221225472 AVN_RSPA_Disp_Rdy 4;
BA_ "Version" SG_ 3221225472 CF_AVN_ProfileIDRValue "18.06.04";
BA_ "UserSigValidity" SG_ 3221225472 CF_AVN_ProfileIDRValue 0;
BA_ "GenSigStartValue" SG_ 3221225472 CF_AVN_ProfileIDRValue 15;
BA_ "GenSigSendType" SG_ 3221225472 CF_AVN_ProfileIDRValue 4;
BA_ "Description" SG_ 3221225472 CF_AVN_ProfileIDRValue "18.05.01_This signal is only used in User Profile applied H/Unit";
BA_ "Version" SG_ 3221225472 HazardFromHUSVM "18.09.04";
BA_ "UserSigValidity" SG_ 3221225472 HazardFromHUSVM 0;
BA_ "GenSigStartValue" SG_ 3221225472 HazardFromHUSVM 3;
BA_ "GenSigSendType" SG_ 3221225472 HazardFromHUSVM 4;
BA_ "Version" SG_ 3221225472 OMUOSMirCtrl "18.05.01";
BA_ "UserSigValidity" SG_ 3221225472 OMUOSMirCtrl 0;
BA_ "GenSigStartValue" SG_ 3221225472 OMUOSMirCtrl 3;
BA_ "GenSigSendType" SG_ 3221225472 OMUOSMirCtrl 4;
BA_ "Description" SG_ 3221225472 OMUOSMirCtrl "18.02.01_";
BA_ "Version" SG_ 3221225472 AVN_PDW_Input "18.09.04";
BA_ "UserSigValidity" SG_ 3221225472 AVN_PDW_Input 3;
BA_ "GenSigStartValue" SG_ 3221225472 AVN_PDW_Input 3;
BA_ "GenSigSendType" SG_ 3221225472 AVN_PDW_Input 4;
BA_ "Version" SG_ 3221225472 AVN_RSPA_Input "18.09.04";
BA_ "UserSigValidity" SG_ 3221225472 AVN_RSPA_Input 3;
BA_ "GenSigStartValue" SG_ 3221225472 AVN_RSPA_Input 3;
BA_ "GenSigSendType" SG_ 3221225472 AVN_RSPA_Input 4;
BA_ "Version" SG_ 3221225472 AVN_ParkingSW "18.09.04";
BA_ "UserSigValidity" SG_ 3221225472 AVN_ParkingSW 3;
BA_ "GenSigStartValue" SG_ 3221225472 AVN_ParkingSW 7;
BA_ "GenSigSendType" SG_ 3221225472 AVN_ParkingSW 4;
BA_ "Version" SG_ 3221225472 HU_AliveStatus "19.02.08";
BA_ "NetworkRequest" SG_ 3221225472 HU_AliveStatus 0;
BA_ "UserSigValidity" SG_ 3221225472 HU_AliveStatus 0;
BA_ "GenSigStartValue" SG_ 3221225472 HU_AliveStatus 3;
BA_ "GenSigSendType" SG_ 3221225472 HU_AliveStatus 4;
BA_ "Version" SG_ 3221225472 C_MtnAlertClu "19.04.06";
BA_ "UserSigValidity" SG_ 3221225472 C_MtnAlertClu 0;
BA_ "GenSigStartValue" SG_ 3221225472 C_MtnAlertClu 3;
BA_ "GenSigSendType" SG_ 3221225472 C_MtnAlertClu 4;
BA_ "Description" SG_ 3221225472 C_MtnAlertClu "(NA only) Signals for identifying Maintenance Alert. Active when TMU is provisioned";
BA_ "Version" SG_ 3221225472 LPI_DCU_ESC_IEB_GST_Byte0 "19.01.06";
BA_ "NetworkRequestHoldingTime" SG_ 3221225472 LPI_DCU_ESC_IEB_GST_Byte0 5000;
BA_ "NetworkRequest" SG_ 3221225472 LPI_DCU_ESC_IEB_GST_Byte0 0;
BA_ "UserSigValidity" SG_ 3221225472 LPI_DCU_ESC_IEB_GST_Byte0 0;
BA_ "GenSigSendType" SG_ 3221225472 LPI_DCU_ESC_IEB_GST_Byte0 2;
BA_ "UsrSigPurpose" SG_ 3221225472 LPI_DCU_ESC_IEB_GST_Byte0 2;
BA_ "Version" SG_ 3221225472 LPI_DCU_ESC_IEB_GST_Byte2 "19.01.06";
BA_ "NetworkRequestHoldingTime" SG_ 3221225472 LPI_DCU_ESC_IEB_GST_Byte2 5000;
BA_ "NetworkRequest" SG_ 3221225472 LPI_DCU_ESC_IEB_GST_Byte2 0;
BA_ "UserSigValidity" SG_ 3221225472 LPI_DCU_ESC_IEB_GST_Byte2 0;
BA_ "GenSigSendType" SG_ 3221225472 LPI_DCU_ESC_IEB_GST_Byte2 2;
BA_ "UsrSigPurpose" SG_ 3221225472 LPI_DCU_ESC_IEB_GST_Byte2 2;
BA_ "Version" SG_ 3221225472 LPI_DCU_ESC_IEB_GST_Byte3 "19.01.06";
BA_ "NetworkRequestHoldingTime" SG_ 3221225472 LPI_DCU_ESC_IEB_GST_Byte3 5000;
BA_ "NetworkRequest" SG_ 3221225472 LPI_DCU_ESC_IEB_GST_Byte3 0;
BA_ "UserSigValidity" SG_ 3221225472 LPI_DCU_ESC_IEB_GST_Byte3 0;
BA_ "GenSigSendType" SG_ 3221225472 LPI_DCU_ESC_IEB_GST_Byte3 2;
BA_ "UsrSigPurpose" SG_ 3221225472 LPI_DCU_ESC_IEB_GST_Byte3 2;
BA_ "Version" SG_ 3221225472 LPI_DCU_ESC_IEB_GST_Byte4 "19.01.06";
BA_ "NetworkRequestHoldingTime" SG_ 3221225472 LPI_DCU_ESC_IEB_GST_Byte4 5000;
BA_ "NetworkRequest" SG_ 3221225472 LPI_DCU_ESC_IEB_GST_Byte4 0;
BA_ "UserSigValidity" SG_ 3221225472 LPI_DCU_ESC_IEB_GST_Byte4 0;
BA_ "GenSigSendType" SG_ 3221225472 LPI_DCU_ESC_IEB_GST_Byte4 2;
BA_ "UsrSigPurpose" SG_ 3221225472 LPI_DCU_ESC_IEB_GST_Byte4 2;
BA_ "Version" SG_ 3221225472 LPI_DCU_ESC_IEB_GST_Byte5 "19.01.06";
BA_ "NetworkRequestHoldingTime" SG_ 3221225472 LPI_DCU_ESC_IEB_GST_Byte5 5000;
BA_ "NetworkRequest" SG_ 3221225472 LPI_DCU_ESC_IEB_GST_Byte5 0;
BA_ "UserSigValidity" SG_ 3221225472 LPI_DCU_ESC_IEB_GST_Byte5 0;
BA_ "GenSigSendType" SG_ 3221225472 LPI_DCU_ESC_IEB_GST_Byte5 2;
BA_ "UsrSigPurpose" SG_ 3221225472 LPI_DCU_ESC_IEB_GST_Byte5 2;
BA_ "Version" SG_ 3221225472 LPI_DCU_ESC_IEB_GST_Byte6 "19.01.06";
BA_ "NetworkRequestHoldingTime" SG_ 3221225472 LPI_DCU_ESC_IEB_GST_Byte6 5000;
BA_ "NetworkRequest" SG_ 3221225472 LPI_DCU_ESC_IEB_GST_Byte6 0;
BA_ "UserSigValidity" SG_ 3221225472 LPI_DCU_ESC_IEB_GST_Byte6 0;
BA_ "GenSigSendType" SG_ 3221225472 LPI_DCU_ESC_IEB_GST_Byte6 2;
BA_ "UsrSigPurpose" SG_ 3221225472 LPI_DCU_ESC_IEB_GST_Byte6 2;
BA_ "Version" SG_ 3221225472 LPI_DCU_ESC_IEB_GST_Byte7 "19.01.06";
BA_ "NetworkRequestHoldingTime" SG_ 3221225472 LPI_DCU_ESC_IEB_GST_Byte7 5000;
BA_ "NetworkRequest" SG_ 3221225472 LPI_DCU_ESC_IEB_GST_Byte7 0;
BA_ "UserSigValidity" SG_ 3221225472 LPI_DCU_ESC_IEB_GST_Byte7 0;
BA_ "GenSigSendType" SG_ 3221225472 LPI_DCU_ESC_IEB_GST_Byte7 2;
BA_ "UsrSigPurpose" SG_ 3221225472 LPI_DCU_ESC_IEB_GST_Byte7 2;
BA_ "Version" SG_ 3221225472 LPI_DCU_ESC_IEB_GST_Byte1 "19.01.06";
BA_ "NetworkRequestHoldingTime" SG_ 3221225472 LPI_DCU_ESC_IEB_GST_Byte1 5000;
BA_ "NetworkRequest" SG_ 3221225472 LPI_DCU_ESC_IEB_GST_Byte1 0;
BA_ "UserSigValidity" SG_ 3221225472 LPI_DCU_ESC_IEB_GST_Byte1 0;
BA_ "GenSigSendType" SG_ 3221225472 LPI_DCU_ESC_IEB_GST_Byte1 2;
BA_ "UsrSigPurpose" SG_ 3221225472 LPI_DCU_ESC_IEB_GST_Byte1 2;
BA_ "Version" SG_ 3221225472 GST_ACU_Byte0 "18.01.08";
BA_ "NetworkRequestHoldingTime" SG_ 3221225472 GST_ACU_Byte0 5000;
BA_ "NetworkRequest" SG_ 3221225472 GST_ACU_Byte0 0;
BA_ "UserSigValidity" SG_ 3221225472 GST_ACU_Byte0 0;
BA_ "GenSigSendType" SG_ 3221225472 GST_ACU_Byte0 2;
BA_ "UsrSigPurpose" SG_ 3221225472 GST_ACU_Byte0 2;
BA_ "Version" SG_ 3221225472 GST_ACU_Byte2 "18.01.08";
BA_ "NetworkRequestHoldingTime" SG_ 3221225472 GST_ACU_Byte2 5000;
BA_ "NetworkRequest" SG_ 3221225472 GST_ACU_Byte2 0;
BA_ "UserSigValidity" SG_ 3221225472 GST_ACU_Byte2 0;
BA_ "GenSigSendType" SG_ 3221225472 GST_ACU_Byte2 2;
BA_ "UsrSigPurpose" SG_ 3221225472 GST_ACU_Byte2 2;
BA_ "Version" SG_ 3221225472 GST_ACU_Byte3 "18.01.08";
BA_ "NetworkRequestHoldingTime" SG_ 3221225472 GST_ACU_Byte3 5000;
BA_ "NetworkRequest" SG_ 3221225472 GST_ACU_Byte3 0;
BA_ "UserSigValidity" SG_ 3221225472 GST_ACU_Byte3 0;
BA_ "GenSigSendType" SG_ 3221225472 GST_ACU_Byte3 2;
BA_ "UsrSigPurpose" SG_ 3221225472 GST_ACU_Byte3 2;
BA_ "Version" SG_ 3221225472 GST_ACU_Byte4 "18.01.08";
BA_ "NetworkRequestHoldingTime" SG_ 3221225472 GST_ACU_Byte4 5000;
BA_ "NetworkRequest" SG_ 3221225472 GST_ACU_Byte4 0;
BA_ "UserSigValidity" SG_ 3221225472 GST_ACU_Byte4 0;
BA_ "GenSigSendType" SG_ 3221225472 GST_ACU_Byte4 2;
BA_ "UsrSigPurpose" SG_ 3221225472 GST_ACU_Byte4 2;
BA_ "Version" SG_ 3221225472 GST_ACU_Byte5 "18.01.08";
BA_ "NetworkRequestHoldingTime" SG_ 3221225472 GST_ACU_Byte5 5000;
BA_ "NetworkRequest" SG_ 3221225472 GST_ACU_Byte5 0;
BA_ "UserSigValidity" SG_ 3221225472 GST_ACU_Byte5 0;
BA_ "GenSigSendType" SG_ 3221225472 GST_ACU_Byte5 2;
BA_ "UsrSigPurpose" SG_ 3221225472 GST_ACU_Byte5 2;
BA_ "Version" SG_ 3221225472 GST_ACU_Byte6 "18.01.08";
BA_ "NetworkRequestHoldingTime" SG_ 3221225472 GST_ACU_Byte6 5000;
BA_ "NetworkRequest" SG_ 3221225472 GST_ACU_Byte6 0;
BA_ "UserSigValidity" SG_ 3221225472 GST_ACU_Byte6 0;
BA_ "GenSigSendType" SG_ 3221225472 GST_ACU_Byte6 2;
BA_ "UsrSigPurpose" SG_ 3221225472 GST_ACU_Byte6 2;
BA_ "Version" SG_ 3221225472 GST_ACU_Byte7 "18.01.08";
BA_ "NetworkRequestHoldingTime" SG_ 3221225472 GST_ACU_Byte7 5000;
BA_ "NetworkRequest" SG_ 3221225472 GST_ACU_Byte7 0;
BA_ "UserSigValidity" SG_ 3221225472 GST_ACU_Byte7 0;
BA_ "GenSigSendType" SG_ 3221225472 GST_ACU_Byte7 2;
BA_ "UsrSigPurpose" SG_ 3221225472 GST_ACU_Byte7 2;
BA_ "Version" SG_ 3221225472 GST_ACU_Byte1 "18.01.08";
BA_ "NetworkRequestHoldingTime" SG_ 3221225472 GST_ACU_Byte1 5000;
BA_ "NetworkRequest" SG_ 3221225472 GST_ACU_Byte1 0;
BA_ "UserSigValidity" SG_ 3221225472 GST_ACU_Byte1 0;
BA_ "GenSigSendType" SG_ 3221225472 GST_ACU_Byte1 2;
BA_ "UsrSigPurpose" SG_ 3221225472 GST_ACU_Byte1 2;
BA_ "Version" SG_ 3221225472 GST_ECS_Byte0 "18.01.08";
BA_ "NetworkRequestHoldingTime" SG_ 3221225472 GST_ECS_Byte0 5000;
BA_ "NetworkRequest" SG_ 3221225472 GST_ECS_Byte0 0;
BA_ "UserSigValidity" SG_ 3221225472 GST_ECS_Byte0 0;
BA_ "GenSigSendType" SG_ 3221225472 GST_ECS_Byte0 2;
BA_ "UsrSigPurpose" SG_ 3221225472 GST_ECS_Byte0 2;
BA_ "Version" SG_ 3221225472 GST_ECS_Byte2 "18.01.08";
BA_ "NetworkRequestHoldingTime" SG_ 3221225472 GST_ECS_Byte2 5000;
BA_ "NetworkRequest" SG_ 3221225472 GST_ECS_Byte2 0;
BA_ "UserSigValidity" SG_ 3221225472 GST_ECS_Byte2 0;
BA_ "GenSigSendType" SG_ 3221225472 GST_ECS_Byte2 2;
BA_ "UsrSigPurpose" SG_ 3221225472 GST_ECS_Byte2 2;
BA_ "Version" SG_ 3221225472 GST_ECS_Byte3 "18.01.08";
BA_ "NetworkRequestHoldingTime" SG_ 3221225472 GST_ECS_Byte3 5000;
BA_ "NetworkRequest" SG_ 3221225472 GST_ECS_Byte3 0;
BA_ "UserSigValidity" SG_ 3221225472 GST_ECS_Byte3 0;
BA_ "GenSigSendType" SG_ 3221225472 GST_ECS_Byte3 2;
BA_ "UsrSigPurpose" SG_ 3221225472 GST_ECS_Byte3 2;
BA_ "Version" SG_ 3221225472 GST_ECS_Byte4 "18.01.08";
BA_ "NetworkRequestHoldingTime" SG_ 3221225472 GST_ECS_Byte4 5000;
BA_ "NetworkRequest" SG_ 3221225472 GST_ECS_Byte4 0;
BA_ "UserSigValidity" SG_ 3221225472 GST_ECS_Byte4 0;
BA_ "GenSigSendType" SG_ 3221225472 GST_ECS_Byte4 2;
BA_ "UsrSigPurpose" SG_ 3221225472 GST_ECS_Byte4 2;
BA_ "Version" SG_ 3221225472 GST_ECS_Byte5 "18.01.08";
BA_ "NetworkRequestHoldingTime" SG_ 3221225472 GST_ECS_Byte5 5000;
BA_ "NetworkRequest" SG_ 3221225472 GST_ECS_Byte5 0;
BA_ "UserSigValidity" SG_ 3221225472 GST_ECS_Byte5 0;
BA_ "GenSigSendType" SG_ 3221225472 GST_ECS_Byte5 2;
BA_ "UsrSigPurpose" SG_ 3221225472 GST_ECS_Byte5 2;
BA_ "Version" SG_ 3221225472 GST_ECS_Byte6 "18.01.08";
BA_ "NetworkRequestHoldingTime" SG_ 3221225472 GST_ECS_Byte6 5000;
BA_ "NetworkRequest" SG_ 3221225472 GST_ECS_Byte6 0;
BA_ "UserSigValidity" SG_ 3221225472 GST_ECS_Byte6 0;
BA_ "GenSigSendType" SG_ 3221225472 GST_ECS_Byte6 2;
BA_ "UsrSigPurpose" SG_ 3221225472 GST_ECS_Byte6 2;
BA_ "Version" SG_ 3221225472 GST_ECS_Byte7 "18.01.08";
BA_ "NetworkRequestHoldingTime" SG_ 3221225472 GST_ECS_Byte7 5000;
BA_ "NetworkRequest" SG_ 3221225472 GST_ECS_Byte7 0;
BA_ "UserSigValidity" SG_ 3221225472 GST_ECS_Byte7 0;
BA_ "GenSigSendType" SG_ 3221225472 GST_ECS_Byte7 2;
BA_ "UsrSigPurpose" SG_ 3221225472 GST_ECS_Byte7 2;
BA_ "Version" SG_ 3221225472 GST_ECS_Byte1 "18.01.08";
BA_ "NetworkRequestHoldingTime" SG_ 3221225472 GST_ECS_Byte1 5000;
BA_ "NetworkRequest" SG_ 3221225472 GST_ECS_Byte1 0;
BA_ "UserSigValidity" SG_ 3221225472 GST_ECS_Byte1 0;
BA_ "GenSigSendType" SG_ 3221225472 GST_ECS_Byte1 2;
BA_ "UsrSigPurpose" SG_ 3221225472 GST_ECS_Byte1 2;
VAL_ 3221225472 PA_FrRtWrngAlrmReq 0 "OFF(No warning alarm)" 1 "1��st warning alarm level" 2 "2��nd warning alarm level" 3 "3��nd warning alarm level (the closest status with obstacle)" ;
VAL_ 3221225472 PA_RrLftWrngAlrmReq 0 "OFF(No warning alarm)" 1 "1��st warning alarm level" 2 "2��nd warning alarm level" 3 "3��nd warning alarm level (the closest status with obstacle)" ;
VAL_ 3221225472 PA_RrCtrWrngAlrmReq 0 "OFF(No warning alarm)" 1 "1��st warning alarm level" 2 "2��nd warning alarm level" 3 "3��nd warning alarm level (the closest status with obstacle)" ;
VAL_ 3221225472 PA_RrRtWrngAlrmReq 0 "OFF(No warning alarm)" 1 "1��st warning alarm level" 2 "2��nd warning alarm level" 3 "3��nd warning alarm level (the closest status with obstacle)" ;
VAL_ 3221225472 PA_Sta 0 "Reserved" 1 "PA_Init" 2 "PA_NewStart" 3 "PA_Standby" 4 "PA_Active" 5 "PA_Angle_Control_Active" 6 "PA_Failure" 7 "PA_Abort" 8 "Reserved" 9 "Reserved" 10 "Reserved" 11 "Reserved" 12 "Reserved" 13 "Reserved" 14 "Not used" 15 "Error Indicator" ;
VAL_ 3221225472 PA_TestModSta 0 "PA is not in Test Mode" 1 "PA is in Test Mode" 2 "Not used" 3 "Error Indicator" ;
VAL_ 3221225472 FCA_OnOffEquipSta 0 "Default" 1 "Off" 2 "Warning" 3 "Assist" 4 "Reserved" 5 "Reserved" 6 "Reserved" 7 "Invalid" ;
VAL_ 3221225472 FCA_SysFlrSta 0 "Normal" 1 "Temp. Unavailable by Camera" 2 "Temp. Unavailable by Radar" 3 "Service Required" 4 "Temp. Unavailable by Camera (Camera only)" 5 "Temp. Unavailable by Camera (w/ Steering Function)" 6 "Reserved" 7 "Reserved" ;
VAL_ 3221225472 FCA_WrngLvlSta 0 "No warning" 1 "Warning level 1" 2 "Warning level 2" 3 "Warning level 3" ;
VAL_ 3221225472 FCA_VehStpReq 0 "No request" 1 "Stop control is required" 2 "Reserved" 3 "Error Indicator" ;
VAL_ 3221225472 FCA_StbltActvReq 0 "Release No alert" 1 "Pre-crash full retraction" 2 "Haptic warning" 3 "Reserved" 4 "Reserved" 5 "Reserved" 6 "Reserved" 7 "Reserved" ;
VAL_ 3221225472 FCA_HydrlcBstAsstReq 0 "Standard threshold" 1 "Lowered threshold 1" 2 "Lowered threshold 2" 3 "Lowered threshold 3" ;
VAL_ 3221225472 FCA_PrefillActvReq 0 "No pre-fill" 1 "Pre-fill act" 2 "Reserved" 3 "Error Indicator" ;
VAL_ 3221225472 FCA_PartialActvReq 0 "No Partial act" 1 "Partail act" 2 "Reserved" 3 "Error Indicator" ;
VAL_ 3221225472 FCA_FullActvReq 0 "No Full act" 1 "Full act" 2 "Reserved" 3 "Error Indicator" ;
VAL_ 3221225472 FCA_SnstvtyModRetVal 0 "Default" 1 "Late" 2 "Normal" 3 "Early" 4 "Reserved" 5 "Reserved" 6 "Reserved" 7 "Invalid" ;
VAL_ 3221225472 FCA_WrngSndSta 0 "No warning" 1 "Warning 1" 2 "Warning 2" 3 "Warning 3" 4 "Reserved" 5 "Reserved" 6 "Reserved" 7 "Error indicator" ;
VAL_ 3221225472 FCA_RelVel 511 "Signal Invalid" ;
VAL_ 3221225472 Nmode_FCAOff_Sta 0 "Not Applied" 1 "Disable" 2 "Enable" 3 "Invalid" ;
VAL_ 3221225472 FCA_Jnctn_OnOffEquipSta 0 "Default" 1 "Off" 2 "On" 3 "Invalid" ;
VAL_ 3221225472 FCA_WrngTrgtDis 0 "No warning" 1 "FCA-Pedestrian" 2 "Reserved" 3 "FCA-Cyclist" 4 "Reserved" 5 "FCA-Car" 6 "Reserved" 7 "FCA-JC(L)" 8 "FCA-JC��" 9 "Reserved" 10 "Reserved" 11 "FCA-JT(L)" 12 "FCA-JT(R)" 13 "Reserved" 14 "Reserved" ;
VAL_ 3221225472 ADAS_DRV_FCA_Plus_Sta 0 "FCA-Car/Ped/Cyc+ ��Ȳ ���ش�" 1 "FCA-Car/Ped/Cyc+ ��Ȳ �ش�" 2 "Not Used" 3 "Error Indicator" ;
VAL_ 3221225472 ECSIVSS_DmpCtrlrErrSta 0 "ECS Normal" 1 "ECS Error" 2 "Not used" 3 "Error Indicator" ;
VAL_ 3221225472 ECSIVSS_IVSSCtrlrErrSta 0 "Ivss signal is valid" 1 "Ivss signal is invalid" 2 "Not used" 3 "Error Indicator" ;
VAL_ 3221225472 ECSIVSS_AntRollCtrlSta 0 "Anti-roll Control Inactive" 1 "Anti-roll Control Active" 2 "Not used" 3 "Error Indicator" ;
VAL_ 3221225472 ECSIVSS_FLCtrlSta 0 "ECS" 1 "ICSC" 2 "Preview ECS" 3 "Preview ECS Limited" ;
VAL_ 3221225472 ECSIVSS_FRCtrlSta 0 "ECS" 1 "ICSC" 2 "Preview ECS" 3 "Preview ECS Limited" ;
VAL_ 3221225472 ECSIVSS_RLCtrlSta 0 "ECS" 1 "ICSC" 2 "Preview ECS" 3 "Preview ECS Limited" ;
VAL_ 3221225472 ECSIVSS_RRCtrlSta 0 "ECS" 1 "ICSC" 2 "Preview ECS" 3 "Preview ECS Limited" ;
VAL_ 3221225472 RSPA_Sta 0 "RSPA not recognized" 1 "Init" 2 "New Start" 3 "Ready OK" 4 "Assist Req" 5 "Assist OK" 6 "Assist Fail" 7 "Abort" 8 "Ready Fail" ;
VAL_ 3221225472 RSPA_Actv 0 "RSPA Off" 1 "RSPA On" 2 "Reserved" 3 "Reserved" ;
VAL_ 3221225472 RSPA_TrgtGearSta 0 "Idle" 1 "P" 2 "R" 3 "N" 4 "D" ;
VAL_ 3221225472 RSPA_EpbReq 0 "No request" 1 "release request" 2 "normal apply" ;
VAL_ 3221225472 RSPA_ExtLampReq 0 "Inactive (No Request)" 1 "Hazard Lamp Active On" 2 "Hazard Lamp Active Off" 3 "Left Turn Signal On" 4 "Right Turn Signal On" 5 "reserved" 6 "reserved" 7 "reserved" ;
VAL_ 3221225472 RSPA_CrankingReq 0 "Init" 1 "to RSPA Remote Cranking" 2 "to Normal Cranking" 3 "to IG OFF" ;
VAL_ 3221225472 RSPA_IdOutWarnReq 0 "No Request" 1 "Change Request" 2 "Not Used" 3 "Error Indicator" ;
VAL_ 3221225472 RSPA_IndBlnkReq 0 "No request" 1 "Type1" 2 "Type2" 3 "Type3" 4 "Type4" 5 "Type5" 6 "Reserved" 7 "Reserved" ;
VAL_ 3221225472 RSPA_SysOff 0 "default" 1 "system off" ;
VAL_ 3221225472 RSPA_DccCmd 0 "No request" 1 "Soft Brake" 2 "Hard 1 Brake" 3 "Hard 2 Brake" ;
VAL_ 3221225472 RSPA_StopReq 0 "No request" 1 "Stop control is required" 2 "Not Used" 3 "Error Indicator" ;
VAL_ 3221225472 RSPA_SelDevInfo 0 "default" 1 "SmartPhone" 2 "Fob" 3 "Reserved" ;
VAL_ 3221225472 RSPA_SelFuncInfo 0 "default" 1 "Parking" 2 "Remote Forward/Backward" 3 "Reserved" ;
VAL_ 3221225472 RSPA_AddtnlAccelActv 0 "Inactive" 1 "Active" 2 "Not Used" 3 "Error Indicator" ;
VAL_ 3221225472 RSPA_Opt 0 "RSPA not applied" 1 "RSPA applied" 2 "Not Used" 3 "Error Indicator" ;
VAL_ 3221225472 RSPA_AvnDis 0 "init" 1 "No display" 2 "RSPA ȭ�� ���" 3 "invalid" ;
VAL_ 3221225472 RSPA_AvnModDis 0 "init" 1 "�������" 2 "�������" 3 "invalid" ;
VAL_ 3221225472 RSPA_AvnModNumDis 0 "init" 1 "2���" 2 "4���" 3 "6���" 4 "8���" 5 "reserved" 6 "reserved" 7 "invalid" ;
VAL_ 3221225472 RSPA_AvnSubViewDis 0 "init" 1 "No display" 2 "��ü�̹��� ���" 3 "invalid" ;
VAL_ 3221225472 RSPA_AvnModADLDis 0 "init" 1 "����Ұ���" 2 "�����" 3 "invalid" ;
VAL_ 3221225472 RSPA_AvnModPDFLDis 0 "init" 1 "����Ұ���" 2 "�����" 3 "invalid" ;
VAL_ 3221225472 RSPA_AvnModPLDis 0 "init" 1 "����Ұ���" 2 "�����" 3 "invalid" ;
VAL_ 3221225472 RSPA_AvnModPDRLDis 0 "init" 1 "����Ұ���" 2 "�����" 3 "invalid" ;
VAL_ 3221225472 RSPA_AvnModPDRRDis 0 "init" 1 "����Ұ���" 2 "�����" 3 "invalid" ;
VAL_ 3221225472 RSPA_AvnModPRDis 0 "init" 1 "����Ұ���" 2 "�����" 3 "invalid" ;
VAL_ 3221225472 RSPA_AvnModPDFRDis 0 "init" 1 "����Ұ���" 2 "�����" 3 "invalid" ;
VAL_ 3221225472 RSPA_AvnModADRDis 0 "init" 1 "����Ұ���" 2 "�����" 3 "invalid" ;
VAL_ 3221225472 RSPA_CamDis 0 "No Display (RSPA ���� ����)" 1 "AVM (�� �޴��� ��ǥ��) ���̵�� ����+ž�� / RVM: View OFF" 2 "AVM (�� �޴��� ��ǥ��) ���̵�� ����+ž�� / RVM: Parking Assist View (Guide L. X)" 3 "AVM (�� �޴��� ��ǥ��) ���̵�� �Ĺ�+ž�� / RVM: Parking Assist View (Guide L. O)" 4 "reserved" 5 "reserved" 6 "reserved" 7 "Invalid" ;
VAL_ 3221225472 RSPA_CnclTyp 0 "init" 1 "Cancel by AVN SoftKey (Cancel Button on Screen)" 2 "Cancel by RSPA" 3 "Invalid" ;
VAL_ 3221225472 RSPA_AvnHmiDis 0 "none" 1 "Select operating mode" 2 "SMART Parking" 3 "REMOTE Parking" 4 "Parking completed" 5 "SMART Pull-out" 6 "Pull-out completed" 7 "RSPA cancelled - Read Manual" 8 "RSPA cancelled - Operate vehicle manually" 9 "Not working condition - Exceed Limit Speed" 10 "Searching for Parking space - Reduce speed under 20km/h" 11 "Check RSPA - Visit Tech Center" 12 "Reserved" 13 "display Front camera - moving forward" 14 "display Rear camera - moving backward" 15 "Reserved" 16 "RSPA paused - Check tailgate closed" 17 "RSPA paused - Remote control range exceeded" 18 "RSPA pasued - Hold down dedicated button on key fob" 19 "Parking completed - manually" 20 "Pull-out completed - manually" 21 "Reserved" 22 "RSPA paused - Check all doors closed" 23 "RSPA paused - Check trunk closed" 24 "RSPA paused - RCCW/RCCA Activated" 25 "RSPA paused - Fasten seat belt on drivers side" 26 "Operation guide - Release brake" 27 "RSPA paused - Monitor surrounding area" 28 "RSPA cancelled - Trailer mode" 29 "RSPA cancelled - PDW Off" 30 "RSPA cancelled - over 20km/h" 31 "RSPA cancelled - not stop" 32 "RSPA cancelled - reverse movement" 33 "RSPA cancelled - narrow space" 34 "Not working condition - trailer mode" 35 "RSPA cancelled - Monitor surrounding area" 36 "RSPA cancelled - Check road condition" 37 "RSPA cancelled - Exceed operating distance" 38 "RSPA cancelled - Exceed operation time" 39 "RSPA cancelled - Detect cancel input" 40 "RSPA cancelled - Detect remote start button input" 41 "RSPA cancelled - Detect B/alarm" 42 "RSPA cancelled - Detect unfasten S/belt and Door open" 43 "RSPA cancelled - Detect T/M operation" 44 "RSPA cancelled - Detect EPB operation" 45 "RSPA cancelled - Detect Pedal operation" 46 "RSPA cancelled - Hood open" 47 "RSPA cancelled - Detect S/wheel operation" 48 "Reserved" 49 "Reserved" 50 "Reserved" 51 "Reserved" 52 "Reserved" 53 "Reserved" 54 "Reserved" 55 "Reserved" 56 "Reserved" 57 "Reserved" 58 "Reserved" 59 "Reserved" 60 "Reserved" 61 "Reserved" 62 "Reserved" 63 "Reserved" 64 "Reserved" 65 "Reserved" 66 "Reserved" 67 "Reserved" 68 "Reserved" 69 "Reserved" 70 "Reserved" 71 "Reserved" 72 "Reserved" 73 "Reserved" 74 "Reserved" 75 "Reserved" 76 "Reserved" 77 "Reserved" 78 "Reserved" 79 "Reserved" 80 "Reserved" 81 "Reserved" 82 "Reserved" 83 "Reserved" 84 "Reserved" 85 "Reserved" 86 "Reserved" 87 "Reserved" 88 "Reserved" 89 "Reserved" 90 "Reserved" 91 "Reserved" 92 "Reserved" 93 "Reserved" 94 "Reserved" 95 "Reserved" 96 "Reserved" 97 "Reserved" 98 "Reserved" 99 "Reserved" 100 "Reserved" 101 "Reserved" 102 "Reserved" 103 "Reserved" 104 "Reserved" 105 "Reserved" 106 "Reserved" 107 "Reserved" 108 "Reserved" 109 "Reserved" 110 "Reserved" 111 "Reserved" 112 "Reserved" 113 "Reserved" 114 "Reserved" 115 "Reserved" 116 "Reserved" 117 "Reserved" 118 "Reserved" 119 "Reserved" 120 "Reserved" 121 "Reserved" 122 "Reserved" 123 "Reserved" 124 "Reserved" 125 "Reserved" 126 "Reserved" 127 "Reserved" 128 "Searching for Parking space - Drive forwards" 129 "Searching Completed - Stop vehicle to park or Move forward" 130 "Select parking mode" 131 "Checking space - Stop the vehicle to check space" 132 "Checking completed - Select pull-out mode" 133 "Remote Moving F/B" 134 "under Remote Control" 135 "Remote Moving F/B Completed" 136 "Operation guide - Reinput Parking Button" 137 "Operation guide - Reinput SMART Key Button" 138 "Not working condition - Read Manual" 139 "Not working condition - Steep road slope up" 140 "Not working condition - Steep road slope down" 141 "RSPA cancelled - Steep road slope up" 142 "RSPA cancelled - Steep road slope down" 143 "0x8F~0xFE:Reserved" 254 "0x8F~0xFE:Reserved" 255 "Invalid" ;
VAL_ 3221225472 IAU_DigitalKeyOpt 0 "not applied (time out)" 1 "applied" 2 "reserved" 3 "Invalid" ;
VAL_ 3221225472 IAU_ProfileIDRVal 0 "Default" 1 "Guest" 2 "Profile1" 3 "Profile2" 4 "Reserved" 5 "Reserved" 6 "Reserved" 7 "Reserved" 8 "Reserved" 9 "Reserved" 10 "Reserved" 11 "Reserved" 12 "Reserved" 13 "Reserved" 14 "Reserved" 15 "Invalid" ;
VAL_ 3221225472 IAU_ISKLearnState 0 "Default" 1 "Learning" 2 "Neutral" 3 "Reserved" ;
VAL_ 3221225472 IAU_DigitalKeyProcessingSta 0 "None" 1 "DeviceOnWPC" 2 "DeviceRegistering" 3 "PhoneRegistered" 4 "All Phone Key Deleted" 5 "NFCCard1Registered" 6 "Reserved" 7 "NFCCard1Deleted" 8 "Reserved" 9 "Reserved" 10 "Reserved" 11 "Reserved" 12 "Reserved" 13 "Reserved" 14 "Reserved" 15 "Invalid" ;
VAL_ 3221225472 IAU_DigitalKeyExit 0 "Normal" 1 "Check System" 2 "Reserved" 3 "Fob Not Detected" 4 "Canceled by User (Timeout)" 5 "Device not Available" 6 "ProcessFail" 7 "Check Card Save" 8 "Reserved" 9 "Reserved" 10 "CardNotAvailable" 11 "DigitalKeyDisabled" 12 "KeyNotSaved" 13 "Reserved" 14 "Reserved" 15 "Invalid" ;
VAL_ 3221225472 IAU_DigitalKeyEnblRVal 0 "Default" 1 "Disable" 2 "Enable" 3 "Invalid" ;
VAL_ 3221225472 IAU_OwnerPhnRegRVal 0 "Default" 1 "Disable" 2 "Enable" 3 "Invalid" ;
VAL_ 3221225472 IAU_NFCCard1RegRVal 0 "Default" 1 "Disable" 2 "Enable" 3 "Invalid" ;
VAL_ 3221225472 IAU_NFCCard2RegRVal 0 "Default" 1 "Disable" 2 "Enable" 3 "Invalid" ;
VAL_ 3221225472 IAU_RdyToSendAuthDataSta 0 "None" 1 "Ready to Send data" 2 "Not Used" 3 "Error Indicator" ;
VAL_ 3221225472 IAU_OptTyp 0 "None" 1 "NFC Option" 2 "FP Option" 3 "BLE Option" 4 "Reserved" 5 "Reserved" 6 "Reserved" 7 "Invalid" ;
VAL_ 3221225472 IAU_NFCKeyReminder 0 "None" 1 "Detected" ;
VAL_ 3221225472 IAU_NFCDeactivation 0 "Off" 1 "On" ;
VAL_ 3221225472 IAU_DISPWrng 0 "None" 1 "Auth_Fail2" 2 "ReAuth_Warning" 3 "IAU Error" 4 "DigitalKey Saved" 5 "Reserved" 6 "Reserved" 7 "Reserved" 8 "Reserved" 9 "Reserved" 10 "Reserved" 11 "Reserved" 12 "Reserved" 13 "Reserved" 14 "Reserved" 15 "Reserved" ;
VAL_ 3221225472 IAU_ConStat 0 "Normal Status" 1 "Fail Status" 2 "Reserved" 3 "Reserved" ;
VAL_ 3221225472 IAU_LftDrHndLockDetected 0 "off" 1 "Lock" 2 "Reserved" 3 "Reserved" ;
VAL_ 3221225472 IAU_LftDrHndUnlockDetected 0 "off" 1 "Unlock" 2 "Reserved" 3 "Reserved" ;
VAL_ 3221225472 IAU_RtDrHndLockDetected 0 "off" 1 "Lock" 2 "Reserved" 3 "Reserved" ;
VAL_ 3221225472 IAU_RtDrHndUnlockDetected 0 "off" 1 "Unlock" 2 "Reserved" 3 "Reserved" ;
VAL_ 3221225472 IAU_ProfileIDParingRVal 0 "Default" 1 "Disable" 2 "Enable" 3 "Invalid" ;
VAL_ 3221225472 MODE_MDPS_SET 0 "Normal" 1 "Sport" 2 "Comfort+" 3 "Sport+" 4 "Reserved" 5 "Reserved" 6 "Reserved" 7 "Invalid" ;
VAL_ 3221225472 MODE_ECS_SET 0 "Normal" 1 "Sport" 2 "Comfort+" 3 "Sport+" 4 "Smart" 5 "Reserved" 6 "Reserved" 7 "Invalid" ;
VAL_ 3221225472 MODE_4WD_SET 0 "Normal" 1 "Sport" 2 "Eco" 3 "Smart" 4 "Reserved" 5 "Reserved" 6 "Reserved" 7 "Invalid" ;
VAL_ 3221225472 MODE_BRAKE_SET 0 "Normal" 1 "Sport" 2 "Eco" 3 "Smart" 4 "Reserved" 5 "Reserved" 6 "Reserved" 7 "Invalid" ;
VAL_ 3221225472 MODE_ENG_SET 0 "Normal" 1 "Sport" 2 "Eco" 3 "Sport+" 4 "Smart" 5 "Snow" 6 "Reserved" 7 "Invalid" ;
VAL_ 3221225472 PSB_LHFlrSta 0 "No failure" 1 "Failure, Service Required" 2 "Defect, PSB warning light off" 3 "Signal not valid" ;
VAL_ 3221225472 PSB_LHActvSta 0 "No PSB motor activation" 1 "PSB retract cycle active" 2 "Reserved" 3 "Reserved" ;
VAL_ 3221225472 PSB_RHFlrSta 0 "No failure" 1 "Failure, Service Required" 2 "Defect, PSB warning light off" 3 "Signal not valid" ;
VAL_ 3221225472 PSB_RHActvSta 0 "No PSB motor activation" 1 "PSB retract cycle active" 2 "Reserved" 3 "Reserved" ;
VAL_ 3221225472 PSB_ActForAcu 0 "Inactive" 1 "Active" 2 "Reserved" 3 "Failure" ;
VAL_ 3221225472 POS_V2_Offset 0 "0x0x0~0x1FFE:Distance" 8190 "0x0x0~0x1FFE:Distance" 8191 "Invalid" ;
VAL_ 3221225472 POS_V2_PathIndex 0 "Unknown" 1 "Reserved" 2 "Reserved" 3 "Reserved" 4 "Reserved" 5 "Reserved" 6 "Reserved" 7 "Reserved" 8 "General Path Index" 9 "General Path Index" 10 "General Path Index" 11 "General Path Index" 12 "General Path Index" 13 "General Path Index" 14 "General Path Index" 15 "General Path Index" 16 "General Path Index" 17 "General Path Index" 18 "General Path Index" 19 "General Path Index" 20 "General Path Index" 21 "General Path Index" 22 "General Path Index" 23 "General Path Index" 24 "General Path Index" 25 "General Path Index" 26 "General Path Index" 27 "General Path Index" 28 "General Path Index" 29 "General Path Index" 30 "General Path Index" 31 "General Path Index" 32 "General Path Index" 33 "General Path Index" 34 "General Path Index" 35 "General Path Index" 36 "General Path Index" 37 "General Path Index" 38 "General Path Index" 39 "General Path Index" 40 "General Path Index" 41 "General Path Index" 42 "General Path Index" 43 "General Path Index" 44 "General Path Index" 45 "General Path Index" 46 "General Path Index" 47 "General Path Index" 48 "General Path Index" 49 "General Path Index" 50 "General Path Index" 51 "General Path Index" 52 "General Path Index" 53 "General Path Index" 54 "General Path Index" 55 "General Path Index" 56 "General Path Index" 57 "General Path Index" 58 "General Path Index" 59 "General Path Index" 60 "General Path Index" 61 "General Path Index" 62 "General Path Index" 63 "General Path Index" ;
VAL_ 3221225472 POS_V2_CyclicCounter 0 "Cyclic Counter" 1 "Cyclic Counter" 2 "Cyclic Counter" 3 "Cyclic Counter" ;
VAL_ 3221225472 POS_V2_RangeAvgSpeed 0 "0x0x0~0xFD:Range Camera Average Speed" 253 "0x0x0~0xFD:Range Camera Average Speed" 254 "0xFE~0x1FE:Reserved" 510 "0xFE~0x1FE:Reserved" 511 "Invalid" ;
VAL_ 3221225472 POS_V2_CurrAltitude100m 0 "Unknown" 1 "Under100m" 16 "1500m" 17 "1600m" 18 "1700m" 19 "1800m" 20 "1900m" 21 "2000m" 22 "2100m" 23 "2200m" 24 "2300m" 25 "2400m" 26 "2500m" 27 "2600m" 28 "2700m" 29 "2800m" 30 "2900m" 31 "3000m" 2 "100m" 32 "3100m" 33 "3200m" 34 "3300m" 35 "3400m" 36 "3500m" 37 "3600m" 38 "3700m" 39 "3800m" 40 "3900m" 41 "4000m" 42 "4100m" 43 "4200m" 44 "4300m" 45 "4400m" 46 "4500m" 47 "4600m" 3 "200m" 48 "4700m" 49 "4800m" 50 "4900m" 51 "5000m" 52 "5100m" 53 "5200m" 54 "5300m" 55 "5400m" 56 "5500m" 57 "5600m" 58 "5700m" 59 "5800m" 60 "5900m" 61 "6000m" 62 "Over6,000m" 63 "Invalid" 4 "300m" 5 "400m" 6 "500m" 7 "600m" 8 "700m" 9 "800m" 10 "900m" 11 "1000m" 12 "1100m" 13 "1200m" 14 "1300m" 15 "1400m" ;
VAL_ 3221225472 POS_V2_CurrAltitude1m 0 "Unknown" 1 "Under1m" 16 "15m" 17 "16m" 18 "17m" 19 "18m" 20 "19m" 21 "20m" 22 "21m" 23 "22m" 24 "23m" 25 "24m" 26 "25m" 27 "26m" 28 "27m" 29 "28m" 30 "29m" 31 "30m" 2 "1m" 32 "31m" 33 "32m" 34 "33m" 35 "34m" 36 "35m" 37 "36m" 38 "37m" 39 "38m" 40 "39m" 41 "40m" 42 "41m" 43 "42m" 44 "43m" 45 "44m" 46 "45m" 47 "46m" 3 "2m" 48 "47m" 49 "48m" 50 "49m" 51 "50m" 52 "51m" 53 "52m" 54 "53m" 55 "54m" 56 "55m" 57 "56m" 58 "57m" 59 "58m" 60 "59m" 61 "60m" 62 "61m" 63 "62m" 4 "3m" 64 "63m" 65 "64m" 66 "65m" 67 "66m" 68 "67m" 69 "68m" 70 "69m" 71 "70m" 72 "71m" 73 "72m" 74 "73m" 75 "74m" 76 "75m" 77 "76m" 78 "77m" 79 "78m" 5 "4m" 80 "79m" 81 "80m" 82 "81m" 83 "82m" 84 "83m" 85 "84m" 86 "85m" 87 "86m" 88 "87m" 89 "88m" 90 "89m" 91 "90m" 92 "91m" 93 "92m" 94 "93m" 95 "94m" 6 "5m" 96 "95m" 97 "96m" 98 "97m" 99 "98m" 100 "99m" 101 "Reserved" 102 "Reserved" 103 "Reserved" 104 "Reserved" 105 "Reserved" 106 "Reserved" 107 "Reserved" 108 "Reserved" 109 "Reserved" 110 "Reserved" 111 "Reserved" 112 "Reserved" 113 "Reserved" 114 "Reserved" 115 "Reserved" 116 "Reserved" 117 "Reserved" 118 "Reserved" 119 "Reserved" 120 "Reserved" 121 "Reserved" 122 "Reserved" 123 "Reserved" 124 "Reserved" 125 "Reserved" 126 "Reserved" 7 "6m" 127 "Invalid" 8 "7m" 9 "8m" 10 "9m" 11 "10m" 12 "11m" 13 "12m" 14 "13m" 15 "14m" ;
VAL_ 3221225472 POS_V2_CurrFuncRoadClass 0 "Unknown" 1 "Freeway" 2 "Arterial(Cityfreeway)" 3 "County" 4 "Collector" 5 "Local" 6 "Etc(ferry, unpaved)" 7 "Invalid" ;
VAL_ 3221225472 POS_V2_CurrFormOfWay 0 "Unknown" 1 "Main road(nondisjunction)" 2 "Main road(disjunction)" 3 "JC" 4 "Plural Junction M" 5 "IC" 6 "Reserved" 7 "Service Area" 8 "Reserved" 9 "Roundabout" 10 "P turn" 11 "U turn" 12 "Pedestrian" 13 "Frontage Road" 14 "Intersection internal(Plural Junction)" 15 "Invalid" ;
VAL_ 3221225472 POS_V2_CurrDirectionLanes 0 "Unknown" 1 "Lane count" 2 "Lane count" 3 "Lane count" 4 "Lane count" 5 "Lane count" 6 "Lane count" 7 "Lane count" 8 "Lane count" 9 "Lane count" 10 "Lane count" 11 "Lane count" 12 "Lane count" 13 "Lane count" 14 "Lane count" 15 "Invalid" ;
VAL_ 3221225472 POS_V2_CurrSpeedLimit 0 "Unknown" 1 "Under 5kph(mph)" 16 "75kph(mph)" 17 "80kph(mph)" 18 "85kph(mph)" 19 "90kph(mph)" 20 "95kph(mph)" 21 "100kph(mph)" 22 "105kph(mph)" 23 "110kph(mph)" 24 "115kph(mph)" 25 "120kph(mph)" 26 "130kph(mph)" 27 "140kph(mph)" 28 "150kph(mph)" 29 "160kph(mph)" 30 "Unlimited" 31 "Invalid" 2 "7kph(mph)" 3 "10kph(mph)" 4 "15kph(mph)" 5 "20kph(mph)" 6 "25kph(mph)" 7 "30kph(mph)" 8 "35kph(mph)" 9 "40kph(mph)" 10 "45kph(mph)" 11 "50kph(mph)" 12 "55kph(mph)" 13 "60kph(mph)" 14 "65kph(mph)" 15 "70kph(mph)" ;
VAL_ 3221225472 POS_V2_CurrTrafficSpeed 0 "Unknown" 1 "Under 5kph(mph)" 16 "75kph(mph)" 17 "80kph(mph)" 18 "85kph(mph)" 19 "90kph(mph)" 20 "95kph(mph)" 21 "100kph(mph)" 22 "105kph(mph)" 23 "110kph(mph)" 24 "115kph(mph)" 25 "120kph(mph)" 26 "130kph(mph)" 27 "140kph(mph)" 28 "150kph(mph)" 29 "160kph(mph)" 30 "Over160kph(mph)" 31 "Invalid" 2 "7kph(mph)" 3 "10kph(mph)" 4 "15kph(mph)" 5 "20kph(mph)" 6 "25kph(mph)" 7 "30kph(mph)" 8 "35kph(mph)" 9 "40kph(mph)" 10 "45kph(mph)" 11 "50kph(mph)" 12 "55kph(mph)" 13 "60kph(mph)" 14 "65kph(mph)" 15 "70kph(mph)" ;
VAL_ 3221225472 VCU_EnergyFlowSta 0 "None" 1 "Vehicle Stop" 2 "EV Propulsion" 3 "Not Used" 4 "Not Used" 5 "Not Used" 6 "Regeneration" 7 "Not Used" 8 "Not Used" 9 "Not Used" 10 "Reserved" 11 "Reserved" 12 "Reserved" 13 "Reserved" 14 "Reserved" 15 "Reserved" ;
VAL_ 3221225472 VCU_SbwWarnSndSta 0 "Warning Sound Off" 1 "Warning Sound On" 2 "Not used" 3 "Error Indicator" ;
VAL_ 3221225472 VCU_EcoGuide_DispReq 0 "Smart ECO Guide Off" 1 "Smart ECO Guide On" 2 "Not used" 3 "Error Indicator" ;
VAL_ 3221225472 VCU_EcoGuide_ApsGaugeVal 0 "Not Display" 1 "1~100" 2 "1~100" 3 "1~100" 4 "1~100" 5 "1~100" 6 "1~100" 7 "1~100" 8 "1~100" 9 "1~100" 10 "1~100" 11 "1~100" 12 "1~100" 13 "1~100" 14 "1~100" 15 "1~100" 16 "1~100" 17 "1~100" 18 "1~100" 19 "1~100" 20 "1~100" 21 "1~100" 22 "1~100" 23 "1~100" 24 "1~100" 25 "1~100" 26 "1~100" 27 "1~100" 28 "1~100" 29 "1~100" 30 "1~100" 31 "1~100" 32 "1~100" 33 "1~100" 34 "1~100" 35 "1~100" 36 "1~100" 37 "1~100" 38 "1~100" 39 "1~100" 40 "1~100" 41 "1~100" 42 "1~100" 43 "1~100" 44 "1~100" 45 "1~100" 46 "1~100" 47 "1~100" 48 "1~100" 49 "1~100" 50 "1~100" 51 "1~100" 52 "1~100" 53 "1~100" 54 "1~100" 55 "1~100" 56 "1~100" 57 "1~100" 58 "1~100" 59 "1~100" 60 "1~100" 61 "1~100" 62 "1~100" 63 "1~100" 64 "1~100" 65 "1~100" 66 "1~100" 67 "1~100" 68 "1~100" 69 "1~100" 70 "1~100" 71 "1~100" 72 "1~100" 73 "1~100" 74 "1~100" 75 "1~100" 76 "1~100" 77 "1~100" 78 "1~100" 79 "1~100" 80 "1~100" 81 "1~100" 82 "1~100" 83 "1~100" 84 "1~100" 85 "1~100" 86 "1~100" 87 "1~100" 88 "1~100" 89 "1~100" 90 "1~100" 91 "1~100" 92 "1~100" 93 "1~100" 94 "1~100" 95 "1~100" 96 "1~100" 97 "1~100" 98 "1~100" 99 "1~100" 100 "1~100" 101 "Reserved" 102 "Reserved" 103 "Reserved" 104 "Reserved" 105 "Reserved" 106 "Reserved" 107 "Reserved" 108 "Reserved" 109 "Reserved" 110 "Reserved" 111 "Reserved" 112 "Reserved" 113 "Reserved" 114 "Reserved" 115 "Reserved" 116 "Reserved" 117 "Reserved" 118 "Reserved" 119 "Reserved" 120 "Reserved" 121 "Reserved" 122 "Reserved" 123 "Reserved" 124 "Reserved" 125 "Reserved" 126 "Reserved" 127 "Reserved" ;
VAL_ 3221225472 VCU_EcoGuide_EcoGaugeVal 0 "Not Display" 1 "1~100" 2 "1~100" 3 "1~100" 4 "1~100" 5 "1~100" 6 "1~100" 7 "1~100" 8 "1~100" 9 "1~100" 10 "1~100" 11 "1~100" 12 "1~100" 13 "1~100" 14 "1~100" 15 "1~100" 16 "1~100" 17 "1~100" 18 "1~100" 19 "1~100" 20 "1~100" 21 "1~100" 22 "1~100" 23 "1~100" 24 "1~100" 25 "1~100" 26 "1~100" 27 "1~100" 28 "1~100" 29 "1~100" 30 "1~100" 31 "1~100" 32 "1~100" 33 "1~100" 34 "1~100" 35 "1~100" 36 "1~100" 37 "1~100" 38 "1~100" 39 "1~100" 40 "1~100" 41 "1~100" 42 "1~100" 43 "1~100" 44 "1~100" 45 "1~100" 46 "1~100" 47 "1~100" 48 "1~100" 49 "1~100" 50 "1~100" 51 "1~100" 52 "1~100" 53 "1~100" 54 "1~100" 55 "1~100" 56 "1~100" 57 "1~100" 58 "1~100" 59 "1~100" 60 "1~100" 61 "1~100" 62 "1~100" 63 "1~100" 64 "1~100" 65 "1~100" 66 "1~100" 67 "1~100" 68 "1~100" 69 "1~100" 70 "1~100" 71 "1~100" 72 "1~100" 73 "1~100" 74 "1~100" 75 "1~100" 76 "1~100" 77 "1~100" 78 "1~100" 79 "1~100" 80 "1~100" 81 "1~100" 82 "1~100" 83 "1~100" 84 "1~100" 85 "1~100" 86 "1~100" 87 "1~100" 88 "1~100" 89 "1~100" 90 "1~100" 91 "1~100" 92 "1~100" 93 "1~100" 94 "1~100" 95 "1~100" 96 "1~100" 97 "1~100" 98 "1~100" 99 "1~100" 100 "1~100" 101 "Reserved" 102 "Reserved" 103 "Reserved" 104 "Reserved" 105 "Reserved" 106 "Reserved" 107 "Reserved" 108 "Reserved" 109 "Reserved" 110 "Reserved" 111 "Reserved" 112 "Reserved" 113 "Reserved" 114 "Reserved" 115 "Reserved" 116 "Reserved" 117 "Reserved" 118 "Reserved" 119 "Reserved" 120 "Reserved" 121 "Reserved" 122 "Reserved" 123 "Reserved" 124 "Reserved" 125 "Reserved" 126 "Reserved" 127 "Reserved" ;
VAL_ 3221225472 VCU_DistFromRegenDispReq 0 "Default" 1 "Displayed ---" 2 "Positive Value" 3 "Negative Value" ;
VAL_ 3221225472 VCU_DrvStyle_DispReq 0 "Invalid" 1 "Valid" 2 "Not used" 3 "Error Indicator" ;
VAL_ 3221225472 VCU_DrvStyle_HighLightSta 0 "None" 1 "High Fuel Efficiency" 2 "Normal Fuel Efficiency" 3 "Low Fuel Efficiency" ;
VAL_ 3221225472 VCU_DrvStyle_EcoVal 0 "0x0x0~0x64:0~100" 100 "0x0x0~0x64:0~100" 101 "Reserved" 102 "Reserved" 103 "Reserved" 104 "Reserved" 105 "Reserved" 106 "Reserved" 107 "Reserved" 108 "Reserved" 109 "Reserved" 110 "Reserved" 111 "Reserved" 112 "Reserved" 113 "Reserved" 114 "Reserved" 115 "Reserved" 116 "Reserved" 117 "Reserved" 118 "Reserved" 119 "Reserved" 120 "Reserved" 121 "Reserved" 122 "Reserved" 123 "Reserved" 124 "Reserved" 125 "Reserved" 126 "Reserved" 127 "Reserved" ;
VAL_ 3221225472 VCU_DrvStyle_NonEcoVal 0 "0x0x0~0x64:0~100" 100 "0x0x0~0x64:0~100" 101 "Reserved" 102 "Reserved" 103 "Reserved" 104 "Reserved" 105 "Reserved" 106 "Reserved" 107 "Reserved" 108 "Reserved" 109 "Reserved" 110 "Reserved" 111 "Reserved" 112 "Reserved" 113 "Reserved" 114 "Reserved" 115 "Reserved" 116 "Reserved" 117 "Reserved" 118 "Reserved" 119 "Reserved" 120 "Reserved" 121 "Reserved" 122 "Reserved" 123 "Reserved" 124 "Reserved" 125 "Reserved" 126 "Reserved" 127 "Reserved" ;
VAL_ 3221225472 VCU_DrvStyle_NorVal 0 "0x0x0~0x64:0~100" 100 "0x0x0~0x64:0~100" 101 "Reserved" 102 "Reserved" 103 "Reserved" 104 "Reserved" 105 "Reserved" 106 "Reserved" 107 "Reserved" 108 "Reserved" 109 "Reserved" 110 "Reserved" 111 "Reserved" 112 "Reserved" 113 "Reserved" 114 "Reserved" 115 "Reserved" 116 "Reserved" 117 "Reserved" 118 "Reserved" 119 "Reserved" 120 "Reserved" 121 "Reserved" 122 "Reserved" 123 "Reserved" 124 "Reserved" 125 "Reserved" 126 "Reserved" 127 "Reserved" ;
VAL_ 3221225472 VCU_EvDrvRdyCluDispSta 0 "Ready Lamp Off" 1 "Ready Lamp On" 2 "Blinking" 3 "Error Indicator" ;
VAL_ 3221225472 VCU_PwrDnModeSta 0 "None" 1 "Set" 2 "Not used" 3 "Error Indicator" ;
VAL_ 3221225472 VCU_CluWarnMsgSta 0 "None(Default)" 1 "Regenerative Braking System Operating Stop" 2 "AC,PTC Controllable when EV_Ready is OFF" 3 "-" 4 "Gear P Change Impossible(VB 10.5V)" 5 "Gear P Change Impossible(VB 9.5V)" 6 "-" 7 "-" 8 "Reserved" 9 "Reserved" 10 "Reserved" 11 "Reserved" 12 "Reserved" 13 "Reserved" 14 "Reserved" 15 "Reserved" ;
VAL_ 3221225472 VCU_DteOffDispSta 0 "None" 1 "DTE Off('---' Display)" 2 "Not used" 3 "Error Indicator" ;
VAL_ 3221225472 VCU_LowSocAlertSta 0 "No Alert" 1 "Low SOC Alert 1" 2 "Low SOC Alert 2" 3 "Low SOC Alert 3" 4 "Reserved" 5 "Reserved" 6 "Reserved" 7 "SOC Unavailable Alert" ;
VAL_ 3221225472 VCU_VcrmReq 0 "Wait(Not Request Logging)" 1 "Service/MIL Lamp On(Request Logging)" 2 "Warning, Abnormal IG Off(Request Logging)" 3 "Reserved" ;
VAL_ 3221225472 VCU_PdlWarnMsgSta 0 "None" 1 "Pop-up Request" 2 "Not used" 3 "Error Indicator" ;
VAL_ 3221225472 VCU_VirtualApsActSta 0 "Real APS" 1 "Virtual APS for Crz" 2 "Not used" 3 "Error Indicator" ;
VAL_ 3221225472 VCU_ServiceLampReq 0 "None" 1 "Service Lamp On" 2 "Not used" 3 "Error Indicator" ;
VAL_ 3221225472 VCU_ServiceModeSta 0 "Normal Mode" 1 "2WD Test Mode" 2 "Not used" 3 "Error Indicator" ;
VAL_ 3221225472 VCU_NPosWshModSta 0 "Normal" 1 "Standby" 2 "N Wash Mode" 3 "Reserved" ;
VAL_ 3221225472 VCU_PowerTrainType 0 "One Moter" 1 "Dual Motor(Base)" 2 "Dual Motor(Performance)" 3 "Reserved" ;
VAL_ 3221225472 VCU_AvnDteOnCalcSta 0 "Display DTE Value" 1 "Display 'Recalculating'" 2 "Not used" 3 "Error Indicator" ;
VAL_ 3221225472 VCU_SbwWarnMsgSta 0 "Off" 1 "Warning 1 - SCU/Parking System Failure" 2 "Warning 2 - Unavailable to Shift Gear" 3 "Warning 3 - Brake On for Gear Shift" 4 "Warning 4 - Unavailable to Park" 5 "Warning 5 - Auto Parked" 6 "Warning 6 - Unavailable to Release Park" 7 "Warning 7 - Same Button Re-Entered" ;
VAL_ 3221225472 HU_DistanceUnit 0 "Km" 1 "Mile" 2 "Reserved" 3 "Invalid" ;
VAL_ 3221225472 HU_MicActivity 0 "Deactivated" 1 "Activated" 2 "reserved" 3 "Invalid" ;
VAL_ 3221225472 AVN_RSPA_CancelInput 0 "Init" 1 "No Input" 2 "Cancel Input" 3 "Invalid" ;
VAL_ 3221225472 AVN_RSPA_ModeSetStat 0 "None" 1 "1st menu from the leftmost" 2 "2nd menu from the leftmost" 3 "3rd menu from the leftmost" 4 "4th menu from the leftmost" 5 "5th menu from the leftmost" 6 "6th menu from the leftmost" 7 "7th menu from the leftmost" 8 "8th menu from the leftmost" 9 "Reserved" 10 "Reserved" 11 "Reserved" 12 "Reserved" 13 "Reserved" 14 "Reserved" 15 "Invalid" ;
VAL_ 3221225472 AVN_RSPA_Disp_Rdy 0 "Impossible to display" 1 "Possible to display" 2 "Reserved" 3 "Invalid" ;
VAL_ 3221225472 CF_AVN_ProfileIDRValue 0 "Default" 1 "Guest" 2 "Profile 1" 3 "Profile 2" 4 "reserved" 5 "reserved" 6 "reserved" 7 "reserved" 8 "reserved" 9 "reserved" 10 "reserved" 11 "reserved" 12 "reserved" 13 "reserved" 14 "reserved" 15 "Invalid" ;
VAL_ 3221225472 HazardFromHUSVM 0 "inactive" 1 "active" 2 "reserved" 3 "invalid" ;
VAL_ 3221225472 OMUOSMirCtrl 0 "Off" 1 "Fold" 2 "Unfold" 3 "invalid" ;
VAL_ 3221225472 AVN_PDW_Input 0 "Init" 1 "No input" 2 "PDW softkey touch input" 3 "Invalid" ;
VAL_ 3221225472 AVN_RSPA_Input 0 "Init" 1 "No input" 2 "RSPA on request" 3 "Invalid" ;
VAL_ 3221225472 AVN_ParkingSW 0 "Released(off)" 1 "Pressed" 2 "Reserved" 3 "Reserved" 4 "Reserved" 5 "Reserved" 6 "Reserved" 7 "Invalid" ;
VAL_ 3221225472 HU_AliveStatus 0 "Not Ready" 1 "On Mode" 2 "Head Unit Update Mode" 3 "Invalid" ;
VAL_ 3221225472 C_MtnAlertClu 0 "Activate" 1 "Deactivate" 2 "Reserved" 3 "Invalid" ;
