VERSION ""

NS_ :

BS_:

BU_: MXC CGW

BO_ 3221225472 VECTOR__INDEPENDENT_SIG_MSG: 0 Vector__XXX
 SG_ RR_C_RDR_Crc02Val : 0|16@1+ (1,0) [0|0] "" Vector__XXX
 SG_ Brake_Control_FL : 0|2@1+ (1,0) [0|0] "" Vector__XXX
 SG_ Brake_Control_FR : 0|2@1+ (1,0) [0|0] "%" Vector__XXX
 SG_ Front_Target_Pressure : 0|6@1+ (1,0) [0|0] "Bar" Vector__XXX
 SG_ Brake_Control_RL : 0|2@1+ (1,0) [0|0] "" Vector__XXX
 SG_ Rear_Target_Pressure : 0|6@1+ (1,0) [0|0] "Bar" Vector__XXX
 SG_ Brake_Control_RR : 0|2@1+ (1,0) [0|0] "" Vector__XXX
 SG_ RR_C_RDR_AlvCnt02Val : 0|8@1+ (1,0) [0|0] "" Vector__XXX
 SG_ BCW_Sta : 0|4@1+ (1,0) [0|0] "" Vector__XXX
 SG_ BCW_OnOffEquipSta : 0|2@1+ (1,0) [0|0] "" Vector__XXX
 SG_ BCW_LftIndSta : 0|2@1+ (1,0) [0|0] "" Vector__XXX
 SG_ BCW_RtIndSta : 0|2@1+ (1,0) [0|0] "" Vector__XXX
 SG_ BCW_LftSndWrngSta : 0|2@1+ (1,0) [0|0] "" Vector__XXX
 SG_ BCW_RtSndWrngSta : 0|2@1+ (1,0) [0|0] "" Vector__XXX
 SG_ BCW_LftIndBriLvlVal : 0|8@1+ (1,0) [0|0] "" Vector__XXX
 SG_ BCW_RtIndBriLvlVal : 0|8@1+ (1,0) [0|0] "" Vector__XXX
 SG_ BCW_SnstvtyModRetVal : 0|3@1+ (1,0) [0|0] "" Vector__XXX
 SG_ BCW_IndSta : 0|2@1+ (1,0) [0|0] "" Vector__XXX
 SG_ BCA_Sta : 0|4@1+ (1,0) [0|0] "" Vector__XXX
 SG_ BCA_OnOffEquipSta : 0|3@1+ (1,0) [0|0] "" Vector__XXX
 SG_ BCA_R_Brake_Warning : 0|3@1+ (1,0) [0|0] "" Vector__XXX
 SG_ BCA_Plus_Deccel_Req : 0|4@1+ (0.04,0) [0|0] "g" Vector__XXX
 SG_ BCA_Plus_BrkCmdSta : 0|2@1+ (1,0) [0|0] "" Vector__XXX
 SG_ BCA_Plus_LftWrngSta : 0|2@1+ (1,0) [0|0] "" Vector__XXX
 SG_ BCA_Plus_RtWrngSta : 0|2@1+ (1,0) [0|0] "" Vector__XXX
 SG_ BCA_Plus_OnOffEquipSta : 0|3@1+ (1,0) [0|0] "" Vector__XXX
 SG_ BCA_Plus_FuncStat : 0|2@1+ (1,0) [0|0] "" Vector__XXX
 SG_ BCA_Plus_Sta : 0|4@1+ (1,0) [0|0] "" Vector__XXX
 SG_ GST_ESC_Byte0 : 0|8@1+ (1,0) [0|0] "" Vector__XXX
 SG_ GST_ESC_Byte2 : 0|8@1+ (1,0) [0|0] "" Vector__XXX
 SG_ GST_ESC_Byte3 : 0|8@1+ (1,0) [0|0] "" Vector__XXX
 SG_ GST_ESC_Byte4 : 0|8@1+ (1,0) [0|0] "" Vector__XXX
 SG_ GST_ESC_Byte5 : 0|8@1+ (1,0) [0|0] "" Vector__XXX
 SG_ GST_ESC_Byte6 : 0|8@1+ (1,0) [0|0] "" Vector__XXX
 SG_ GST_ESC_Byte7 : 0|8@1+ (1,0) [0|0] "" Vector__XXX
 SG_ GST_ESC_Byte1 : 0|8@1+ (1,0) [0|0] "" Vector__XXX
 SG_ GST_MDPS_Byte0 : 0|8@1+ (1,0) [0|0] "" Vector__XXX
 SG_ GST_MDPS_Byte2 : 0|8@1+ (1,0) [0|0] "" Vector__XXX
 SG_ GST_MDPS_Byte3 : 0|8@1+ (1,0) [0|0] "" Vector__XXX
 SG_ GST_MDPS_Byte4 : 0|8@1+ (1,0) [0|0] "" Vector__XXX
 SG_ GST_MDPS_Byte5 : 0|8@1+ (1,0) [0|0] "" Vector__XXX
 SG_ GST_MDPS_Byte6 : 0|8@1+ (1,0) [0|0] "" Vector__XXX
 SG_ GST_MDPS_Byte7 : 0|8@1+ (1,0) [0|0] "" Vector__XXX
 SG_ GST_MDPS_Byte1 : 0|8@1+ (1,0) [0|0] "" Vector__XXX
 SG_ CALSAS_Crc1Val : 0|16@1+ (1,0) [0|0] "" Vector__XXX
 SG_ CALSAS_AlvCnt1Val : 0|8@1+ (1,0) [0|0] "" Vector__XXX
 SG_ SAS_CmdCodWrdVal : 0|4@1+ (1,0) [0|0] "" Vector__XXX
 SG_ SAS_CANIdVal : 0|11@1+ (1,0) [0|0] "" Vector__XXX
 SG_ GST_EPB_Byte0 : 0|8@1+ (1,0) [0|0] "" Vector__XXX
 SG_ GST_EPB_Byte2 : 0|8@1+ (1,0) [0|0] "" Vector__XXX
 SG_ GST_EPB_Byte3 : 0|8@1+ (1,0) [0|0] "" Vector__XXX
 SG_ GST_EPB_Byte4 : 0|8@1+ (1,0) [0|0] "" Vector__XXX
 SG_ GST_EPB_Byte5 : 0|8@1+ (1,0) [0|0] "" Vector__XXX
 SG_ GST_EPB_Byte6 : 0|8@1+ (1,0) [0|0] "" Vector__XXX
 SG_ GST_EPB_Byte7 : 0|8@1+ (1,0) [0|0] "" Vector__XXX
 SG_ GST_EPB_Byte1 : 0|8@1+ (1,0) [0|0] "" Vector__XXX
 SG_ ECS_GST_Byte0 : 0|8@1+ (1,0) [0|0] "" Vector__XXX
 SG_ ECS_GST_Byte2 : 0|8@1+ (1,0) [0|0] "" Vector__XXX
 SG_ ECS_GST_Byte3 : 0|8@1+ (1,0) [0|0] "" Vector__XXX
 SG_ ECS_GST_Byte4 : 0|8@1+ (1,0) [0|0] "" Vector__XXX
 SG_ ECS_GST_Byte5 : 0|8@1+ (1,0) [0|0] "" Vector__XXX
 SG_ ECS_GST_Byte6 : 0|8@1+ (1,0) [0|0] "" Vector__XXX
 SG_ ECS_GST_Byte7 : 0|8@1+ (1,0) [0|0] "" Vector__XXX
 SG_ ECS_GST_Byte1 : 0|8@1+ (1,0) [0|0] "" Vector__XXX
 SG_ ESC_DTO_Byte0 : 0|8@1+ (1,0) [0|0] "" Vector__XXX
 SG_ ESC_DTO_Byte2 : 0|8@1+ (1,0) [0|0] "" Vector__XXX
 SG_ ESC_DTO_Byte3 : 0|8@1+ (1,0) [0|0] "" Vector__XXX
 SG_ ESC_DTO_Byte4 : 0|8@1+ (1,0) [0|0] "" Vector__XXX
 SG_ ESC_DTO_Byte5 : 0|8@1+ (1,0) [0|0] "" Vector__XXX
 SG_ ESC_DTO_Byte6 : 0|8@1+ (1,0) [0|0] "" Vector__XXX
 SG_ ESC_DTO_Byte7 : 0|8@1+ (1,0) [0|0] "" Vector__XXX
 SG_ ESC_DTO_Byte1 : 0|8@1+ (1,0) [0|0] "" Vector__XXX
 SG_ ESC_CRO_Byte0 : 0|8@1+ (1,0) [0|0] "" Vector__XXX
 SG_ ESC_CRO_Byte2 : 0|8@1+ (1,0) [0|0] "" Vector__XXX
 SG_ ESC_CRO_Byte3 : 0|8@1+ (1,0) [0|0] "" Vector__XXX
 SG_ ESC_CRO_Byte4 : 0|8@1+ (1,0) [0|0] "" Vector__XXX
 SG_ ESC_CRO_Byte5 : 0|8@1+ (1,0) [0|0] "" Vector__XXX
 SG_ ESC_CRO_Byte6 : 0|8@1+ (1,0) [0|0] "" Vector__XXX
 SG_ ESC_CRO_Byte7 : 0|8@1+ (1,0) [0|0] "" Vector__XXX
 SG_ ESC_CRO_Byte1 : 0|8@1+ (1,0) [0|0] "" Vector__XXX
 SG_ ESC_GST_Byte0 : 0|8@1+ (1,0) [0|0] "" Vector__XXX
 SG_ ESC_GST_Byte2 : 0|8@1+ (1,0) [0|0] "" Vector__XXX
 SG_ ESC_GST_Byte3 : 0|8@1+ (1,0) [0|0] "" Vector__XXX
 SG_ ESC_GST_Byte4 : 0|8@1+ (1,0) [0|0] "" Vector__XXX
 SG_ ESC_GST_Byte5 : 0|8@1+ (1,0) [0|0] "" Vector__XXX
 SG_ ESC_GST_Byte6 : 0|8@1+ (1,0) [0|0] "" Vector__XXX
 SG_ ESC_GST_Byte7 : 0|8@1+ (1,0) [0|0] "" Vector__XXX
 SG_ ESC_GST_Byte1 : 0|8@1+ (1,0) [0|0] "" Vector__XXX
 SG_ ESC_Logger1_Byte0 : 0|8@1+ (1,0) [0|0] "" Vector__XXX
 SG_ ESC_Logger1_Byte2 : 0|8@1+ (1,0) [0|0] "" Vector__XXX
 SG_ ESC_Logger1_Byte3 : 0|8@1+ (1,0) [0|0] "" Vector__XXX
 SG_ ESC_Logger1_Byte4 : 0|8@1+ (1,0) [0|0] "" Vector__XXX
 SG_ ESC_Logger1_Byte5 : 0|8@1+ (1,0) [0|0] "" Vector__XXX
 SG_ ESC_Logger1_Byte6 : 0|8@1+ (1,0) [0|0] "" Vector__XXX
 SG_ ESC_Logger1_Byte7 : 0|8@1+ (1,0) [0|0] "" Vector__XXX
 SG_ ESC_Logger1_Byte1 : 0|8@1+ (1,0) [0|0] "" Vector__XXX
 SG_ ESC_Logger0_Byte0 : 0|8@1+ (1,0) [0|0] "" Vector__XXX
 SG_ ESC_Logger0_Byte2 : 0|8@1+ (1,0) [0|0] "" Vector__XXX
 SG_ ESC_Logger0_Byte3 : 0|8@1+ (1,0) [0|0] "" Vector__XXX
 SG_ ESC_Logger0_Byte4 : 0|8@1+ (1,0) [0|0] "" Vector__XXX
 SG_ ESC_Logger0_Byte5 : 0|8@1+ (1,0) [0|0] "" Vector__XXX
 SG_ ESC_Logger0_Byte6 : 0|8@1+ (1,0) [0|0] "" Vector__XXX
 SG_ ESC_Logger0_Byte7 : 0|8@1+ (1,0) [0|0] "" Vector__XXX
 SG_ ESC_Logger0_Byte1 : 0|8@1+ (1,0) [0|0] "" Vector__XXX
 SG_ GST_ALL_Byte0 : 0|8@1+ (1,0) [0|0] "" Vector__XXX
 SG_ GST_ALL_Byte2 : 0|8@1+ (1,0) [0|0] "" Vector__XXX
 SG_ GST_ALL_Byte3 : 0|8@1+ (1,0) [0|0] "" Vector__XXX
 SG_ GST_ALL_Byte4 : 0|8@1+ (1,0) [0|0] "" Vector__XXX
 SG_ GST_ALL_Byte5 : 0|8@1+ (1,0) [0|0] "" Vector__XXX
 SG_ GST_ALL_Byte6 : 0|8@1+ (1,0) [0|0] "" Vector__XXX
 SG_ GST_ALL_Byte7 : 0|8@1+ (1,0) [0|0] "" Vector__XXX
 SG_ GST_ALL_Byte1 : 0|8@1+ (1,0) [0|0] "" Vector__XXX
 SG_ MDPS_GST_Byte0 : 0|8@1+ (1,0) [0|0] "" Vector__XXX
 SG_ MDPS_GST_Byte2 : 0|8@1+ (1,0) [0|0] "" Vector__XXX
 SG_ MDPS_GST_Byte3 : 0|8@1+ (1,0) [0|0] "" Vector__XXX
 SG_ MDPS_GST_Byte4 : 0|8@1+ (1,0) [0|0] "" Vector__XXX
 SG_ MDPS_GST_Byte5 : 0|8@1+ (1,0) [0|0] "" Vector__XXX
 SG_ MDPS_GST_Byte6 : 0|8@1+ (1,0) [0|0] "" Vector__XXX
 SG_ MDPS_GST_Byte7 : 0|8@1+ (1,0) [0|0] "" Vector__XXX
 SG_ MDPS_GST_Byte1 : 0|8@1+ (1,0) [0|0] "" Vector__XXX
 SG_ ECS_Crc4Val : 0|16@1+ (1,0) [0|0] "" Vector__XXX
 SG_ ECSIVSS_RdIndxVal : 0|4@1+ (1,0) [0|0] "" Vector__XXX
 SG_ ECS_AlvCnt4Val : 0|8@1+ (1,0) [0|0] "" Vector__XXX
 SG_ ECSIVSS_FLWhlVrtclAccelSnsrVal : 0|12@1+ (0.03247863,-16.62905856) [0|0] "g" Vector__XXX
 SG_ ECSIVSS_FRWhlVrtclAccelSnsrVal : 0|12@1+ (0.03247863,-16.62905856) [0|0] "g" Vector__XXX
 SG_ ECSIVSS_FLBodyAccelSnsrVal : 0|12@1+ (0.002442,-1.250304) [0|0] "g" Vector__XXX
 SG_ ECSIVSS_FRBodyAccelSnsrVal : 0|12@1+ (0.002442,-1.250304) [0|0] "g" Vector__XXX
 SG_ ECSIVSS_RrBodyAccelSnsrVal : 0|12@1+ (0.002442,-1.250304) [0|0] "g" Vector__XXX
 SG_ ESC_Logger3_Byte0 : 0|8@1+ (1,0) [0|0] "" Vector__XXX
 SG_ ESC_Logger3_Byte2 : 0|8@1+ (1,0) [0|0] "" Vector__XXX
 SG_ ESC_Logger3_Byte3 : 0|8@1+ (1,0) [0|0] "" Vector__XXX
 SG_ ESC_Logger3_Byte4 : 0|8@1+ (1,0) [0|0] "" Vector__XXX
 SG_ ESC_Logger3_Byte5 : 0|8@1+ (1,0) [0|0] "" Vector__XXX
 SG_ ESC_Logger3_Byte6 : 0|8@1+ (1,0) [0|0] "" Vector__XXX
 SG_ ESC_Logger3_Byte7 : 0|8@1+ (1,0) [0|0] "" Vector__XXX
 SG_ ESC_Logger3_Byte1 : 0|8@1+ (1,0) [0|0] "" Vector__XXX
 SG_ EPB_GST_Byte0 : 0|8@1+ (1,0) [0|0] "" Vector__XXX
 SG_ EPB_GST_Byte2 : 0|8@1+ (1,0) [0|0] "" Vector__XXX
 SG_ EPB_GST_Byte3 : 0|8@1+ (1,0) [0|0] "" Vector__XXX
 SG_ EPB_GST_Byte4 : 0|8@1+ (1,0) [0|0] "" Vector__XXX
 SG_ EPB_GST_Byte5 : 0|8@1+ (1,0) [0|0] "" Vector__XXX
 SG_ EPB_GST_Byte6 : 0|8@1+ (1,0) [0|0] "" Vector__XXX
 SG_ EPB_GST_Byte7 : 0|8@1+ (1,0) [0|0] "" Vector__XXX
 SG_ EPB_GST_Byte1 : 0|8@1+ (1,0) [0|0] "" Vector__XXX
 SG_ ESC_Logger2_Byte0 : 0|8@1+ (1,0) [0|0] "" Vector__XXX
 SG_ ESC_Logger2_Byte2 : 0|8@1+ (1,0) [0|0] "" Vector__XXX
 SG_ ESC_Logger2_Byte3 : 0|8@1+ (1,0) [0|0] "" Vector__XXX
 SG_ ESC_Logger2_Byte4 : 0|8@1+ (1,0) [0|0] "" Vector__XXX
 SG_ ESC_Logger2_Byte5 : 0|8@1+ (1,0) [0|0] "" Vector__XXX
 SG_ ESC_Logger2_Byte6 : 0|8@1+ (1,0) [0|0] "" Vector__XXX
 SG_ ESC_Logger2_Byte7 : 0|8@1+ (1,0) [0|0] "" Vector__XXX
 SG_ ESC_Logger2_Byte1 : 0|8@1+ (1,0) [0|0] "" Vector__XXX
 SG_ ESC_Logger4_Byte0 : 0|8@1+ (1,0) [0|0] "" Vector__XXX
 SG_ ESC_Logger4_Byte2 : 0|8@1+ (1,0) [0|0] "" Vector__XXX
 SG_ ESC_Logger4_Byte3 : 0|8@1+ (1,0) [0|0] "" Vector__XXX
 SG_ ESC_Logger4_Byte4 : 0|8@1+ (1,0) [0|0] "" Vector__XXX
 SG_ ESC_Logger4_Byte5 : 0|8@1+ (1,0) [0|0] "" Vector__XXX
 SG_ ESC_Logger4_Byte6 : 0|8@1+ (1,0) [0|0] "" Vector__XXX
 SG_ ESC_Logger4_Byte7 : 0|8@1+ (1,0) [0|0] "" Vector__XXX
 SG_ ESC_Logger4_Byte1 : 0|8@1+ (1,0) [0|0] "" Vector__XXX
 SG_ GST_ODS_Byte0 : 0|8@1+ (1,0) [0|0] "" Vector__XXX
 SG_ GST_ODS_Byte2 : 0|8@1+ (1,0) [0|0] "" Vector__XXX
 SG_ GST_ODS_Byte3 : 0|8@1+ (1,0) [0|0] "" Vector__XXX
 SG_ GST_ODS_Byte4 : 0|8@1+ (1,0) [0|0] "" Vector__XXX
 SG_ GST_ODS_Byte5 : 0|8@1+ (1,0) [0|0] "" Vector__XXX
 SG_ GST_ODS_Byte6 : 0|8@1+ (1,0) [0|0] "" Vector__XXX
 SG_ GST_ODS_Byte7 : 0|8@1+ (1,0) [0|0] "" Vector__XXX
 SG_ GST_ODS_Byte1 : 0|8@1+ (1,0) [0|0] "" Vector__XXX
 SG_ ESC_Logger5_Byte0 : 0|8@1+ (1,0) [0|0] "" Vector__XXX
 SG_ ESC_Logger5_Byte2 : 0|8@1+ (1,0) [0|0] "" Vector__XXX
 SG_ ESC_Logger5_Byte3 : 0|8@1+ (1,0) [0|0] "" Vector__XXX
 SG_ ESC_Logger5_Byte4 : 0|8@1+ (1,0) [0|0] "" Vector__XXX
 SG_ ESC_Logger5_Byte5 : 0|8@1+ (1,0) [0|0] "" Vector__XXX
 SG_ ESC_Logger5_Byte6 : 0|8@1+ (1,0) [0|0] "" Vector__XXX
 SG_ ESC_Logger5_Byte7 : 0|8@1+ (1,0) [0|0] "" Vector__XXX
 SG_ ESC_Logger5_Byte1 : 0|8@1+ (1,0) [0|0] "" Vector__XXX
 SG_ ESC_Logger6_Byte0 : 0|8@1+ (1,0) [0|0] "" Vector__XXX
 SG_ ESC_Logger6_Byte2 : 0|8@1+ (1,0) [0|0] "" Vector__XXX
 SG_ ESC_Logger6_Byte3 : 0|8@1+ (1,0) [0|0] "" Vector__XXX
 SG_ ESC_Logger6_Byte4 : 0|8@1+ (1,0) [0|0] "" Vector__XXX
 SG_ ESC_Logger6_Byte5 : 0|8@1+ (1,0) [0|0] "" Vector__XXX
 SG_ ESC_Logger6_Byte6 : 0|8@1+ (1,0) [0|0] "" Vector__XXX
 SG_ ESC_Logger6_Byte7 : 0|8@1+ (1,0) [0|0] "" Vector__XXX
 SG_ ESC_Logger6_Byte1 : 0|8@1+ (1,0) [0|0] "" Vector__XXX
 SG_ ESC_Logger7_Byte0 : 0|8@1+ (1,0) [0|0] "" Vector__XXX
 SG_ ESC_Logger7_Byte2 : 0|8@1+ (1,0) [0|0] "" Vector__XXX
 SG_ ESC_Logger7_Byte3 : 0|8@1+ (1,0) [0|0] "" Vector__XXX
 SG_ ESC_Logger7_Byte4 : 0|8@1+ (1,0) [0|0] "" Vector__XXX
 SG_ ESC_Logger7_Byte5 : 0|8@1+ (1,0) [0|0] "" Vector__XXX
 SG_ ESC_Logger7_Byte6 : 0|8@1+ (1,0) [0|0] "" Vector__XXX
 SG_ ESC_Logger7_Byte7 : 0|8@1+ (1,0) [0|0] "" Vector__XXX
 SG_ ESC_Logger7_Byte1 : 0|8@1+ (1,0) [0|0] "" Vector__XXX
 SG_ HU_LanguageInfo : 0|8@1+ (1,0) [0|0] "" Vector__XXX
 SG_ HU_MuteStatus : 0|2@1+ (1,0) [0|0] "" Vector__XXX
 SG_ HU_WelcomeReady : 0|2@1+ (1,0) [0|0] "" Vector__XXX
 SG_ HU_UsmSupport : 0|2@1+ (1,0) [0|0] "" Vector__XXX
 SG_ HU_NaviStatus : 0|2@1+ (1,0) [0|0] "" Vector__XXX
 SG_ HU_NaviDisp : 0|2@1+ (1,0) [0|0] "" Vector__XXX
 SG_ HU_BVM_Display_Message : 0|3@1+ (1,0) [0|0] "" Vector__XXX
 SG_ HU_SVM_View_Display : 0|5@1+ (1,0) [0|0] "" Vector__XXX
 SG_ HU_NaviCamSettingStatus : 0|8@1+ (1,0) [0|0] "" Vector__XXX
 SG_ HU_VolumeStatus : 0|6@1+ (1,0) [0|0] "" Vector__XXX
 SG_ ESC_Logger8_Byte0 : 0|8@1+ (1,0) [0|0] "" Vector__XXX
 SG_ ESC_Logger8_Byte2 : 0|8@1+ (1,0) [0|0] "" Vector__XXX
 SG_ ESC_Logger8_Byte3 : 0|8@1+ (1,0) [0|0] "" Vector__XXX
 SG_ ESC_Logger8_Byte4 : 0|8@1+ (1,0) [0|0] "" Vector__XXX
 SG_ ESC_Logger8_Byte5 : 0|8@1+ (1,0) [0|0] "" Vector__XXX
 SG_ ESC_Logger8_Byte6 : 0|8@1+ (1,0) [0|0] "" Vector__XXX
 SG_ ESC_Logger8_Byte7 : 0|8@1+ (1,0) [0|0] "" Vector__XXX
 SG_ ESC_Logger8_Byte1 : 0|8@1+ (1,0) [0|0] "" Vector__XXX
 SG_ ESC_Logger9_Byte0 : 0|8@1+ (1,0) [0|0] "" Vector__XXX
 SG_ ESC_Logger9_Byte2 : 0|8@1+ (1,0) [0|0] "" Vector__XXX
 SG_ ESC_Logger9_Byte3 : 0|8@1+ (1,0) [0|0] "" Vector__XXX
 SG_ ESC_Logger9_Byte4 : 0|8@1+ (1,0) [0|0] "" Vector__XXX
 SG_ ESC_Logger9_Byte5 : 0|8@1+ (1,0) [0|0] "" Vector__XXX
 SG_ ESC_Logger9_Byte6 : 0|8@1+ (1,0) [0|0] "" Vector__XXX
 SG_ ESC_Logger9_Byte7 : 0|8@1+ (1,0) [0|0] "" Vector__XXX
 SG_ ESC_Logger9_Byte1 : 0|8@1+ (1,0) [0|0] "" Vector__XXX
 SG_ HU_TimeSetting : 0|2@1+ (1,0) [0|0] "" Vector__XXX
 SG_ HU_DisplayMinute : 0|8@1+ (1,0) [0|0] "" Vector__XXX
 SG_ HU_Status : 0|4@1+ (1,0) [0|0] "" Vector__XXX
 SG_ HU_DisplaySecond : 0|8@1+ (1,0) [0|0] "" Vector__XXX
 SG_ HU_DisplayMonth : 0|4@1+ (1,0) [0|0] "" Vector__XXX
 SG_ HU_DisplayYear1 : 0|2@1+ (1,0) [0|0] "" Vector__XXX
 SG_ HU_DisplayYear2 : 0|8@1+ (1,0) [0|0] "" Vector__XXX
 SG_ HU_DisplayDay : 0|8@1+ (1,0) [0|0] "" Vector__XXX
 SG_ HU_AM_PM_INFO : 0|2@1+ (1,0) [0|0] "" Vector__XXX
 SG_ HU_ZeroDetection : 0|2@1+ (1,0) [0|0] "" Vector__XXX
 SG_ HU_TimeFormat : 0|2@1+ (1,0) [0|0] "" Vector__XXX
 SG_ HU_ComRefresh : 0|2@1+ (1,0) [0|0] "" Vector__XXX
 SG_ HU_ClockInfo : 0|2@1+ (1,0) [0|0] "" Vector__XXX
 SG_ HU_DisplayHour : 0|8@1+ (1,0) [0|0] "" Vector__XXX
 SG_ ESC_Logger10_Byte0 : 0|8@1+ (1,0) [0|0] "" Vector__XXX
 SG_ ESC_Logger10_Byte2 : 0|8@1+ (1,0) [0|0] "" Vector__XXX
 SG_ ESC_Logger10_Byte3 : 0|8@1+ (1,0) [0|0] "" Vector__XXX
 SG_ ESC_Logger10_Byte4 : 0|8@1+ (1,0) [0|0] "" Vector__XXX
 SG_ ESC_Logger10_Byte5 : 0|8@1+ (1,0) [0|0] "" Vector__XXX
 SG_ ESC_Logger10_Byte6 : 0|8@1+ (1,0) [0|0] "" Vector__XXX
 SG_ ESC_Logger10_Byte7 : 0|8@1+ (1,0) [0|0] "" Vector__XXX
 SG_ ESC_Logger10_Byte1 : 0|8@1+ (1,0) [0|0] "" Vector__XXX
 SG_ ESC_Logger11_Byte0 : 0|8@1+ (1,0) [0|0] "" Vector__XXX
 SG_ ESC_Logger11_Byte2 : 0|8@1+ (1,0) [0|0] "" Vector__XXX
 SG_ ESC_Logger11_Byte3 : 0|8@1+ (1,0) [0|0] "" Vector__XXX
 SG_ ESC_Logger11_Byte4 : 0|8@1+ (1,0) [0|0] "" Vector__XXX
 SG_ ESC_Logger11_Byte5 : 0|8@1+ (1,0) [0|0] "" Vector__XXX
 SG_ ESC_Logger11_Byte6 : 0|8@1+ (1,0) [0|0] "" Vector__XXX
 SG_ ESC_Logger11_Byte7 : 0|8@1+ (1,0) [0|0] "" Vector__XXX
 SG_ ESC_Logger11_Byte1 : 0|8@1+ (1,0) [0|0] "" Vector__XXX
 SG_ ODS_GST_Byte0 : 0|8@1+ (1,0) [0|0] "" Vector__XXX
 SG_ ODS_GST_Byte2 : 0|8@1+ (1,0) [0|0] "" Vector__XXX
 SG_ ODS_GST_Byte3 : 0|8@1+ (1,0) [0|0] "" Vector__XXX
 SG_ ODS_GST_Byte4 : 0|8@1+ (1,0) [0|0] "" Vector__XXX
 SG_ ODS_GST_Byte5 : 0|8@1+ (1,0) [0|0] "" Vector__XXX
 SG_ ODS_GST_Byte6 : 0|8@1+ (1,0) [0|0] "" Vector__XXX
 SG_ ODS_GST_Byte7 : 0|8@1+ (1,0) [0|0] "" Vector__XXX
 SG_ ODS_GST_Byte1 : 0|8@1+ (1,0) [0|0] "" Vector__XXX
 SG_ HU_Type : 0|8@1+ (1,0) [0|0] "" Vector__XXX
 SG_ HU_DistributeInfo : 0|8@1+ (1,0) [0|0] "" Vector__XXX
 SG_ HU_OptionInfo : 0|16@1+ (1,0) [0|0] "" Vector__XXX
 SG_ HU_CamViewDispStatus : 0|2@1+ (1,0) [0|0] "" Vector__XXX
 SG_ HU_AMP_EQVariant : 0|5@1+ (1,0) [0|0] "" Vector__XXX
 SG_ HU_AdasSupport : 0|3@1+ (1,0) [0|0] "" Vector__XXX
 SG_ ESC_Logger12_Byte0 : 0|8@1+ (1,0) [0|0] "" Vector__XXX
 SG_ ESC_Logger12_Byte2 : 0|8@1+ (1,0) [0|0] "" Vector__XXX
 SG_ ESC_Logger12_Byte3 : 0|8@1+ (1,0) [0|0] "" Vector__XXX
 SG_ ESC_Logger12_Byte4 : 0|8@1+ (1,0) [0|0] "" Vector__XXX
 SG_ ESC_Logger12_Byte5 : 0|8@1+ (1,0) [0|0] "" Vector__XXX
 SG_ ESC_Logger12_Byte6 : 0|8@1+ (1,0) [0|0] "" Vector__XXX
 SG_ ESC_Logger12_Byte7 : 0|8@1+ (1,0) [0|0] "" Vector__XXX
 SG_ ESC_Logger12_Byte1 : 0|8@1+ (1,0) [0|0] "" Vector__XXX
 SG_ ADAS_CMD_Crc20Val : 0|16@1+ (1,0) [0|0] "" Vector__XXX
 SG_ SCC_NSCCOpSta : 0|2@1+ (1,0) [0|0] "" Vector__XXX
 SG_ SCC_NSCCOnOffSta : 0|2@1+ (1,0) [0|0] "" Vector__XXX
 SG_ SCC_ObjSta : 0|3@1+ (1,0) [0|0] "" Vector__XXX
 SG_ SCC_SnstvtyModRetVal : 0|3@1+ (1,0) [0|0] "" Vector__XXX
 SG_ SCC_NSCCAutoSetSpdUpdtSta : 0|2@1+ (1,0) [0|0] "" Vector__XXX
 SG_ SCC_NSCCInfoPUDis : 0|3@1+ (1,0) [0|0] "" Vector__XXX
 SG_ SCC_AccelReqVal : 0|11@1+ (0.01,-10.23) [0|0] "m/s^2" Vector__XXX
 SG_ SCC_AccelReqRawVal : 0|11@1+ (0.01,-10.23) [0|0] "m/s^2" Vector__XXX
 SG_ SCC_JrkUppLimVal : 0|7@1+ (0.1,0) [0|0] "m/s^3" Vector__XXX
 SG_ ADAS_CMD_AlvCnt20Val : 0|8@1+ (1,0) [0|0] "" Vector__XXX
 SG_ SCC_JrkLwrLimVal : 0|7@1+ (0.1,0) [0|0] "m/s^3" Vector__XXX
 SG_ SCC_AccelLimBandUppVal : 0|6@1+ (0.02,0) [0|0] "m/s^2" Vector__XXX
 SG_ SCC_AccelLimBandLwrVal : 0|6@1+ (0.02,0) [0|0] "m/s^2" Vector__XXX
 SG_ SCC_VehStpReq : 0|2@1+ (1,0) [0|0] "" Vector__XXX
 SG_ SCC_DclModReq : 0|2@1+ (1,0) [0|0] "" Vector__XXX
 SG_ SCC_TrgtDstVal : 0|11@1+ (0.1,0) [0|0] "m" Vector__XXX
 SG_ SCC_ObjDstVal : 0|11@1+ (0.1,0) [0|0] "m" Vector__XXX
 SG_ SCC_ObjRelSpdVal : 0|12@1+ (0.1,-170) [0|0] "m/s" Vector__XXX
 SG_ SCC_ObjLatPosVal : 0|9@1+ (0.1,-20) [0|0] "m" Vector__XXX
 SG_ SCC_SysFlrSta : 0|2@1+ (1,0) [0|0] "" Vector__XXX
 SG_ SCC_MainOnOffSta : 0|2@1+ (1,0) [0|0] "" Vector__XXX
 SG_ SCC_OpSta : 0|3@1+ (1,0) [0|0] "" Vector__XXX
 SG_ SCC_TakeoverReq : 0|2@1+ (1,0) [0|0] "" Vector__XXX
 SG_ SCC_InfoDis : 0|3@1+ (1,0) [0|0] "" Vector__XXX
 SG_ SCC_DrvAlrtDis : 0|2@1+ (1,0) [0|0] "" Vector__XXX
 SG_ SCC_HeadwayDstSetVal : 0|4@1+ (1,0) [0|0] "" Vector__XXX
 SG_ SCC_NSCCAutoSetSpdSta : 0|2@1+ (1,0) [0|0] "" Vector__XXX
 SG_ SCC_TrgtSpdSetVal : 0|8@1+ (1,0) [0|0] "km/h or MPH" Vector__XXX
 SG_ ESC_Logger13_Byte0 : 0|8@1+ (1,0) [0|0] "" Vector__XXX
 SG_ ESC_Logger13_Byte2 : 0|8@1+ (1,0) [0|0] "" Vector__XXX
 SG_ ESC_Logger13_Byte3 : 0|8@1+ (1,0) [0|0] "" Vector__XXX
 SG_ ESC_Logger13_Byte4 : 0|8@1+ (1,0) [0|0] "" Vector__XXX
 SG_ ESC_Logger13_Byte5 : 0|8@1+ (1,0) [0|0] "" Vector__XXX
 SG_ ESC_Logger13_Byte6 : 0|8@1+ (1,0) [0|0] "" Vector__XXX
 SG_ ESC_Logger13_Byte7 : 0|8@1+ (1,0) [0|0] "" Vector__XXX
 SG_ ESC_Logger13_Byte1 : 0|8@1+ (1,0) [0|0] "" Vector__XXX
 SG_ ICSC_Crc1Val : 0|16@1+ (1,0) [0|0] "" Vector__XXX
 SG_ ICSC_BrkActvSta : 0|2@1+ (1,0) [0|0] "" Vector__XXX
 SG_ DAC_RwsOvrlayStrkReq : 0|16@1+ (0.01,-327.67) [0|0] "mm" Vector__XXX
 SG_ ICSC_AlvCnt1Val : 0|8@1+ (1,0) [0|0] "" Vector__XXX
 SG_ DAC_RwsActvSta : 0|2@1+ (1,0) [0|0] "" Vector__XXX
 SG_ DAC_RwsDfctvSta : 0|2@1+ (1,0) [0|0] "" Vector__XXX
 SG_ DAC_RwsCtrlMod : 0|3@1+ (1,0) [0|0] "" Vector__XXX
 SG_ DSDC_EcsFLNrmlCurrReq : 0|8@1+ (0.5,0) [0|0] "%" Vector__XXX
 SG_ DSDC_EcsFRNrmlCurrReq : 0|8@1+ (0.5,0) [0|0] "%" Vector__XXX
 SG_ DSDC_EcsRLNrmlCurrReq : 0|8@1+ (0.5,0) [0|0] "%" Vector__XXX
 SG_ DSDC_EcsRRNrmlCurrReq : 0|8@1+ (0.5,0) [0|0] "%" Vector__XXX
 SG_ DSDC_EcsActvSta : 0|2@1+ (1,0) [0|0] "" Vector__XXX
 SG_ DSDC_EcsDfctvSta : 0|2@1+ (1,0) [0|0] "" Vector__XXX
 SG_ DTVC_AwdTqReq : 0|16@1+ (1,0) [0|0] "Nm" Vector__XXX
 SG_ DTVC_AwdActvSta : 0|2@1+ (1,0) [0|0] "" Vector__XXX
 SG_ DTVC_AwdDfctvSta : 0|2@1+ (1,0) [0|0] "" Vector__XXX
 SG_ ESC_Logger14_Byte0 : 0|8@1+ (1,0) [0|0] "" Vector__XXX
 SG_ ESC_Logger14_Byte2 : 0|8@1+ (1,0) [0|0] "" Vector__XXX
 SG_ ESC_Logger14_Byte3 : 0|8@1+ (1,0) [0|0] "" Vector__XXX
 SG_ ESC_Logger14_Byte4 : 0|8@1+ (1,0) [0|0] "" Vector__XXX
 SG_ ESC_Logger14_Byte5 : 0|8@1+ (1,0) [0|0] "" Vector__XXX
 SG_ ESC_Logger14_Byte6 : 0|8@1+ (1,0) [0|0] "" Vector__XXX
 SG_ ESC_Logger14_Byte7 : 0|8@1+ (1,0) [0|0] "" Vector__XXX
 SG_ ESC_Logger14_Byte1 : 0|8@1+ (1,0) [0|0] "" Vector__XXX
 SG_ ESC_Logger15_Byte0 : 0|8@1+ (1,0) [0|0] "" Vector__XXX
 SG_ ESC_Logger15_Byte2 : 0|8@1+ (1,0) [0|0] "" Vector__XXX
 SG_ ESC_Logger15_Byte3 : 0|8@1+ (1,0) [0|0] "" Vector__XXX
 SG_ ESC_Logger15_Byte4 : 0|8@1+ (1,0) [0|0] "" Vector__XXX
 SG_ ESC_Logger15_Byte5 : 0|8@1+ (1,0) [0|0] "" Vector__XXX
 SG_ ESC_Logger15_Byte6 : 0|8@1+ (1,0) [0|0] "" Vector__XXX
 SG_ ESC_Logger15_Byte7 : 0|8@1+ (1,0) [0|0] "" Vector__XXX
 SG_ ESC_Logger15_Byte1 : 0|8@1+ (1,0) [0|0] "" Vector__XXX
 SG_ ESC_Logger16_Byte0 : 0|8@1+ (1,0) [0|0] "" Vector__XXX
 SG_ ESC_Logger16_Byte2 : 0|8@1+ (1,0) [0|0] "" Vector__XXX
 SG_ ESC_Logger16_Byte3 : 0|8@1+ (1,0) [0|0] "" Vector__XXX
 SG_ ESC_Logger16_Byte4 : 0|8@1+ (1,0) [0|0] "" Vector__XXX
 SG_ ESC_Logger16_Byte5 : 0|8@1+ (1,0) [0|0] "" Vector__XXX
 SG_ ESC_Logger16_Byte6 : 0|8@1+ (1,0) [0|0] "" Vector__XXX
 SG_ ESC_Logger16_Byte7 : 0|8@1+ (1,0) [0|0] "" Vector__XXX
 SG_ ESC_Logger16_Byte1 : 0|8@1+ (1,0) [0|0] "" Vector__XXX
 SG_ ESC_Logger17_Byte0 : 0|8@1+ (1,0) [0|0] "" Vector__XXX
 SG_ ESC_Logger17_Byte2 : 0|8@1+ (1,0) [0|0] "" Vector__XXX

CM_ SG_ 3221225472 RR_C_RDR_Crc02Val "R_C_RDR_CyclicRedundancyCheck02Value ##2G##BCW - BCA11 - Check_Sum";
CM_ SG_ 3221225472 Brake_Control_FL "Separated brkaing On/Off for Front-left wheel";
CM_ SG_ 3221225472 Brake_Control_FR "Separated brkaing On/Off for Front-right wheel";
CM_ SG_ 3221225472 Front_Target_Pressure "Target braking pressure for front wheels";
CM_ SG_ 3221225472 Brake_Control_RL "Separated brkaing On/Off for Rear-Left wheel";
CM_ SG_ 3221225472 Rear_Target_Pressure "Target braking pressure for rear wheels";
CM_ SG_ 3221225472 Brake_Control_RR "Separated brkaing On/Off for Rear-right wheel";
CM_ SG_ 3221225472 RR_C_RDR_AlvCnt02Val "RR_C_RDR_AliveCounter02Value ##2G##BCW - BCA11 - AliveCounter";
CM_ SG_ 3221225472 BCW_Sta "BCW_Status ##2G##BCW - BCW11 - CF_BCW_Stat";
CM_ SG_ 3221225472 BCW_OnOffEquipSta "BCW_OnOffEquipmentStatus ##2G##BCW - BCW12 - CF_BCW_USM";
CM_ SG_ 3221225472 BCW_LftIndSta "BCW_LeftIndicatorStatus ##2G##BCW - BCW11 - CF_BCW_IndLeft";
CM_ SG_ 3221225472 BCW_RtIndSta "BCW_RightIndicatorStatus ##2G##BCW - BCW11 - CF_BCW_IndRight";
CM_ SG_ 3221225472 BCW_LftSndWrngSta "BCW_LeftSoundWarningStatus ##2G##BCW - BCW11 - CF_FL_SndWan";
CM_ SG_ 3221225472 BCW_RtSndWrngSta "BCW_RightSoundWarningStatus ##2G##BCW - BCW11 - CF_FR_SndWan";
CM_ SG_ 3221225472 BCW_LftIndBriLvlVal "BCW_LeftIndicatorBrightnessLevelValue ##2G##BCW - BCW11 - CF_BCW_IndBriLeft";
CM_ SG_ 3221225472 BCW_RtIndBriLvlVal "BCW_RightIndicatorBrightnessLevelValue ##2G##BCW - BCW11 - CF_BCW_IndBriRight";
CM_ SG_ 3221225472 BCW_SnstvtyModRetVal "BCW_SensitivityModeReturnValue ##2G##BCW - BCW12 - CF_BCW_DrvSetState";
CM_ SG_ 3221225472 BCA_Sta "BCA_Status ##2G##BCW - BCA11 - CF_BCA_State";
CM_ SG_ 3221225472 BCA_OnOffEquipSta "BCA_OnOffEquipmentStatus ##2G##BCW - BCW12 - CF_BCA_USM";
CM_ SG_ 3221225472 BCA_R_Brake_Warning "BCA-R Warning Off/Left/Right";
CM_ SG_ 3221225472 BCA_Plus_Deccel_Req "BCA_Plus_Deccel_Requirement";
CM_ SG_ 3221225472 BCA_Plus_BrkCmdSta "BCA_Plus_BrakeCommandStatus";
CM_ SG_ 3221225472 BCA_Plus_LftWrngSta "BCA_Plus_LeftWarningStatus";
CM_ SG_ 3221225472 BCA_Plus_RtWrngSta "BCA_Plus_RightWarningStatus";
CM_ SG_ 3221225472 BCA_Plus_OnOffEquipSta "BCA_Plus_OnOffEquipmentStatus";
CM_ SG_ 3221225472 BCA_Plus_FuncStat "BCA_Plus_FunctionStatus";
CM_ SG_ 3221225472 BCA_Plus_Sta "BCA_Plus_Status";
CM_ SG_ 3221225472 CALSAS_Crc1Val "CALSAS_CyclicRedundancyCheck1Value";
CM_ SG_ 3221225472 CALSAS_AlvCnt1Val "CALSAS_AliveCounter1Value";
CM_ SG_ 3221225472 SAS_CmdCodWrdVal "SAS_CommandCodeWordValue ##2G##ESC - CAL_SAS11 - CCW";
CM_ SG_ 3221225472 SAS_CANIdVal "SAS_CANIdentifierValue ##2G##ESC - CAL_SAS11 - SAS_CID";
CM_ SG_ 3221225472 ECS_Crc4Val "ECS_CyclicRedundancyCheck4Value";
CM_ SG_ 3221225472 ECSIVSS_RdIndxVal "ECSIVSS_RoadIndexValue";
CM_ SG_ 3221225472 ECS_AlvCnt4Val "ECS_AliveCounter4Value";
CM_ SG_ 3221225472 ECSIVSS_FLWhlVrtclAccelSnsrVal "ECSIVSS_FrontLeftWheelVerticalAccelerationSensorValue";
CM_ SG_ 3221225472 ECSIVSS_FRWhlVrtclAccelSnsrVal "ECSIVSS_FrontRightWheelVerticalAccelerationSensorValue";
CM_ SG_ 3221225472 ECSIVSS_FLBodyAccelSnsrVal "ECSIVSS_FrontLeftBodyAccelerationSensorValue";
CM_ SG_ 3221225472 ECSIVSS_FRBodyAccelSnsrVal "ECSIVSS_FrontRightBodyAccelerationSensorValue";
CM_ SG_ 3221225472 ECSIVSS_RrBodyAccelSnsrVal "ECSIVSS_RearBodyAccelerationSensorValue";
CM_ SG_ 3221225472 HU_LanguageInfo "Information for System Language (for Display Font)";
CM_ SG_ 3221225472 HU_MuteStatus "Information for System Mute Display";
CM_ SG_ 3221225472 HU_WelcomeReady "HU playback ready signal to play welcome animation video";
CM_ SG_ 3221225472 HU_UsmSupport "Information whether HU can support USM or not";
CM_ SG_ 3221225472 HU_NaviStatus "Information for Navigation Status (Booting, Normal Operation, No SD card)
-AVN NAVI Transmission Signal";
CM_ SG_ 3221225472 HU_NaviDisp "Information for Navi Display status on Front Monitor";
CM_ SG_ 3221225472 HU_BVM_Display_Message "BVM Operation Message";
CM_ SG_ 3221225472 HU_SVM_View_Display "BVM View display to cluster";
CM_ SG_ 3221225472 HU_NaviCamSettingStatus "Information for Navi Camera alert setting status
+ Bit-coded field (On 1, Off 0)
   - bit 0 : Fixed Camera
   - bit 1 : Signal/Speed Violation Camera
   - bit 2 : Movable Camera
   - bit 3 : User Registration Fixed Camera
   - bit 4 : User Registration Signal/Speed Violation Camera
   - bit 5~6 : Reserved
-AVN NAVI Transmission Signal";
CM_ SG_ 3221225472 HU_VolumeStatus "Information for AVN Volume";
CM_ SG_ 3221225472 HU_TimeSetting "Information for current time setting";
CM_ SG_ 3221225472 HU_DisplayMinute "Information for time display in Minute unit";
CM_ SG_ 3221225472 HU_Status "Information for H/U status
Transmitted on H/U status changing";
CM_ SG_ 3221225472 HU_DisplaySecond "Information for time display in Second unit";
CM_ SG_ 3221225472 HU_DisplayMonth "Information for Month";
CM_ SG_ 3221225472 HU_DisplayYear1 "Information for Year (XXOO)
XX : HU_DisplayYear1
OO: HU_DisplayYear2";
CM_ SG_ 3221225472 HU_DisplayYear2 "Information for Year (XXOO)
XX : HU_DisplayYear1
OO: HU_DisplayYear2";
CM_ SG_ 3221225472 HU_DisplayDay "Information for Day";
CM_ SG_ 3221225472 HU_AM_PM_INFO "Information for AM/PM";
CM_ SG_ 3221225472 HU_ZeroDetection "Request zero detction to Analog Clock";
CM_ SG_ 3221225472 HU_TimeFormat "Information for time format
Digital CLOCK only";
CM_ SG_ 3221225472 HU_DisplayHour "Information for time display in Hour unit";
CM_ SG_ 3221225472 HU_Type "Information for H/U Platform type
- Integrated AVN 1.0 use different value depends on development company (Mobis:0x68/LG:0x70)
- Integrated AVN 1.0 Mobis is developed based on Display Audio
- Integrated AVN 1.0 LG is developed based on Compact AVN
Information for China OPIO Platform
- 0xFC: China OPIO w/o CLU interface (most of phase1)
- 0xFD: China OPIO w/CLU interface (parts of phase1, phase2)
Information for Audio Platform Type
- 0x43 : Audio 4.0 Value";
CM_ SG_ 3221225472 HU_DistributeInfo "Region :Europe/North America/
Vehicle Type : RHD/LHD
Positionning information";
CM_ SG_ 3221225472 HU_OptionInfo "Information of H/U functions";
CM_ SG_ 3221225472 HU_AMP_EQVariant "Set EQ Variant for various vehicle cases.
During the AMP initializing process, This signal should be sent before AMP unmute.
This signal is only needed for models that have variant EQ for vehicle types. (Hatchback, Wagon, Hybrid etc..)
Models that doesn��t have variant EQ for vehicle types shouldn��t have this signal.";
CM_ SG_ 3221225472 HU_AdasSupport "Information about ADAS support
-Classify between General Map and Precise Map Transmission Function
-AVN System Transmission Signal";
CM_ SG_ 3221225472 ADAS_CMD_Crc20Val "ADAS_CMD_CyclicRedundancyCheck20Value ##2G##SCC - SCC12 - CR_VSM_ChkSum";
CM_ SG_ 3221225472 SCC_NSCCOpSta "SCC_NSCCOperatingStatus ##2G##SCC - SCC11 - NSCC_Camera_Act";
CM_ SG_ 3221225472 SCC_NSCCOnOffSta "SCC_NSCCOnOffStatus ##2G##SCC - SCC13 - NSCC_Zone_USM";
CM_ SG_ 3221225472 SCC_ObjSta "SCC_ObjectState";
CM_ SG_ 3221225472 SCC_SnstvtyModRetVal "SCC_SensitivityModeReturnValue ##2G##SCC - SCC13 - SCCDrvModeRValue";
CM_ SG_ 3221225472 SCC_NSCCAutoSetSpdUpdtSta "SCC_NSCCAutoSetSpeedUpdateStatus ##2G##LDW_LKA - HDA11 - CF_HDA_AutoSetSpdUpdate";
CM_ SG_ 3221225472 SCC_NSCCInfoPUDis "SCC_NSCCInformationPopUpDisplay";
CM_ SG_ 3221225472 SCC_AccelReqVal "SCC_AccelerationRequestValue ##2G##SCC - SCC12 - aReqValue";
CM_ SG_ 3221225472 SCC_AccelReqRawVal "SCC_AccelerationRequestRawValue ##2G##SCC - SCC12 - aReqRaw";
CM_ SG_ 3221225472 SCC_JrkUppLimVal "SCC_JerkUpperLimitValue ##2G##SCC - SCC14 - JerkUpperLimit";
CM_ SG_ 3221225472 ADAS_CMD_AlvCnt20Val "ADAS_CMD_AliveCounter20Value ##2G##SCC - SCC12 - CR_VSM_Alive";
CM_ SG_ 3221225472 SCC_JrkLwrLimVal "SCC_JerkLowerLimitValue ##2G##SCC - SCC14 - JerkLowerLimit";
CM_ SG_ 3221225472 SCC_AccelLimBandUppVal "SCC_AccelerationLimitBandUpperValue ##2G##SCC - SCC14 - ComfortBandUpper";
CM_ SG_ 3221225472 SCC_AccelLimBandLwrVal "SCC_AccelerationLimitBandLowerValue ##2G##SCC - SCC14 - ComfortBandLower";
CM_ SG_ 3221225472 SCC_VehStpReq "SCC_VehicleStopRequest ##2G##SCC - SCC12 - StopReq";
CM_ SG_ 3221225472 SCC_DclModReq "SCC_DecelerationModeRequest";
CM_ SG_ 3221225472 SCC_TrgtDstVal "SCC_TargetDistanceValue";
CM_ SG_ 3221225472 SCC_ObjDstVal "SCC_ObjectDistanceValue ##2G##SCC - SCC11 - SCC_ObjDist";
CM_ SG_ 3221225472 SCC_ObjRelSpdVal "SCC_ObjectRelativeSpeedValue ##2G##SCC - SCC11 - SCC_ObjRelSpd";
CM_ SG_ 3221225472 SCC_ObjLatPosVal "SCC_ObjectLateralPositionValue ##2G##SCC - SCC11 - SCC_ObjLatPos";
CM_ SG_ 3221225472 SCC_SysFlrSta "SCC_SystemFailureStatus ##2G##SCC - SCC12 - SCCFailInfo";
CM_ SG_ 3221225472 SCC_MainOnOffSta "SCC_MainOnOffStatus ##2G##SCC - SCC11 - MainMode_SCC";
CM_ SG_ 3221225472 SCC_OpSta "SCC_OperatingStatus ##2G##SCC - SCC14 - SCCMode2";
CM_ SG_ 3221225472 SCC_TakeoverReq "SCC_TakeoverRequest ##2G##SCC - SCC12 - TakeOverReq";
CM_ SG_ 3221225472 SCC_InfoDis "SCC_InformationDisplay ##2G##SCC - SCC11 - SCCInfoDisplay";
CM_ SG_ 3221225472 SCC_DrvAlrtDis "SCC_DriverAlertDisplay ##2G##SCC - SCC11 - DriverAlertDisplay";
CM_ SG_ 3221225472 SCC_HeadwayDstSetVal "SCC_HeadwayDistanceSettingValue ##2G##SCC - SCC11 - TauGapSet";
CM_ SG_ 3221225472 SCC_NSCCAutoSetSpdSta "SCC_NSCCAutoSetSpeedStatus ##2G##LDW_LKA - HDA11 - CF_HDA_AutoSetSpdEnable";
CM_ SG_ 3221225472 SCC_TrgtSpdSetVal "SCC_TargetSpeedSettingValue ##2G##SCC - SCC11 - VSetDis";
CM_ SG_ 3221225472 ICSC_Crc1Val "ICSC_CyclicRedundancyCheck1Value";
CM_ SG_ 3221225472 ICSC_BrkActvSta "ICSC_BrakeActivationStatus";
CM_ SG_ 3221225472 DAC_RwsOvrlayStrkReq "DAC_RwsOverlayStrokeRequest";
CM_ SG_ 3221225472 ICSC_AlvCnt1Val "ICSC_AliveCounter1Value";
CM_ SG_ 3221225472 DAC_RwsActvSta "DAC_RwsActivationStatus";
CM_ SG_ 3221225472 DAC_RwsDfctvSta "DAC_RwsDefectiveStatus";
CM_ SG_ 3221225472 DAC_RwsCtrlMod "DAC_RwsControlMode";
CM_ SG_ 3221225472 DSDC_EcsFLNrmlCurrReq "DSDC_EcsFrontLeftNormalizedCurrentRequest ##2G##ICSC - IVSS_ECS11 - IVSS_ReqNmlCurrentFL";
CM_ SG_ 3221225472 DSDC_EcsFRNrmlCurrReq "DSDC_EcsFrontRightNormalizedCurrentRequest ##2G##ICSC - IVSS_ECS11 - IVSS_ReqNmlCurrentFR";
CM_ SG_ 3221225472 DSDC_EcsRLNrmlCurrReq "DSDC_EcsRearLeftNormalizedCurrentRequest ##2G##ICSC - IVSS_ECS11 - IVSS_ReqNmlCurrentRL";
CM_ SG_ 3221225472 DSDC_EcsRRNrmlCurrReq "DSDC_EcsRearRightNormalizedCurrentRequest ##2G##ICSC - IVSS_ECS11 - IVSS_ReqNmlCurrentRR";
CM_ SG_ 3221225472 DSDC_EcsActvSta "DSDC_EcsActivationStatus ##2G##ICSC - IVSS_ECS11 - IVSS_Act_Flg";
CM_ SG_ 3221225472 DSDC_EcsDfctvSta "DSDC_EcsDefectiveStatus ##2G##ICSC - IVSS_ECS11 - IVSS_Def";
CM_ SG_ 3221225472 DTVC_AwdTqReq "DTVC_AwdTorqueRequest ##2G##ICSC - IVSS_AWD11 - ICC_TQC_REQ";
CM_ SG_ 3221225472 DTVC_AwdActvSta "DTVC_AwdActivationStatus ##2G##ICSC - IVSS_AWD11 - ICC_ACT";
CM_ SG_ 3221225472 DTVC_AwdDfctvSta "DTVC_AwdDefectiveStatus ##2G##ICSC - IVSS_AWD11 - ICC_AWD_DEF";
BA_DEF_ BO_  "GenMsgEVName" STRING ;
BA_DEF_ BO_  "UsrMsgIDSforwardDeviation" INT 0 100;
BA_DEF_ BO_  "UsrMsgIDSbackwardDeviation" INT 50 1000;
BA_DEF_ BO_  "GenMsgCycleTime" INT 0 2000;
BA_DEF_ BO_  "GenMsgStartDelayTime" INT 0 2000;
BA_DEF_ BO_  "GenMsgSendType" ENUM  "Cyclic","NoMsgSendType";
BA_DEF_ BO_  "GenMsgCycleTimeFast" INT 0 500;
BA_DEF_ BO_  "GenMsgDelayTime" INT 0 20;
BA_DEF_ BO_  "GenMsgILSupport" ENUM  "No","Yes";
BA_DEF_ BO_  "GenMsgNrOfRepetition" INT 0 3;
BA_DEF_ BO_  "VFrameFormat" ENUM  "StandardCAN","ExtendedCAN","reserved","reserved","reserved","reserved","reserved","reserved","reserved","reserved","reserved","reserved","reserved","reserved","StandardCAN_FD","ExtendedCAN_FD";
BA_DEF_ SG_  "UserSigValidity" ENUM  "B+","ACC","IG","IG1","IG2","IG3","IG1 or IG2","IG1 or IG3","Undef";
BA_DEF_ SG_  "UsrSigPurpose" ENUM  "Undef","FN","DIAG","DIAG(Req)","DIAG(Res)","DIAG(Phy)","DEV","CCP(Req)","CCP(Res)","NM","TP";
BA_DEF_ SG_  "GenSigStartValue" INT 0 1215752192;
BA_DEF_ SG_  "NetworkRequest" ENUM  "Yes","No";
BA_DEF_ SG_  "NetworkRequestHoldingTime" INT 0 65535;
BA_DEF_ SG_  "Description" STRING ;
BA_DEF_ SG_  "Version" STRING ;
BA_DEF_ SG_  "GenSigEnvVarType" ENUM  "Int","Float","Undef";
BA_DEF_ SG_  "GenSigSendType" ENUM  "Cyclic","OnWrite","OnWriteWithRepetition","OnChange","OnChangeWithRepetition","IfActive","IfActiveWithRepetition","NoSigSendType","OnChangeAndIfActive","OnChangeAndIfActiveWithRepetition";
BA_DEF_ SG_  "GwSigLatencyTime" INT 0 65536;
BA_DEF_ SG_  "GwSigMissingSourceType" ENUM  "Undef","OldValue","DefaultValue","InitialValue";
BA_DEF_ SG_  "NWM-WakeupAllowed" ENUM  "<n.a.>";
BA_DEF_ SG_  "RoutingFactor" INT 1 1215752192;
BA_DEF_REL_ BU_SG_REL_  "GenSigTimeoutTime" INT 0 7000;
BA_DEF_DEF_  "GenMsgEVName" "@Signame";
BA_DEF_DEF_  "UsrMsgIDSforwardDeviation" 10;
BA_DEF_DEF_  "UsrMsgIDSbackwardDeviation" 100;
BA_DEF_DEF_  "GenMsgCycleTime" 200;
BA_DEF_DEF_  "GenMsgStartDelayTime" 0;
BA_DEF_DEF_  "GenMsgSendType" "NoMsgSendType";
BA_DEF_DEF_  "GenMsgCycleTimeFast" 40;
BA_DEF_DEF_  "GenMsgDelayTime" 20;
BA_DEF_DEF_  "GenMsgILSupport" "Yes";
BA_DEF_DEF_  "GenMsgNrOfRepetition" 3;
BA_DEF_DEF_  "VFrameFormat" "StandardCAN";
BA_DEF_DEF_  "UserSigValidity" "IG";
BA_DEF_DEF_  "UsrSigPurpose" "FN";
BA_DEF_DEF_  "GenSigStartValue" 0;
BA_DEF_DEF_  "NetworkRequest" "No";
BA_DEF_DEF_  "NetworkRequestHoldingTime" 0;
BA_DEF_DEF_  "Description" "";
BA_DEF_DEF_  "Version" "";
BA_DEF_DEF_  "GenSigEnvVarType" "Undef";
BA_DEF_DEF_  "GenSigSendType" "NoSigSendType";
BA_DEF_DEF_  "GwSigLatencyTime" 40;
BA_DEF_DEF_  "GwSigMissingSourceType" "Undef";
BA_DEF_DEF_  "NWM-WakeupAllowed" "<n.a.>";
BA_DEF_DEF_  "RoutingFactor" 1;
BA_DEF_DEF_REL_ "GenSigTimeoutTime" 500;
BA_ "Version" SG_ 3221225472 RR_C_RDR_Crc02Val "18.12.08";
BA_ "RoutingFactor" SG_ 3221225472 RR_C_RDR_Crc02Val 3;
BA_ "UserSigValidity" SG_ 3221225472 RR_C_RDR_Crc02Val 3;
BA_ "GenSigStartValue" SG_ 3221225472 RR_C_RDR_Crc02Val 65535;
BA_ "Description" SG_ 3221225472 RR_C_RDR_Crc02Val "The data area for CRC calculation is based on the data length (DLC) of the message DB.

The CRC shall be calculated over the entire data block (excluding the CRC bytes) including the user data, alive counter and Data ID

 

- CRC Polynomial (0x1021) , In";
BA_ "Version" SG_ 3221225472 Brake_Control_FL "18.12.01";
BA_ "RoutingFactor" SG_ 3221225472 Brake_Control_FL 3;
BA_ "UserSigValidity" SG_ 3221225472 Brake_Control_FL 3;
BA_ "Description" SG_ 3221225472 Brake_Control_FL "This signal infrom ESC whether to control FL wheel or not";
BA_ "Version" SG_ 3221225472 Brake_Control_FR "18.12.01";
BA_ "RoutingFactor" SG_ 3221225472 Brake_Control_FR 3;
BA_ "UserSigValidity" SG_ 3221225472 Brake_Control_FR 3;
BA_ "Description" SG_ 3221225472 Brake_Control_FR "This signal infrom ESC whether to control FR wheel or not";
BA_ "Version" SG_ 3221225472 Front_Target_Pressure "18.12.01";
BA_ "RoutingFactor" SG_ 3221225472 Front_Target_Pressure 3;
BA_ "UserSigValidity" SG_ 3221225472 Front_Target_Pressure 3;
BA_ "Description" SG_ 3221225472 Front_Target_Pressure "This signal indicates Front_Target_Pressure";
BA_ "Version" SG_ 3221225472 Brake_Control_RL "18.12.01";
BA_ "RoutingFactor" SG_ 3221225472 Brake_Control_RL 3;
BA_ "UserSigValidity" SG_ 3221225472 Brake_Control_RL 3;
BA_ "Description" SG_ 3221225472 Brake_Control_RL "This signal infrom ESC whether to control RL wheel or not";
BA_ "Version" SG_ 3221225472 Rear_Target_Pressure "18.12.01";
BA_ "RoutingFactor" SG_ 3221225472 Rear_Target_Pressure 3;
BA_ "UserSigValidity" SG_ 3221225472 Rear_Target_Pressure 3;
BA_ "Description" SG_ 3221225472 Rear_Target_Pressure "This signal indicates Rear_Target_Pressure";
BA_ "Version" SG_ 3221225472 Brake_Control_RR "18.12.01";
BA_ "RoutingFactor" SG_ 3221225472 Brake_Control_RR 3;
BA_ "UserSigValidity" SG_ 3221225472 Brake_Control_RR 3;
BA_ "Description" SG_ 3221225472 Brake_Control_RR "This signal infrom ESC whether to control RR wheel or not";
BA_ "Version" SG_ 3221225472 RR_C_RDR_AlvCnt02Val "18.12.08";
BA_ "RoutingFactor" SG_ 3221225472 RR_C_RDR_AlvCnt02Val 3;
BA_ "UserSigValidity" SG_ 3221225472 RR_C_RDR_AlvCnt02Val 3;
BA_ "Description" SG_ 3221225472 RR_C_RDR_AlvCnt02Val "For the first transmission request for a data element the counter shall be initialized with 0 and shall be incremented by 1 for every subsequent send request. 

When the counter reaches the maximum value(0xFF), then it shall restart with 0 for the next s";
BA_ "Version" SG_ 3221225472 BCW_Sta "18.12.01";
BA_ "RoutingFactor" SG_ 3221225472 BCW_Sta 3;
BA_ "UserSigValidity" SG_ 3221225472 BCW_Sta 3;
BA_ "Description" SG_ 3221225472 BCW_Sta "This signal indicates the status of BCW";
BA_ "Version" SG_ 3221225472 BCW_OnOffEquipSta "18.12.01";
BA_ "RoutingFactor" SG_ 3221225472 BCW_OnOffEquipSta 3;
BA_ "UserSigValidity" SG_ 3221225472 BCW_OnOffEquipSta 3;
BA_ "Description" SG_ 3221225472 BCW_OnOffEquipSta "This signal indicates the on/off status of BCW";
BA_ "Version" SG_ 3221225472 BCW_LftIndSta "18.12.01";
BA_ "RoutingFactor" SG_ 3221225472 BCW_LftIndSta 3;
BA_ "UserSigValidity" SG_ 3221225472 BCW_LftIndSta 3;
BA_ "Description" SG_ 3221225472 BCW_LftIndSta "This signal Indicates BCW Warning Indicator mode for Left side";
BA_ "Version" SG_ 3221225472 BCW_RtIndSta "18.12.01";
BA_ "RoutingFactor" SG_ 3221225472 BCW_RtIndSta 3;
BA_ "UserSigValidity" SG_ 3221225472 BCW_RtIndSta 3;
BA_ "Description" SG_ 3221225472 BCW_RtIndSta "This signal Indicates BCW Warning Indicator mode for Right side";
BA_ "Version" SG_ 3221225472 BCW_LftSndWrngSta "18.12.01";
BA_ "RoutingFactor" SG_ 3221225472 BCW_LftSndWrngSta 3;
BA_ "UserSigValidity" SG_ 3221225472 BCW_LftSndWrngSta 3;
BA_ "Description" SG_ 3221225472 BCW_LftSndWrngSta "This signal indicates BCW Sound Warning for Front Left Speaker";
BA_ "Version" SG_ 3221225472 BCW_RtSndWrngSta "18.12.01";
BA_ "RoutingFactor" SG_ 3221225472 BCW_RtSndWrngSta 3;
BA_ "UserSigValidity" SG_ 3221225472 BCW_RtSndWrngSta 3;
BA_ "Description" SG_ 3221225472 BCW_RtSndWrngSta "This signal indicates BCW Sound Warning for Front Right Speaker";
BA_ "Version" SG_ 3221225472 BCW_LftIndBriLvlVal "18.12.01";
BA_ "RoutingFactor" SG_ 3221225472 BCW_LftIndBriLvlVal 3;
BA_ "UserSigValidity" SG_ 3221225472 BCW_LftIndBriLvlVal 3;
BA_ "Description" SG_ 3221225472 BCW_LftIndBriLvlVal "0x00~FF : Indicator Brightness level of BCW";
BA_ "Version" SG_ 3221225472 BCW_RtIndBriLvlVal "18.12.01";
BA_ "RoutingFactor" SG_ 3221225472 BCW_RtIndBriLvlVal 3;
BA_ "UserSigValidity" SG_ 3221225472 BCW_RtIndBriLvlVal 3;
BA_ "Description" SG_ 3221225472 BCW_RtIndBriLvlVal "0x00~FF : Indicator Brightness level of BCW";
BA_ "Version" SG_ 3221225472 BCW_SnstvtyModRetVal "18.12.01";
BA_ "RoutingFactor" SG_ 3221225472 BCW_SnstvtyModRetVal 3;
BA_ "UserSigValidity" SG_ 3221225472 BCW_SnstvtyModRetVal 3;
BA_ "Description" SG_ 3221225472 BCW_SnstvtyModRetVal "This signal indicates the selected sensitive mode of BCW warning";
BA_ "Version" SG_ 3221225472 BCW_IndSta "18.12.01";
BA_ "RoutingFactor" SG_ 3221225472 BCW_IndSta 3;
BA_ "UserSigValidity" SG_ 3221225472 BCW_IndSta 3;
BA_ "Description" SG_ 3221225472 BCW_IndSta "OS Mirror Indicator Failure";
BA_ "Version" SG_ 3221225472 BCA_Sta "18.12.01";
BA_ "RoutingFactor" SG_ 3221225472 BCA_Sta 3;
BA_ "UserSigValidity" SG_ 3221225472 BCA_Sta 3;
BA_ "Description" SG_ 3221225472 BCA_Sta "This signal indicates the status of BCA";
BA_ "Version" SG_ 3221225472 BCA_OnOffEquipSta "18.12.01";
BA_ "RoutingFactor" SG_ 3221225472 BCA_OnOffEquipSta 3;
BA_ "UserSigValidity" SG_ 3221225472 BCA_OnOffEquipSta 3;
BA_ "Description" SG_ 3221225472 BCA_OnOffEquipSta "This signal indicates the on/off status of BCA";
BA_ "Version" SG_ 3221225472 BCA_R_Brake_Warning "18.12.01";
BA_ "RoutingFactor" SG_ 3221225472 BCA_R_Brake_Warning 3;
BA_ "UserSigValidity" SG_ 3221225472 BCA_R_Brake_Warning 3;
BA_ "Description" SG_ 3221225472 BCA_R_Brake_Warning "This signal indicate the warning status for BCA-R with Differential Brake";
BA_ "Version" SG_ 3221225472 BCA_Plus_Deccel_Req "18.12.01";
BA_ "RoutingFactor" SG_ 3221225472 BCA_Plus_Deccel_Req 3;
BA_ "UserSigValidity" SG_ 3221225472 BCA_Plus_Deccel_Req 3;
BA_ "Description" SG_ 3221225472 BCA_Plus_Deccel_Req "This value is defined the time to stop the vehicle.





(PH) = 0.04 * (Hex)g";
BA_ "Version" SG_ 3221225472 BCA_Plus_BrkCmdSta "18.12.01";
BA_ "RoutingFactor" SG_ 3221225472 BCA_Plus_BrkCmdSta 3;
BA_ "UserSigValidity" SG_ 3221225472 BCA_Plus_BrkCmdSta 3;
BA_ "Description" SG_ 3221225472 BCA_Plus_BrkCmdSta "BCA_Plus Function Brake Command";
BA_ "Version" SG_ 3221225472 BCA_Plus_LftWrngSta "18.12.06";
BA_ "RoutingFactor" SG_ 3221225472 BCA_Plus_LftWrngSta 3;
BA_ "UserSigValidity" SG_ 3221225472 BCA_Plus_LftWrngSta 3;
BA_ "Description" SG_ 3221225472 BCA_Plus_LftWrngSta "This signal Indicates BCA_Plus Warning state for HMI(Cluster)";
BA_ "Version" SG_ 3221225472 BCA_Plus_RtWrngSta "18.12.06";
BA_ "RoutingFactor" SG_ 3221225472 BCA_Plus_RtWrngSta 3;
BA_ "UserSigValidity" SG_ 3221225472 BCA_Plus_RtWrngSta 3;
BA_ "Description" SG_ 3221225472 BCA_Plus_RtWrngSta "This signal Indicates BCA_Plus Warning state for HMI";
BA_ "Version" SG_ 3221225472 BCA_Plus_OnOffEquipSta "18.12.01";
BA_ "RoutingFactor" SG_ 3221225472 BCA_Plus_OnOffEquipSta 3;
BA_ "UserSigValidity" SG_ 3221225472 BCA_Plus_OnOffEquipSta 3;
BA_ "Description" SG_ 3221225472 BCA_Plus_OnOffEquipSta "BCA_Plus state";
BA_ "Version" SG_ 3221225472 BCA_Plus_FuncStat "18.12.01";
BA_ "RoutingFactor" SG_ 3221225472 BCA_Plus_FuncStat 3;
BA_ "UserSigValidity" SG_ 3221225472 BCA_Plus_FuncStat 3;
BA_ "Description" SG_ 3221225472 BCA_Plus_FuncStat "ESC state";
BA_ "Version" SG_ 3221225472 BCA_Plus_Sta "18.12.01";
BA_ "RoutingFactor" SG_ 3221225472 BCA_Plus_Sta 3;
BA_ "UserSigValidity" SG_ 3221225472 BCA_Plus_Sta 3;
BA_ "Description" SG_ 3221225472 BCA_Plus_Sta "This signal indicates the status of BCA Plus";
BA_ "Version" SG_ 3221225472 GST_ESC_Byte0 "18.01.08";
BA_ "NetworkRequestHoldingTime" SG_ 3221225472 GST_ESC_Byte0 5000;
BA_ "NetworkRequest" SG_ 3221225472 GST_ESC_Byte0 0;
BA_ "UserSigValidity" SG_ 3221225472 GST_ESC_Byte0 0;
BA_ "GenSigSendType" SG_ 3221225472 GST_ESC_Byte0 2;
BA_ "UsrSigPurpose" SG_ 3221225472 GST_ESC_Byte0 2;
BA_ "Version" SG_ 3221225472 GST_ESC_Byte2 "18.01.08";
BA_ "NetworkRequestHoldingTime" SG_ 3221225472 GST_ESC_Byte2 5000;
BA_ "NetworkRequest" SG_ 3221225472 GST_ESC_Byte2 0;
BA_ "UserSigValidity" SG_ 3221225472 GST_ESC_Byte2 0;
BA_ "GenSigSendType" SG_ 3221225472 GST_ESC_Byte2 2;
BA_ "UsrSigPurpose" SG_ 3221225472 GST_ESC_Byte2 2;
BA_ "Version" SG_ 3221225472 GST_ESC_Byte3 "18.01.08";
BA_ "NetworkRequestHoldingTime" SG_ 3221225472 GST_ESC_Byte3 5000;
BA_ "NetworkRequest" SG_ 3221225472 GST_ESC_Byte3 0;
BA_ "UserSigValidity" SG_ 3221225472 GST_ESC_Byte3 0;
BA_ "GenSigSendType" SG_ 3221225472 GST_ESC_Byte3 2;
BA_ "UsrSigPurpose" SG_ 3221225472 GST_ESC_Byte3 2;
BA_ "Version" SG_ 3221225472 GST_ESC_Byte4 "18.01.08";
BA_ "NetworkRequestHoldingTime" SG_ 3221225472 GST_ESC_Byte4 5000;
BA_ "NetworkRequest" SG_ 3221225472 GST_ESC_Byte4 0;
BA_ "UserSigValidity" SG_ 3221225472 GST_ESC_Byte4 0;
BA_ "GenSigSendType" SG_ 3221225472 GST_ESC_Byte4 2;
BA_ "UsrSigPurpose" SG_ 3221225472 GST_ESC_Byte4 2;
BA_ "Version" SG_ 3221225472 GST_ESC_Byte5 "18.01.08";
BA_ "NetworkRequestHoldingTime" SG_ 3221225472 GST_ESC_Byte5 5000;
BA_ "NetworkRequest" SG_ 3221225472 GST_ESC_Byte5 0;
BA_ "UserSigValidity" SG_ 3221225472 GST_ESC_Byte5 0;
BA_ "GenSigSendType" SG_ 3221225472 GST_ESC_Byte5 2;
BA_ "UsrSigPurpose" SG_ 3221225472 GST_ESC_Byte5 2;
BA_ "Version" SG_ 3221225472 GST_ESC_Byte6 "18.01.08";
BA_ "NetworkRequestHoldingTime" SG_ 3221225472 GST_ESC_Byte6 5000;
BA_ "NetworkRequest" SG_ 3221225472 GST_ESC_Byte6 0;
BA_ "UserSigValidity" SG_ 3221225472 GST_ESC_Byte6 0;
BA_ "GenSigSendType" SG_ 3221225472 GST_ESC_Byte6 2;
BA_ "UsrSigPurpose" SG_ 3221225472 GST_ESC_Byte6 2;
BA_ "Version" SG_ 3221225472 GST_ESC_Byte7 "18.01.08";
BA_ "NetworkRequestHoldingTime" SG_ 3221225472 GST_ESC_Byte7 5000;
BA_ "NetworkRequest" SG_ 3221225472 GST_ESC_Byte7 0;
BA_ "UserSigValidity" SG_ 3221225472 GST_ESC_Byte7 0;
BA_ "GenSigSendType" SG_ 3221225472 GST_ESC_Byte7 2;
BA_ "UsrSigPurpose" SG_ 3221225472 GST_ESC_Byte7 2;
BA_ "Version" SG_ 3221225472 GST_ESC_Byte1 "18.01.08";
BA_ "NetworkRequestHoldingTime" SG_ 3221225472 GST_ESC_Byte1 5000;
BA_ "NetworkRequest" SG_ 3221225472 GST_ESC_Byte1 0;
BA_ "UserSigValidity" SG_ 3221225472 GST_ESC_Byte1 0;
BA_ "GenSigSendType" SG_ 3221225472 GST_ESC_Byte1 2;
BA_ "UsrSigPurpose" SG_ 3221225472 GST_ESC_Byte1 2;
BA_ "Version" SG_ 3221225472 GST_MDPS_Byte0 "18.01.08";
BA_ "NetworkRequestHoldingTime" SG_ 3221225472 GST_MDPS_Byte0 5000;
BA_ "NetworkRequest" SG_ 3221225472 GST_MDPS_Byte0 0;
BA_ "UserSigValidity" SG_ 3221225472 GST_MDPS_Byte0 0;
BA_ "GenSigSendType" SG_ 3221225472 GST_MDPS_Byte0 2;
BA_ "UsrSigPurpose" SG_ 3221225472 GST_MDPS_Byte0 2;
BA_ "Version" SG_ 3221225472 GST_MDPS_Byte2 "18.01.08";
BA_ "NetworkRequestHoldingTime" SG_ 3221225472 GST_MDPS_Byte2 5000;
BA_ "NetworkRequest" SG_ 3221225472 GST_MDPS_Byte2 0;
BA_ "UserSigValidity" SG_ 3221225472 GST_MDPS_Byte2 0;
BA_ "GenSigSendType" SG_ 3221225472 GST_MDPS_Byte2 2;
BA_ "UsrSigPurpose" SG_ 3221225472 GST_MDPS_Byte2 2;
BA_ "Version" SG_ 3221225472 GST_MDPS_Byte3 "18.01.08";
BA_ "NetworkRequestHoldingTime" SG_ 3221225472 GST_MDPS_Byte3 5000;
BA_ "NetworkRequest" SG_ 3221225472 GST_MDPS_Byte3 0;
BA_ "UserSigValidity" SG_ 3221225472 GST_MDPS_Byte3 0;
BA_ "GenSigSendType" SG_ 3221225472 GST_MDPS_Byte3 2;
BA_ "UsrSigPurpose" SG_ 3221225472 GST_MDPS_Byte3 2;
BA_ "Version" SG_ 3221225472 GST_MDPS_Byte4 "18.01.08";
BA_ "NetworkRequestHoldingTime" SG_ 3221225472 GST_MDPS_Byte4 5000;
BA_ "NetworkRequest" SG_ 3221225472 GST_MDPS_Byte4 0;
BA_ "UserSigValidity" SG_ 3221225472 GST_MDPS_Byte4 0;
BA_ "GenSigSendType" SG_ 3221225472 GST_MDPS_Byte4 2;
BA_ "UsrSigPurpose" SG_ 3221225472 GST_MDPS_Byte4 2;
BA_ "Version" SG_ 3221225472 GST_MDPS_Byte5 "18.01.08";
BA_ "NetworkRequestHoldingTime" SG_ 3221225472 GST_MDPS_Byte5 5000;
BA_ "NetworkRequest" SG_ 3221225472 GST_MDPS_Byte5 0;
BA_ "UserSigValidity" SG_ 3221225472 GST_MDPS_Byte5 0;
BA_ "GenSigSendType" SG_ 3221225472 GST_MDPS_Byte5 2;
BA_ "UsrSigPurpose" SG_ 3221225472 GST_MDPS_Byte5 2;
BA_ "Version" SG_ 3221225472 GST_MDPS_Byte6 "18.01.08";
BA_ "NetworkRequestHoldingTime" SG_ 3221225472 GST_MDPS_Byte6 5000;
BA_ "NetworkRequest" SG_ 3221225472 GST_MDPS_Byte6 0;
BA_ "UserSigValidity" SG_ 3221225472 GST_MDPS_Byte6 0;
BA_ "GenSigSendType" SG_ 3221225472 GST_MDPS_Byte6 2;
BA_ "UsrSigPurpose" SG_ 3221225472 GST_MDPS_Byte6 2;
BA_ "Version" SG_ 3221225472 GST_MDPS_Byte7 "18.01.08";
BA_ "NetworkRequestHoldingTime" SG_ 3221225472 GST_MDPS_Byte7 5000;
BA_ "NetworkRequest" SG_ 3221225472 GST_MDPS_Byte7 0;
BA_ "UserSigValidity" SG_ 3221225472 GST_MDPS_Byte7 0;
BA_ "GenSigSendType" SG_ 3221225472 GST_MDPS_Byte7 2;
BA_ "UsrSigPurpose" SG_ 3221225472 GST_MDPS_Byte7 2;
BA_ "Version" SG_ 3221225472 GST_MDPS_Byte1 "18.01.08";
BA_ "NetworkRequestHoldingTime" SG_ 3221225472 GST_MDPS_Byte1 5000;
BA_ "NetworkRequest" SG_ 3221225472 GST_MDPS_Byte1 0;
BA_ "UserSigValidity" SG_ 3221225472 GST_MDPS_Byte1 0;
BA_ "GenSigSendType" SG_ 3221225472 GST_MDPS_Byte1 2;
BA_ "UsrSigPurpose" SG_ 3221225472 GST_MDPS_Byte1 2;
BA_ "Version" SG_ 3221225472 CALSAS_Crc1Val "18.11.08";
BA_ "UserSigValidity" SG_ 3221225472 CALSAS_Crc1Val 3;
BA_ "GenSigStartValue" SG_ 3221225472 CALSAS_Crc1Val 65535;
BA_ "GenSigSendType" SG_ 3221225472 CALSAS_Crc1Val 4;
BA_ "Description" SG_ 3221225472 CALSAS_Crc1Val "The data area for CRC calculation is based on the data length (DLC) of the message DB.

The CRC shall be calculated over the entire data block (excluding the CRC bytes) including the user data, alive counter and Data ID

 

- CRC Polynomial (0x1021) , In";
BA_ "Version" SG_ 3221225472 CALSAS_AlvCnt1Val "18.11.08";
BA_ "UserSigValidity" SG_ 3221225472 CALSAS_AlvCnt1Val 3;
BA_ "GenSigSendType" SG_ 3221225472 CALSAS_AlvCnt1Val 4;
BA_ "Description" SG_ 3221225472 CALSAS_AlvCnt1Val "For the first transmission request for a data element the counter shall be initialized with 0 and shall be incremented by 1 for every subsequent send request. 

When the counter reaches the maximum value(0xFF), then it shall restart with 0 for the next s";
BA_ "Version" SG_ 3221225472 SAS_CmdCodWrdVal "17.12.00";
BA_ "UserSigValidity" SG_ 3221225472 SAS_CmdCodWrdVal 3;
BA_ "GenSigSendType" SG_ 3221225472 SAS_CmdCodWrdVal 4;
BA_ "Description" SG_ 3221225472 SAS_CmdCodWrdVal "Command information regarding the steering angle sensor��s calibration/de-calibration

If the SAS_CAL(SAS1) flag is not set (=0) the calibration message will be accepted without preceding de-calibration procedure. 

If the SAS_CAL flag is set (=1) it is ";
BA_ "Version" SG_ 3221225472 SAS_CANIdVal "17.12.00";
BA_ "UserSigValidity" SG_ 3221225472 SAS_CANIdVal 3;
BA_ "GenSigStartValue" SG_ 3221225472 SAS_CANIdVal 688;
BA_ "GenSigSendType" SG_ 3221225472 SAS_CANIdVal 4;
BA_ "Description" SG_ 3221225472 SAS_CANIdVal "This signal indicates SAS1-CAN transmit identifier";
BA_ "Version" SG_ 3221225472 GST_EPB_Byte0 "18.01.08";
BA_ "NetworkRequestHoldingTime" SG_ 3221225472 GST_EPB_Byte0 5000;
BA_ "NetworkRequest" SG_ 3221225472 GST_EPB_Byte0 0;
BA_ "UserSigValidity" SG_ 3221225472 GST_EPB_Byte0 0;
BA_ "GenSigSendType" SG_ 3221225472 GST_EPB_Byte0 2;
BA_ "UsrSigPurpose" SG_ 3221225472 GST_EPB_Byte0 2;
BA_ "Version" SG_ 3221225472 GST_EPB_Byte2 "18.01.08";
BA_ "NetworkRequestHoldingTime" SG_ 3221225472 GST_EPB_Byte2 5000;
BA_ "NetworkRequest" SG_ 3221225472 GST_EPB_Byte2 0;
BA_ "UserSigValidity" SG_ 3221225472 GST_EPB_Byte2 0;
BA_ "GenSigSendType" SG_ 3221225472 GST_EPB_Byte2 2;
BA_ "UsrSigPurpose" SG_ 3221225472 GST_EPB_Byte2 2;
BA_ "Version" SG_ 3221225472 GST_EPB_Byte3 "18.01.08";
BA_ "NetworkRequestHoldingTime" SG_ 3221225472 GST_EPB_Byte3 5000;
BA_ "NetworkRequest" SG_ 3221225472 GST_EPB_Byte3 0;
BA_ "UserSigValidity" SG_ 3221225472 GST_EPB_Byte3 0;
BA_ "GenSigSendType" SG_ 3221225472 GST_EPB_Byte3 2;
BA_ "UsrSigPurpose" SG_ 3221225472 GST_EPB_Byte3 2;
BA_ "Version" SG_ 3221225472 GST_EPB_Byte4 "18.01.08";
BA_ "NetworkRequestHoldingTime" SG_ 3221225472 GST_EPB_Byte4 5000;
BA_ "NetworkRequest" SG_ 3221225472 GST_EPB_Byte4 0;
BA_ "UserSigValidity" SG_ 3221225472 GST_EPB_Byte4 0;
BA_ "GenSigSendType" SG_ 3221225472 GST_EPB_Byte4 2;
BA_ "UsrSigPurpose" SG_ 3221225472 GST_EPB_Byte4 2;
BA_ "Version" SG_ 3221225472 GST_EPB_Byte5 "18.01.08";
BA_ "NetworkRequestHoldingTime" SG_ 3221225472 GST_EPB_Byte5 5000;
BA_ "NetworkRequest" SG_ 3221225472 GST_EPB_Byte5 0;
BA_ "UserSigValidity" SG_ 3221225472 GST_EPB_Byte5 0;
BA_ "GenSigSendType" SG_ 3221225472 GST_EPB_Byte5 2;
BA_ "UsrSigPurpose" SG_ 3221225472 GST_EPB_Byte5 2;
BA_ "Version" SG_ 3221225472 GST_EPB_Byte6 "18.01.08";
BA_ "NetworkRequestHoldingTime" SG_ 3221225472 GST_EPB_Byte6 5000;
BA_ "NetworkRequest" SG_ 3221225472 GST_EPB_Byte6 0;
BA_ "UserSigValidity" SG_ 3221225472 GST_EPB_Byte6 0;
BA_ "GenSigSendType" SG_ 3221225472 GST_EPB_Byte6 2;
BA_ "UsrSigPurpose" SG_ 3221225472 GST_EPB_Byte6 2;
BA_ "Version" SG_ 3221225472 GST_EPB_Byte7 "18.01.08";
BA_ "NetworkRequestHoldingTime" SG_ 3221225472 GST_EPB_Byte7 5000;
BA_ "NetworkRequest" SG_ 3221225472 GST_EPB_Byte7 0;
BA_ "UserSigValidity" SG_ 3221225472 GST_EPB_Byte7 0;
BA_ "GenSigSendType" SG_ 3221225472 GST_EPB_Byte7 2;
BA_ "UsrSigPurpose" SG_ 3221225472 GST_EPB_Byte7 2;
BA_ "Version" SG_ 3221225472 GST_EPB_Byte1 "18.01.08";
BA_ "NetworkRequestHoldingTime" SG_ 3221225472 GST_EPB_Byte1 5000;
BA_ "NetworkRequest" SG_ 3221225472 GST_EPB_Byte1 0;
BA_ "UserSigValidity" SG_ 3221225472 GST_EPB_Byte1 0;
BA_ "GenSigSendType" SG_ 3221225472 GST_EPB_Byte1 2;
BA_ "UsrSigPurpose" SG_ 3221225472 GST_EPB_Byte1 2;
BA_ "Version" SG_ 3221225472 ECS_GST_Byte0 "18.01.08";
BA_ "NetworkRequestHoldingTime" SG_ 3221225472 ECS_GST_Byte0 5000;
BA_ "NetworkRequest" SG_ 3221225472 ECS_GST_Byte0 0;
BA_ "UserSigValidity" SG_ 3221225472 ECS_GST_Byte0 0;
BA_ "GenSigSendType" SG_ 3221225472 ECS_GST_Byte0 2;
BA_ "UsrSigPurpose" SG_ 3221225472 ECS_GST_Byte0 2;
BA_ "Version" SG_ 3221225472 ECS_GST_Byte2 "18.01.08";
BA_ "NetworkRequestHoldingTime" SG_ 3221225472 ECS_GST_Byte2 5000;
BA_ "NetworkRequest" SG_ 3221225472 ECS_GST_Byte2 0;
BA_ "UserSigValidity" SG_ 3221225472 ECS_GST_Byte2 0;
BA_ "GenSigSendType" SG_ 3221225472 ECS_GST_Byte2 2;
BA_ "UsrSigPurpose" SG_ 3221225472 ECS_GST_Byte2 2;
BA_ "Version" SG_ 3221225472 ECS_GST_Byte3 "18.01.08";
BA_ "NetworkRequestHoldingTime" SG_ 3221225472 ECS_GST_Byte3 5000;
BA_ "NetworkRequest" SG_ 3221225472 ECS_GST_Byte3 0;
BA_ "UserSigValidity" SG_ 3221225472 ECS_GST_Byte3 0;
BA_ "GenSigSendType" SG_ 3221225472 ECS_GST_Byte3 2;
BA_ "UsrSigPurpose" SG_ 3221225472 ECS_GST_Byte3 2;
BA_ "Version" SG_ 3221225472 ECS_GST_Byte4 "18.01.08";
BA_ "NetworkRequestHoldingTime" SG_ 3221225472 ECS_GST_Byte4 5000;
BA_ "NetworkRequest" SG_ 3221225472 ECS_GST_Byte4 0;
BA_ "UserSigValidity" SG_ 3221225472 ECS_GST_Byte4 0;
BA_ "GenSigSendType" SG_ 3221225472 ECS_GST_Byte4 2;
BA_ "UsrSigPurpose" SG_ 3221225472 ECS_GST_Byte4 2;
BA_ "Version" SG_ 3221225472 ECS_GST_Byte5 "18.01.08";
BA_ "NetworkRequestHoldingTime" SG_ 3221225472 ECS_GST_Byte5 5000;
BA_ "NetworkRequest" SG_ 3221225472 ECS_GST_Byte5 0;
BA_ "UserSigValidity" SG_ 3221225472 ECS_GST_Byte5 0;
BA_ "GenSigSendType" SG_ 3221225472 ECS_GST_Byte5 2;
BA_ "UsrSigPurpose" SG_ 3221225472 ECS_GST_Byte5 2;
BA_ "Version" SG_ 3221225472 ECS_GST_Byte6 "18.01.08";
BA_ "NetworkRequestHoldingTime" SG_ 3221225472 ECS_GST_Byte6 5000;
BA_ "NetworkRequest" SG_ 3221225472 ECS_GST_Byte6 0;
BA_ "UserSigValidity" SG_ 3221225472 ECS_GST_Byte6 0;
BA_ "GenSigSendType" SG_ 3221225472 ECS_GST_Byte6 2;
BA_ "UsrSigPurpose" SG_ 3221225472 ECS_GST_Byte6 2;
BA_ "Version" SG_ 3221225472 ECS_GST_Byte7 "18.01.08";
BA_ "NetworkRequestHoldingTime" SG_ 3221225472 ECS_GST_Byte7 5000;
BA_ "NetworkRequest" SG_ 3221225472 ECS_GST_Byte7 0;
BA_ "UserSigValidity" SG_ 3221225472 ECS_GST_Byte7 0;
BA_ "GenSigSendType" SG_ 3221225472 ECS_GST_Byte7 2;
BA_ "UsrSigPurpose" SG_ 3221225472 ECS_GST_Byte7 2;
BA_ "Version" SG_ 3221225472 ECS_GST_Byte1 "18.01.08";
BA_ "NetworkRequestHoldingTime" SG_ 3221225472 ECS_GST_Byte1 5000;
BA_ "NetworkRequest" SG_ 3221225472 ECS_GST_Byte1 0;
BA_ "UserSigValidity" SG_ 3221225472 ECS_GST_Byte1 0;
BA_ "GenSigSendType" SG_ 3221225472 ECS_GST_Byte1 2;
BA_ "UsrSigPurpose" SG_ 3221225472 ECS_GST_Byte1 2;
BA_ "Version" SG_ 3221225472 ESC_DTO_Byte0 "18.08.01";
BA_ "NetworkRequestHoldingTime" SG_ 3221225472 ESC_DTO_Byte0 5000;
BA_ "NetworkRequest" SG_ 3221225472 ESC_DTO_Byte0 0;
BA_ "UserSigValidity" SG_ 3221225472 ESC_DTO_Byte0 0;
BA_ "GenSigSendType" SG_ 3221225472 ESC_DTO_Byte0 2;
BA_ "UsrSigPurpose" SG_ 3221225472 ESC_DTO_Byte0 6;
BA_ "Version" SG_ 3221225472 ESC_DTO_Byte2 "18.08.01";
BA_ "NetworkRequestHoldingTime" SG_ 3221225472 ESC_DTO_Byte2 5000;
BA_ "NetworkRequest" SG_ 3221225472 ESC_DTO_Byte2 0;
BA_ "UserSigValidity" SG_ 3221225472 ESC_DTO_Byte2 0;
BA_ "GenSigSendType" SG_ 3221225472 ESC_DTO_Byte2 2;
BA_ "UsrSigPurpose" SG_ 3221225472 ESC_DTO_Byte2 6;
BA_ "Version" SG_ 3221225472 ESC_DTO_Byte3 "18.08.01";
BA_ "NetworkRequestHoldingTime" SG_ 3221225472 ESC_DTO_Byte3 5000;
BA_ "NetworkRequest" SG_ 3221225472 ESC_DTO_Byte3 0;
BA_ "UserSigValidity" SG_ 3221225472 ESC_DTO_Byte3 0;
BA_ "GenSigSendType" SG_ 3221225472 ESC_DTO_Byte3 2;
BA_ "UsrSigPurpose" SG_ 3221225472 ESC_DTO_Byte3 6;
BA_ "Version" SG_ 3221225472 ESC_DTO_Byte4 "18.08.01";
BA_ "NetworkRequestHoldingTime" SG_ 3221225472 ESC_DTO_Byte4 5000;
BA_ "NetworkRequest" SG_ 3221225472 ESC_DTO_Byte4 0;
BA_ "UserSigValidity" SG_ 3221225472 ESC_DTO_Byte4 0;
BA_ "GenSigSendType" SG_ 3221225472 ESC_DTO_Byte4 2;
BA_ "UsrSigPurpose" SG_ 3221225472 ESC_DTO_Byte4 6;
BA_ "Version" SG_ 3221225472 ESC_DTO_Byte5 "18.08.01";
BA_ "NetworkRequestHoldingTime" SG_ 3221225472 ESC_DTO_Byte5 5000;
BA_ "NetworkRequest" SG_ 3221225472 ESC_DTO_Byte5 0;
BA_ "UserSigValidity" SG_ 3221225472 ESC_DTO_Byte5 0;
BA_ "GenSigSendType" SG_ 3221225472 ESC_DTO_Byte5 2;
BA_ "UsrSigPurpose" SG_ 3221225472 ESC_DTO_Byte5 6;
BA_ "Version" SG_ 3221225472 ESC_DTO_Byte6 "18.08.01";
BA_ "NetworkRequestHoldingTime" SG_ 3221225472 ESC_DTO_Byte6 5000;
BA_ "NetworkRequest" SG_ 3221225472 ESC_DTO_Byte6 0;
BA_ "UserSigValidity" SG_ 3221225472 ESC_DTO_Byte6 0;
BA_ "GenSigSendType" SG_ 3221225472 ESC_DTO_Byte6 2;
BA_ "UsrSigPurpose" SG_ 3221225472 ESC_DTO_Byte6 6;
BA_ "Version" SG_ 3221225472 ESC_DTO_Byte7 "18.08.01";
BA_ "NetworkRequestHoldingTime" SG_ 3221225472 ESC_DTO_Byte7 5000;
BA_ "NetworkRequest" SG_ 3221225472 ESC_DTO_Byte7 0;
BA_ "UserSigValidity" SG_ 3221225472 ESC_DTO_Byte7 0;
BA_ "GenSigSendType" SG_ 3221225472 ESC_DTO_Byte7 2;
BA_ "UsrSigPurpose" SG_ 3221225472 ESC_DTO_Byte7 6;
BA_ "Version" SG_ 3221225472 ESC_DTO_Byte1 "18.08.01";
BA_ "NetworkRequestHoldingTime" SG_ 3221225472 ESC_DTO_Byte1 5000;
BA_ "NetworkRequest" SG_ 3221225472 ESC_DTO_Byte1 0;
BA_ "UserSigValidity" SG_ 3221225472 ESC_DTO_Byte1 0;
BA_ "GenSigSendType" SG_ 3221225472 ESC_DTO_Byte1 2;
BA_ "UsrSigPurpose" SG_ 3221225472 ESC_DTO_Byte1 6;
BA_ "Version" SG_ 3221225472 ESC_CRO_Byte0 "18.08.02";
BA_ "NetworkRequestHoldingTime" SG_ 3221225472 ESC_CRO_Byte0 5000;
BA_ "NetworkRequest" SG_ 3221225472 ESC_CRO_Byte0 0;
BA_ "UserSigValidity" SG_ 3221225472 ESC_CRO_Byte0 0;
BA_ "GenSigSendType" SG_ 3221225472 ESC_CRO_Byte0 2;
BA_ "UsrSigPurpose" SG_ 3221225472 ESC_CRO_Byte0 6;
BA_ "Version" SG_ 3221225472 ESC_CRO_Byte2 "18.08.02";
BA_ "NetworkRequestHoldingTime" SG_ 3221225472 ESC_CRO_Byte2 5000;
BA_ "NetworkRequest" SG_ 3221225472 ESC_CRO_Byte2 0;
BA_ "UserSigValidity" SG_ 3221225472 ESC_CRO_Byte2 0;
BA_ "GenSigSendType" SG_ 3221225472 ESC_CRO_Byte2 2;
BA_ "UsrSigPurpose" SG_ 3221225472 ESC_CRO_Byte2 6;
BA_ "Version" SG_ 3221225472 ESC_CRO_Byte3 "18.08.02";
BA_ "NetworkRequestHoldingTime" SG_ 3221225472 ESC_CRO_Byte3 5000;
BA_ "NetworkRequest" SG_ 3221225472 ESC_CRO_Byte3 0;
BA_ "UserSigValidity" SG_ 3221225472 ESC_CRO_Byte3 0;
BA_ "GenSigSendType" SG_ 3221225472 ESC_CRO_Byte3 2;
BA_ "UsrSigPurpose" SG_ 3221225472 ESC_CRO_Byte3 6;
BA_ "Version" SG_ 3221225472 ESC_CRO_Byte4 "18.08.02";
BA_ "NetworkRequestHoldingTime" SG_ 3221225472 ESC_CRO_Byte4 5000;
BA_ "NetworkRequest" SG_ 3221225472 ESC_CRO_Byte4 0;
BA_ "UserSigValidity" SG_ 3221225472 ESC_CRO_Byte4 0;
BA_ "GenSigSendType" SG_ 3221225472 ESC_CRO_Byte4 2;
BA_ "UsrSigPurpose" SG_ 3221225472 ESC_CRO_Byte4 6;
BA_ "Version" SG_ 3221225472 ESC_CRO_Byte5 "18.08.02";
BA_ "NetworkRequestHoldingTime" SG_ 3221225472 ESC_CRO_Byte5 5000;
BA_ "NetworkRequest" SG_ 3221225472 ESC_CRO_Byte5 0;
BA_ "UserSigValidity" SG_ 3221225472 ESC_CRO_Byte5 0;
BA_ "GenSigSendType" SG_ 3221225472 ESC_CRO_Byte5 2;
BA_ "UsrSigPurpose" SG_ 3221225472 ESC_CRO_Byte5 6;
BA_ "Version" SG_ 3221225472 ESC_CRO_Byte6 "18.08.02";
BA_ "NetworkRequestHoldingTime" SG_ 3221225472 ESC_CRO_Byte6 5000;
BA_ "NetworkRequest" SG_ 3221225472 ESC_CRO_Byte6 0;
BA_ "UserSigValidity" SG_ 3221225472 ESC_CRO_Byte6 0;
BA_ "GenSigSendType" SG_ 3221225472 ESC_CRO_Byte6 2;
BA_ "UsrSigPurpose" SG_ 3221225472 ESC_CRO_Byte6 6;
BA_ "Version" SG_ 3221225472 ESC_CRO_Byte7 "18.08.02";
BA_ "NetworkRequestHoldingTime" SG_ 3221225472 ESC_CRO_Byte7 5000;
BA_ "NetworkRequest" SG_ 3221225472 ESC_CRO_Byte7 0;
BA_ "UserSigValidity" SG_ 3221225472 ESC_CRO_Byte7 0;
BA_ "GenSigSendType" SG_ 3221225472 ESC_CRO_Byte7 2;
BA_ "UsrSigPurpose" SG_ 3221225472 ESC_CRO_Byte7 6;
BA_ "Version" SG_ 3221225472 ESC_CRO_Byte1 "18.08.02";
BA_ "NetworkRequestHoldingTime" SG_ 3221225472 ESC_CRO_Byte1 5000;
BA_ "NetworkRequest" SG_ 3221225472 ESC_CRO_Byte1 0;
BA_ "UserSigValidity" SG_ 3221225472 ESC_CRO_Byte1 0;
BA_ "GenSigSendType" SG_ 3221225472 ESC_CRO_Byte1 2;
BA_ "UsrSigPurpose" SG_ 3221225472 ESC_CRO_Byte1 6;
BA_ "Version" SG_ 3221225472 ESC_GST_Byte0 "18.01.08";
BA_ "NetworkRequestHoldingTime" SG_ 3221225472 ESC_GST_Byte0 5000;
BA_ "NetworkRequest" SG_ 3221225472 ESC_GST_Byte0 0;
BA_ "UserSigValidity" SG_ 3221225472 ESC_GST_Byte0 0;
BA_ "GenSigSendType" SG_ 3221225472 ESC_GST_Byte0 2;
BA_ "UsrSigPurpose" SG_ 3221225472 ESC_GST_Byte0 2;
BA_ "Version" SG_ 3221225472 ESC_GST_Byte2 "18.01.08";
BA_ "NetworkRequestHoldingTime" SG_ 3221225472 ESC_GST_Byte2 5000;
BA_ "NetworkRequest" SG_ 3221225472 ESC_GST_Byte2 0;
BA_ "UserSigValidity" SG_ 3221225472 ESC_GST_Byte2 0;
BA_ "GenSigSendType" SG_ 3221225472 ESC_GST_Byte2 2;
BA_ "UsrSigPurpose" SG_ 3221225472 ESC_GST_Byte2 2;
BA_ "Version" SG_ 3221225472 ESC_GST_Byte3 "18.01.08";
BA_ "NetworkRequestHoldingTime" SG_ 3221225472 ESC_GST_Byte3 5000;
BA_ "NetworkRequest" SG_ 3221225472 ESC_GST_Byte3 0;
BA_ "UserSigValidity" SG_ 3221225472 ESC_GST_Byte3 0;
BA_ "GenSigSendType" SG_ 3221225472 ESC_GST_Byte3 2;
BA_ "UsrSigPurpose" SG_ 3221225472 ESC_GST_Byte3 2;
BA_ "Version" SG_ 3221225472 ESC_GST_Byte4 "18.01.08";
BA_ "NetworkRequestHoldingTime" SG_ 3221225472 ESC_GST_Byte4 5000;
BA_ "NetworkRequest" SG_ 3221225472 ESC_GST_Byte4 0;
BA_ "UserSigValidity" SG_ 3221225472 ESC_GST_Byte4 0;
BA_ "GenSigSendType" SG_ 3221225472 ESC_GST_Byte4 2;
BA_ "UsrSigPurpose" SG_ 3221225472 ESC_GST_Byte4 2;
BA_ "Version" SG_ 3221225472 ESC_GST_Byte5 "18.01.08";
BA_ "NetworkRequestHoldingTime" SG_ 3221225472 ESC_GST_Byte5 5000;
BA_ "NetworkRequest" SG_ 3221225472 ESC_GST_Byte5 0;
BA_ "UserSigValidity" SG_ 3221225472 ESC_GST_Byte5 0;
BA_ "GenSigSendType" SG_ 3221225472 ESC_GST_Byte5 2;
BA_ "UsrSigPurpose" SG_ 3221225472 ESC_GST_Byte5 2;
BA_ "Version" SG_ 3221225472 ESC_GST_Byte6 "18.01.08";
BA_ "NetworkRequestHoldingTime" SG_ 3221225472 ESC_GST_Byte6 5000;
BA_ "NetworkRequest" SG_ 3221225472 ESC_GST_Byte6 0;
BA_ "UserSigValidity" SG_ 3221225472 ESC_GST_Byte6 0;
BA_ "GenSigSendType" SG_ 3221225472 ESC_GST_Byte6 2;
BA_ "UsrSigPurpose" SG_ 3221225472 ESC_GST_Byte6 2;
BA_ "Version" SG_ 3221225472 ESC_GST_Byte7 "18.01.08";
BA_ "NetworkRequestHoldingTime" SG_ 3221225472 ESC_GST_Byte7 5000;
BA_ "NetworkRequest" SG_ 3221225472 ESC_GST_Byte7 0;
BA_ "UserSigValidity" SG_ 3221225472 ESC_GST_Byte7 0;
BA_ "GenSigSendType" SG_ 3221225472 ESC_GST_Byte7 2;
BA_ "UsrSigPurpose" SG_ 3221225472 ESC_GST_Byte7 2;
BA_ "Version" SG_ 3221225472 ESC_GST_Byte1 "18.01.08";
BA_ "NetworkRequestHoldingTime" SG_ 3221225472 ESC_GST_Byte1 5000;
BA_ "NetworkRequest" SG_ 3221225472 ESC_GST_Byte1 0;
BA_ "UserSigValidity" SG_ 3221225472 ESC_GST_Byte1 0;
BA_ "GenSigSendType" SG_ 3221225472 ESC_GST_Byte1 2;
BA_ "UsrSigPurpose" SG_ 3221225472 ESC_GST_Byte1 2;
BA_ "Version" SG_ 3221225472 ESC_Logger1_Byte0 "18.08.01";
BA_ "NetworkRequestHoldingTime" SG_ 3221225472 ESC_Logger1_Byte0 5000;
BA_ "NetworkRequest" SG_ 3221225472 ESC_Logger1_Byte0 0;
BA_ "UserSigValidity" SG_ 3221225472 ESC_Logger1_Byte0 0;
BA_ "GenSigSendType" SG_ 3221225472 ESC_Logger1_Byte0 2;
BA_ "UsrSigPurpose" SG_ 3221225472 ESC_Logger1_Byte0 6;
BA_ "Version" SG_ 3221225472 ESC_Logger1_Byte2 "18.08.01";
BA_ "NetworkRequestHoldingTime" SG_ 3221225472 ESC_Logger1_Byte2 5000;
BA_ "NetworkRequest" SG_ 3221225472 ESC_Logger1_Byte2 0;
BA_ "UserSigValidity" SG_ 3221225472 ESC_Logger1_Byte2 0;
BA_ "GenSigSendType" SG_ 3221225472 ESC_Logger1_Byte2 2;
BA_ "UsrSigPurpose" SG_ 3221225472 ESC_Logger1_Byte2 6;
BA_ "Version" SG_ 3221225472 ESC_Logger1_Byte3 "18.08.01";
BA_ "NetworkRequestHoldingTime" SG_ 3221225472 ESC_Logger1_Byte3 5000;
BA_ "NetworkRequest" SG_ 3221225472 ESC_Logger1_Byte3 0;
BA_ "UserSigValidity" SG_ 3221225472 ESC_Logger1_Byte3 0;
BA_ "GenSigSendType" SG_ 3221225472 ESC_Logger1_Byte3 2;
BA_ "UsrSigPurpose" SG_ 3221225472 ESC_Logger1_Byte3 6;
BA_ "Version" SG_ 3221225472 ESC_Logger1_Byte4 "18.08.01";
BA_ "NetworkRequestHoldingTime" SG_ 3221225472 ESC_Logger1_Byte4 5000;
BA_ "NetworkRequest" SG_ 3221225472 ESC_Logger1_Byte4 0;
BA_ "UserSigValidity" SG_ 3221225472 ESC_Logger1_Byte4 0;
BA_ "GenSigSendType" SG_ 3221225472 ESC_Logger1_Byte4 2;
BA_ "UsrSigPurpose" SG_ 3221225472 ESC_Logger1_Byte4 6;
BA_ "Version" SG_ 3221225472 ESC_Logger1_Byte5 "18.08.01";
BA_ "NetworkRequestHoldingTime" SG_ 3221225472 ESC_Logger1_Byte5 5000;
BA_ "NetworkRequest" SG_ 3221225472 ESC_Logger1_Byte5 0;
BA_ "UserSigValidity" SG_ 3221225472 ESC_Logger1_Byte5 0;
BA_ "GenSigSendType" SG_ 3221225472 ESC_Logger1_Byte5 2;
BA_ "UsrSigPurpose" SG_ 3221225472 ESC_Logger1_Byte5 6;
BA_ "Version" SG_ 3221225472 ESC_Logger1_Byte6 "18.08.01";
BA_ "NetworkRequestHoldingTime" SG_ 3221225472 ESC_Logger1_Byte6 5000;
BA_ "NetworkRequest" SG_ 3221225472 ESC_Logger1_Byte6 0;
BA_ "UserSigValidity" SG_ 3221225472 ESC_Logger1_Byte6 0;
BA_ "GenSigSendType" SG_ 3221225472 ESC_Logger1_Byte6 2;
BA_ "UsrSigPurpose" SG_ 3221225472 ESC_Logger1_Byte6 6;
BA_ "Version" SG_ 3221225472 ESC_Logger1_Byte7 "18.08.01";
BA_ "NetworkRequestHoldingTime" SG_ 3221225472 ESC_Logger1_Byte7 5000;
BA_ "NetworkRequest" SG_ 3221225472 ESC_Logger1_Byte7 0;
BA_ "UserSigValidity" SG_ 3221225472 ESC_Logger1_Byte7 0;
BA_ "GenSigSendType" SG_ 3221225472 ESC_Logger1_Byte7 2;
BA_ "UsrSigPurpose" SG_ 3221225472 ESC_Logger1_Byte7 6;
BA_ "Version" SG_ 3221225472 ESC_Logger1_Byte1 "18.08.01";
BA_ "NetworkRequestHoldingTime" SG_ 3221225472 ESC_Logger1_Byte1 5000;
BA_ "NetworkRequest" SG_ 3221225472 ESC_Logger1_Byte1 0;
BA_ "UserSigValidity" SG_ 3221225472 ESC_Logger1_Byte1 0;
BA_ "GenSigSendType" SG_ 3221225472 ESC_Logger1_Byte1 2;
BA_ "UsrSigPurpose" SG_ 3221225472 ESC_Logger1_Byte1 6;
BA_ "Version" SG_ 3221225472 ESC_Logger0_Byte0 "18.08.01";
BA_ "NetworkRequestHoldingTime" SG_ 3221225472 ESC_Logger0_Byte0 5000;
BA_ "NetworkRequest" SG_ 3221225472 ESC_Logger0_Byte0 0;
BA_ "UserSigValidity" SG_ 3221225472 ESC_Logger0_Byte0 0;
BA_ "GenSigSendType" SG_ 3221225472 ESC_Logger0_Byte0 2;
BA_ "UsrSigPurpose" SG_ 3221225472 ESC_Logger0_Byte0 6;
BA_ "Version" SG_ 3221225472 ESC_Logger0_Byte2 "18.08.01";
BA_ "NetworkRequestHoldingTime" SG_ 3221225472 ESC_Logger0_Byte2 5000;
BA_ "NetworkRequest" SG_ 3221225472 ESC_Logger0_Byte2 0;
BA_ "UserSigValidity" SG_ 3221225472 ESC_Logger0_Byte2 0;
BA_ "GenSigSendType" SG_ 3221225472 ESC_Logger0_Byte2 2;
BA_ "UsrSigPurpose" SG_ 3221225472 ESC_Logger0_Byte2 6;
BA_ "Version" SG_ 3221225472 ESC_Logger0_Byte3 "18.08.01";
BA_ "NetworkRequestHoldingTime" SG_ 3221225472 ESC_Logger0_Byte3 5000;
BA_ "NetworkRequest" SG_ 3221225472 ESC_Logger0_Byte3 0;
BA_ "UserSigValidity" SG_ 3221225472 ESC_Logger0_Byte3 0;
BA_ "GenSigSendType" SG_ 3221225472 ESC_Logger0_Byte3 2;
BA_ "UsrSigPurpose" SG_ 3221225472 ESC_Logger0_Byte3 6;
BA_ "Version" SG_ 3221225472 ESC_Logger0_Byte4 "18.08.01";
BA_ "NetworkRequestHoldingTime" SG_ 3221225472 ESC_Logger0_Byte4 5000;
BA_ "NetworkRequest" SG_ 3221225472 ESC_Logger0_Byte4 0;
BA_ "UserSigValidity" SG_ 3221225472 ESC_Logger0_Byte4 0;
BA_ "GenSigSendType" SG_ 3221225472 ESC_Logger0_Byte4 2;
BA_ "UsrSigPurpose" SG_ 3221225472 ESC_Logger0_Byte4 6;
BA_ "Version" SG_ 3221225472 ESC_Logger0_Byte5 "18.08.01";
BA_ "NetworkRequestHoldingTime" SG_ 3221225472 ESC_Logger0_Byte5 5000;
BA_ "NetworkRequest" SG_ 3221225472 ESC_Logger0_Byte5 0;
BA_ "UserSigValidity" SG_ 3221225472 ESC_Logger0_Byte5 0;
BA_ "GenSigSendType" SG_ 3221225472 ESC_Logger0_Byte5 2;
BA_ "UsrSigPurpose" SG_ 3221225472 ESC_Logger0_Byte5 6;
BA_ "Version" SG_ 3221225472 ESC_Logger0_Byte6 "18.08.01";
BA_ "NetworkRequestHoldingTime" SG_ 3221225472 ESC_Logger0_Byte6 5000;
BA_ "NetworkRequest" SG_ 3221225472 ESC_Logger0_Byte6 0;
BA_ "UserSigValidity" SG_ 3221225472 ESC_Logger0_Byte6 0;
BA_ "GenSigSendType" SG_ 3221225472 ESC_Logger0_Byte6 2;
BA_ "UsrSigPurpose" SG_ 3221225472 ESC_Logger0_Byte6 6;
BA_ "Version" SG_ 3221225472 ESC_Logger0_Byte7 "18.08.01";
BA_ "NetworkRequestHoldingTime" SG_ 3221225472 ESC_Logger0_Byte7 5000;
BA_ "NetworkRequest" SG_ 3221225472 ESC_Logger0_Byte7 0;
BA_ "UserSigValidity" SG_ 3221225472 ESC_Logger0_Byte7 0;
BA_ "GenSigSendType" SG_ 3221225472 ESC_Logger0_Byte7 2;
BA_ "UsrSigPurpose" SG_ 3221225472 ESC_Logger0_Byte7 6;
BA_ "Version" SG_ 3221225472 ESC_Logger0_Byte1 "18.08.01";
BA_ "NetworkRequestHoldingTime" SG_ 3221225472 ESC_Logger0_Byte1 5000;
BA_ "NetworkRequest" SG_ 3221225472 ESC_Logger0_Byte1 0;
BA_ "UserSigValidity" SG_ 3221225472 ESC_Logger0_Byte1 0;
BA_ "GenSigSendType" SG_ 3221225472 ESC_Logger0_Byte1 2;
BA_ "UsrSigPurpose" SG_ 3221225472 ESC_Logger0_Byte1 6;
BA_ "Version" SG_ 3221225472 GST_ALL_Byte0 "19.02.08";
BA_ "NetworkRequestHoldingTime" SG_ 3221225472 GST_ALL_Byte0 5000;
BA_ "NetworkRequest" SG_ 3221225472 GST_ALL_Byte0 0;
BA_ "UserSigValidity" SG_ 3221225472 GST_ALL_Byte0 0;
BA_ "GenSigSendType" SG_ 3221225472 GST_ALL_Byte0 2;
BA_ "UsrSigPurpose" SG_ 3221225472 GST_ALL_Byte0 2;
BA_ "Version" SG_ 3221225472 GST_ALL_Byte2 "19.02.08";
BA_ "NetworkRequestHoldingTime" SG_ 3221225472 GST_ALL_Byte2 5000;
BA_ "NetworkRequest" SG_ 3221225472 GST_ALL_Byte2 0;
BA_ "UserSigValidity" SG_ 3221225472 GST_ALL_Byte2 0;
BA_ "GenSigSendType" SG_ 3221225472 GST_ALL_Byte2 2;
BA_ "UsrSigPurpose" SG_ 3221225472 GST_ALL_Byte2 2;
BA_ "Version" SG_ 3221225472 GST_ALL_Byte3 "19.02.08";
BA_ "NetworkRequestHoldingTime" SG_ 3221225472 GST_ALL_Byte3 5000;
BA_ "NetworkRequest" SG_ 3221225472 GST_ALL_Byte3 0;
BA_ "UserSigValidity" SG_ 3221225472 GST_ALL_Byte3 0;
BA_ "GenSigSendType" SG_ 3221225472 GST_ALL_Byte3 2;
BA_ "UsrSigPurpose" SG_ 3221225472 GST_ALL_Byte3 2;
BA_ "Version" SG_ 3221225472 GST_ALL_Byte4 "19.02.08";
BA_ "NetworkRequestHoldingTime" SG_ 3221225472 GST_ALL_Byte4 5000;
BA_ "NetworkRequest" SG_ 3221225472 GST_ALL_Byte4 0;
BA_ "UserSigValidity" SG_ 3221225472 GST_ALL_Byte4 0;
BA_ "GenSigSendType" SG_ 3221225472 GST_ALL_Byte4 2;
BA_ "UsrSigPurpose" SG_ 3221225472 GST_ALL_Byte4 2;
BA_ "Version" SG_ 3221225472 GST_ALL_Byte5 "19.02.08";
BA_ "NetworkRequestHoldingTime" SG_ 3221225472 GST_ALL_Byte5 5000;
BA_ "NetworkRequest" SG_ 3221225472 GST_ALL_Byte5 0;
BA_ "UserSigValidity" SG_ 3221225472 GST_ALL_Byte5 0;
BA_ "GenSigSendType" SG_ 3221225472 GST_ALL_Byte5 2;
BA_ "UsrSigPurpose" SG_ 3221225472 GST_ALL_Byte5 2;
BA_ "Version" SG_ 3221225472 GST_ALL_Byte6 "19.02.08";
BA_ "NetworkRequestHoldingTime" SG_ 3221225472 GST_ALL_Byte6 5000;
BA_ "NetworkRequest" SG_ 3221225472 GST_ALL_Byte6 0;
BA_ "UserSigValidity" SG_ 3221225472 GST_ALL_Byte6 0;
BA_ "GenSigSendType" SG_ 3221225472 GST_ALL_Byte6 2;
BA_ "UsrSigPurpose" SG_ 3221225472 GST_ALL_Byte6 2;
BA_ "Version" SG_ 3221225472 GST_ALL_Byte7 "19.02.08";
BA_ "NetworkRequestHoldingTime" SG_ 3221225472 GST_ALL_Byte7 5000;
BA_ "NetworkRequest" SG_ 3221225472 GST_ALL_Byte7 0;
BA_ "UserSigValidity" SG_ 3221225472 GST_ALL_Byte7 0;
BA_ "GenSigSendType" SG_ 3221225472 GST_ALL_Byte7 2;
BA_ "UsrSigPurpose" SG_ 3221225472 GST_ALL_Byte7 2;
BA_ "Version" SG_ 3221225472 GST_ALL_Byte1 "19.02.08";
BA_ "NetworkRequestHoldingTime" SG_ 3221225472 GST_ALL_Byte1 5000;
BA_ "NetworkRequest" SG_ 3221225472 GST_ALL_Byte1 0;
BA_ "UserSigValidity" SG_ 3221225472 GST_ALL_Byte1 0;
BA_ "GenSigSendType" SG_ 3221225472 GST_ALL_Byte1 2;
BA_ "UsrSigPurpose" SG_ 3221225472 GST_ALL_Byte1 2;
BA_ "Version" SG_ 3221225472 MDPS_GST_Byte0 "18.01.08";
BA_ "NetworkRequestHoldingTime" SG_ 3221225472 MDPS_GST_Byte0 5000;
BA_ "NetworkRequest" SG_ 3221225472 MDPS_GST_Byte0 0;
BA_ "UserSigValidity" SG_ 3221225472 MDPS_GST_Byte0 0;
BA_ "GenSigSendType" SG_ 3221225472 MDPS_GST_Byte0 2;
BA_ "UsrSigPurpose" SG_ 3221225472 MDPS_GST_Byte0 2;
BA_ "Version" SG_ 3221225472 MDPS_GST_Byte2 "18.01.08";
BA_ "NetworkRequestHoldingTime" SG_ 3221225472 MDPS_GST_Byte2 5000;
BA_ "NetworkRequest" SG_ 3221225472 MDPS_GST_Byte2 0;
BA_ "UserSigValidity" SG_ 3221225472 MDPS_GST_Byte2 0;
BA_ "GenSigSendType" SG_ 3221225472 MDPS_GST_Byte2 2;
BA_ "UsrSigPurpose" SG_ 3221225472 MDPS_GST_Byte2 2;
BA_ "Version" SG_ 3221225472 MDPS_GST_Byte3 "18.01.08";
BA_ "NetworkRequestHoldingTime" SG_ 3221225472 MDPS_GST_Byte3 5000;
BA_ "NetworkRequest" SG_ 3221225472 MDPS_GST_Byte3 0;
BA_ "UserSigValidity" SG_ 3221225472 MDPS_GST_Byte3 0;
BA_ "GenSigSendType" SG_ 3221225472 MDPS_GST_Byte3 2;
BA_ "UsrSigPurpose" SG_ 3221225472 MDPS_GST_Byte3 2;
BA_ "Version" SG_ 3221225472 MDPS_GST_Byte4 "18.01.08";
BA_ "NetworkRequestHoldingTime" SG_ 3221225472 MDPS_GST_Byte4 5000;
BA_ "NetworkRequest" SG_ 3221225472 MDPS_GST_Byte4 0;
BA_ "UserSigValidity" SG_ 3221225472 MDPS_GST_Byte4 0;
BA_ "GenSigSendType" SG_ 3221225472 MDPS_GST_Byte4 2;
BA_ "UsrSigPurpose" SG_ 3221225472 MDPS_GST_Byte4 2;
BA_ "Version" SG_ 3221225472 MDPS_GST_Byte5 "18.01.08";
BA_ "NetworkRequestHoldingTime" SG_ 3221225472 MDPS_GST_Byte5 5000;
BA_ "NetworkRequest" SG_ 3221225472 MDPS_GST_Byte5 0;
BA_ "UserSigValidity" SG_ 3221225472 MDPS_GST_Byte5 0;
BA_ "GenSigSendType" SG_ 3221225472 MDPS_GST_Byte5 2;
BA_ "UsrSigPurpose" SG_ 3221225472 MDPS_GST_Byte5 2;
BA_ "Version" SG_ 3221225472 MDPS_GST_Byte6 "18.01.08";
BA_ "NetworkRequestHoldingTime" SG_ 3221225472 MDPS_GST_Byte6 5000;
BA_ "NetworkRequest" SG_ 3221225472 MDPS_GST_Byte6 0;
BA_ "UserSigValidity" SG_ 3221225472 MDPS_GST_Byte6 0;
BA_ "GenSigSendType" SG_ 3221225472 MDPS_GST_Byte6 2;
BA_ "UsrSigPurpose" SG_ 3221225472 MDPS_GST_Byte6 2;
BA_ "Version" SG_ 3221225472 MDPS_GST_Byte7 "18.01.08";
BA_ "NetworkRequestHoldingTime" SG_ 3221225472 MDPS_GST_Byte7 5000;
BA_ "NetworkRequest" SG_ 3221225472 MDPS_GST_Byte7 0;
BA_ "UserSigValidity" SG_ 3221225472 MDPS_GST_Byte7 0;
BA_ "GenSigSendType" SG_ 3221225472 MDPS_GST_Byte7 2;
BA_ "UsrSigPurpose" SG_ 3221225472 MDPS_GST_Byte7 2;
BA_ "Version" SG_ 3221225472 MDPS_GST_Byte1 "18.01.08";
BA_ "NetworkRequestHoldingTime" SG_ 3221225472 MDPS_GST_Byte1 5000;
BA_ "NetworkRequest" SG_ 3221225472 MDPS_GST_Byte1 0;
BA_ "UserSigValidity" SG_ 3221225472 MDPS_GST_Byte1 0;
BA_ "GenSigSendType" SG_ 3221225472 MDPS_GST_Byte1 2;
BA_ "UsrSigPurpose" SG_ 3221225472 MDPS_GST_Byte1 2;
BA_ "Version" SG_ 3221225472 ECS_Crc4Val "18.11.08";
BA_ "RoutingFactor" SG_ 3221225472 ECS_Crc4Val 5;
BA_ "UserSigValidity" SG_ 3221225472 ECS_Crc4Val 3;
BA_ "GenSigStartValue" SG_ 3221225472 ECS_Crc4Val 65535;
BA_ "Description" SG_ 3221225472 ECS_Crc4Val "The data area for CRC calculation is based on the data length (DLC) of the message DB.

The CRC shall be calculated over the entire data block (excluding the CRC bytes) including the user data, alive counter and Data ID

 

- CRC Polynomial (0x1021) , In";
BA_ "Version" SG_ 3221225472 ECSIVSS_RdIndxVal "17.11.00";
BA_ "RoutingFactor" SG_ 3221225472 ECSIVSS_RdIndxVal 5;
BA_ "UserSigValidity" SG_ 3221225472 ECSIVSS_RdIndxVal 3;
BA_ "Description" SG_ 3221225472 ECSIVSS_RdIndxVal "Road Index";
BA_ "Version" SG_ 3221225472 ECS_AlvCnt4Val "18.11.08";
BA_ "RoutingFactor" SG_ 3221225472 ECS_AlvCnt4Val 5;
BA_ "UserSigValidity" SG_ 3221225472 ECS_AlvCnt4Val 3;
BA_ "Description" SG_ 3221225472 ECS_AlvCnt4Val "For the first transmission request for a data element the counter shall be initialized with 0 and shall be incremented by 1 for every subsequent send request. 

When the counter reaches the maximum value(0xFF), then it shall restart with 0 for the next s";
BA_ "Version" SG_ 3221225472 ECSIVSS_FLWhlVrtclAccelSnsrVal "18.07.04";
BA_ "RoutingFactor" SG_ 3221225472 ECSIVSS_FLWhlVrtclAccelSnsrVal 5;
BA_ "UserSigValidity" SG_ 3221225472 ECSIVSS_FLWhlVrtclAccelSnsrVal 3;
BA_ "GenSigStartValue" SG_ 3221225472 ECSIVSS_FLWhlVrtclAccelSnsrVal 512;
BA_ "Description" SG_ 3221225472 ECSIVSS_FLWhlVrtclAccelSnsrVal "Wheel Vertical Acceleration Sensor - FL

0x0000~0x03FF:-13.3g(102)~13.3g(921)/0x0400~0x0FFE:Not used/0x0FFF:Invalid



 /* Wheel G value, 102:-13.3g, 921 : +13.3g */

Value : 102(-13.3G) ~ 921(+13.3G)

If Value <= 102, Then Value = -13.3g

If Value >= 92";
BA_ "Version" SG_ 3221225472 ECSIVSS_FRWhlVrtclAccelSnsrVal "18.07.04";
BA_ "RoutingFactor" SG_ 3221225472 ECSIVSS_FRWhlVrtclAccelSnsrVal 5;
BA_ "UserSigValidity" SG_ 3221225472 ECSIVSS_FRWhlVrtclAccelSnsrVal 3;
BA_ "GenSigStartValue" SG_ 3221225472 ECSIVSS_FRWhlVrtclAccelSnsrVal 512;
BA_ "Description" SG_ 3221225472 ECSIVSS_FRWhlVrtclAccelSnsrVal "Wheel Vertical Acceleration Sensor - FR

0x0000~0x03FF:-13.3g(102)~13.3g(921)/0x0400~0x0FFE:Not used/0x0FFF:Invalid



 /* Wheel G value, 102:-13.3g, 921 : +13.3g */

Value : 102(-13.3G) ~ 921(+13.3G)

If Value <= 102, Then Value = -13.3g

If Value >= 92";
BA_ "Version" SG_ 3221225472 ECSIVSS_FLBodyAccelSnsrVal "18.07.04";
BA_ "RoutingFactor" SG_ 3221225472 ECSIVSS_FLBodyAccelSnsrVal 5;
BA_ "UserSigValidity" SG_ 3221225472 ECSIVSS_FLBodyAccelSnsrVal 3;
BA_ "GenSigStartValue" SG_ 3221225472 ECSIVSS_FLBodyAccelSnsrVal 512;
BA_ "Description" SG_ 3221225472 ECSIVSS_FLBodyAccelSnsrVal "Body Vertical Acceleration Sensor - FL

0x0000~0x03FF:-1g(102)~1g(921)/0x0400~0x0FFE:Not used/0x0FFF:Invalid



 /* Body G value, 102:-1g, 921 : +1g */

Value : 102(-1g) ~ 921(+1g)

If Value <= 102, Then Value = -1g

If Value >= 921 Then  Value = 1g";
BA_ "Version" SG_ 3221225472 ECSIVSS_FRBodyAccelSnsrVal "18.07.04";
BA_ "RoutingFactor" SG_ 3221225472 ECSIVSS_FRBodyAccelSnsrVal 5;
BA_ "UserSigValidity" SG_ 3221225472 ECSIVSS_FRBodyAccelSnsrVal 3;
BA_ "GenSigStartValue" SG_ 3221225472 ECSIVSS_FRBodyAccelSnsrVal 512;
BA_ "Description" SG_ 3221225472 ECSIVSS_FRBodyAccelSnsrVal "Body Vertical Acceleration Sensor - FR

0x0000~0x03FF:-1g(102)~1g(921)/0x0400~0x0FFE:Not used/0x0FFF:Invalid



 /* Body G value, 102:-1g, 921 : +1g */

Value : 102(-1g) ~ 921(+1g)

If Value <= 102, Then Value = -1g

If Value >= 921 Then  Value = 1g";
BA_ "Version" SG_ 3221225472 ECSIVSS_RrBodyAccelSnsrVal "18.07.04";
BA_ "RoutingFactor" SG_ 3221225472 ECSIVSS_RrBodyAccelSnsrVal 5;
BA_ "UserSigValidity" SG_ 3221225472 ECSIVSS_RrBodyAccelSnsrVal 3;
BA_ "GenSigStartValue" SG_ 3221225472 ECSIVSS_RrBodyAccelSnsrVal 512;
BA_ "Description" SG_ 3221225472 ECSIVSS_RrBodyAccelSnsrVal "Body Vertical Acceleration Sensor - Rear

0x0000~0x03FF:-1g(102)~1g(921)/0x0400~0x0FFE:Not used/0x0FFF:Invalid



 /* Body G value, 102:-1g, 921 : +1g */

Value : 102(-1g) ~ 921(+1g)

If Value <= 102, Then Value = -1g

If Value >= 921 Then  Value = 1g";
BA_ "Version" SG_ 3221225472 ESC_Logger3_Byte0 "18.08.01";
BA_ "NetworkRequestHoldingTime" SG_ 3221225472 ESC_Logger3_Byte0 5000;
BA_ "NetworkRequest" SG_ 3221225472 ESC_Logger3_Byte0 0;
BA_ "UserSigValidity" SG_ 3221225472 ESC_Logger3_Byte0 0;
BA_ "GenSigSendType" SG_ 3221225472 ESC_Logger3_Byte0 2;
BA_ "UsrSigPurpose" SG_ 3221225472 ESC_Logger3_Byte0 6;
BA_ "Version" SG_ 3221225472 ESC_Logger3_Byte2 "18.08.01";
BA_ "NetworkRequestHoldingTime" SG_ 3221225472 ESC_Logger3_Byte2 5000;
BA_ "NetworkRequest" SG_ 3221225472 ESC_Logger3_Byte2 0;
BA_ "UserSigValidity" SG_ 3221225472 ESC_Logger3_Byte2 0;
BA_ "GenSigSendType" SG_ 3221225472 ESC_Logger3_Byte2 2;
BA_ "UsrSigPurpose" SG_ 3221225472 ESC_Logger3_Byte2 6;
BA_ "Version" SG_ 3221225472 ESC_Logger3_Byte3 "18.08.01";
BA_ "NetworkRequestHoldingTime" SG_ 3221225472 ESC_Logger3_Byte3 5000;
BA_ "NetworkRequest" SG_ 3221225472 ESC_Logger3_Byte3 0;
BA_ "UserSigValidity" SG_ 3221225472 ESC_Logger3_Byte3 0;
BA_ "GenSigSendType" SG_ 3221225472 ESC_Logger3_Byte3 2;
BA_ "UsrSigPurpose" SG_ 3221225472 ESC_Logger3_Byte3 6;
BA_ "Version" SG_ 3221225472 ESC_Logger3_Byte4 "18.08.01";
BA_ "NetworkRequestHoldingTime" SG_ 3221225472 ESC_Logger3_Byte4 5000;
BA_ "NetworkRequest" SG_ 3221225472 ESC_Logger3_Byte4 0;
BA_ "UserSigValidity" SG_ 3221225472 ESC_Logger3_Byte4 0;
BA_ "GenSigSendType" SG_ 3221225472 ESC_Logger3_Byte4 2;
BA_ "UsrSigPurpose" SG_ 3221225472 ESC_Logger3_Byte4 6;
BA_ "Version" SG_ 3221225472 ESC_Logger3_Byte5 "18.08.01";
BA_ "NetworkRequestHoldingTime" SG_ 3221225472 ESC_Logger3_Byte5 5000;
BA_ "NetworkRequest" SG_ 3221225472 ESC_Logger3_Byte5 0;
BA_ "UserSigValidity" SG_ 3221225472 ESC_Logger3_Byte5 0;
BA_ "GenSigSendType" SG_ 3221225472 ESC_Logger3_Byte5 2;
BA_ "UsrSigPurpose" SG_ 3221225472 ESC_Logger3_Byte5 6;
BA_ "Version" SG_ 3221225472 ESC_Logger3_Byte6 "18.08.01";
BA_ "NetworkRequestHoldingTime" SG_ 3221225472 ESC_Logger3_Byte6 5000;
BA_ "NetworkRequest" SG_ 3221225472 ESC_Logger3_Byte6 0;
BA_ "UserSigValidity" SG_ 3221225472 ESC_Logger3_Byte6 0;
BA_ "GenSigSendType" SG_ 3221225472 ESC_Logger3_Byte6 2;
BA_ "UsrSigPurpose" SG_ 3221225472 ESC_Logger3_Byte6 6;
BA_ "Version" SG_ 3221225472 ESC_Logger3_Byte7 "18.08.01";
BA_ "NetworkRequestHoldingTime" SG_ 3221225472 ESC_Logger3_Byte7 5000;
BA_ "NetworkRequest" SG_ 3221225472 ESC_Logger3_Byte7 0;
BA_ "UserSigValidity" SG_ 3221225472 ESC_Logger3_Byte7 0;
BA_ "GenSigSendType" SG_ 3221225472 ESC_Logger3_Byte7 2;
BA_ "UsrSigPurpose" SG_ 3221225472 ESC_Logger3_Byte7 6;
BA_ "Version" SG_ 3221225472 ESC_Logger3_Byte1 "18.08.01";
BA_ "NetworkRequestHoldingTime" SG_ 3221225472 ESC_Logger3_Byte1 5000;
BA_ "NetworkRequest" SG_ 3221225472 ESC_Logger3_Byte1 0;
BA_ "UserSigValidity" SG_ 3221225472 ESC_Logger3_Byte1 0;
BA_ "GenSigSendType" SG_ 3221225472 ESC_Logger3_Byte1 2;
BA_ "UsrSigPurpose" SG_ 3221225472 ESC_Logger3_Byte1 6;
BA_ "Version" SG_ 3221225472 EPB_GST_Byte0 "18.01.08";
BA_ "NetworkRequestHoldingTime" SG_ 3221225472 EPB_GST_Byte0 5000;
BA_ "NetworkRequest" SG_ 3221225472 EPB_GST_Byte0 0;
BA_ "UserSigValidity" SG_ 3221225472 EPB_GST_Byte0 0;
BA_ "GenSigSendType" SG_ 3221225472 EPB_GST_Byte0 2;
BA_ "UsrSigPurpose" SG_ 3221225472 EPB_GST_Byte0 2;
BA_ "Version" SG_ 3221225472 EPB_GST_Byte2 "18.01.08";
BA_ "NetworkRequestHoldingTime" SG_ 3221225472 EPB_GST_Byte2 5000;
BA_ "NetworkRequest" SG_ 3221225472 EPB_GST_Byte2 0;
BA_ "UserSigValidity" SG_ 3221225472 EPB_GST_Byte2 0;
BA_ "GenSigSendType" SG_ 3221225472 EPB_GST_Byte2 2;
BA_ "UsrSigPurpose" SG_ 3221225472 EPB_GST_Byte2 2;
BA_ "Version" SG_ 3221225472 EPB_GST_Byte3 "18.01.08";
BA_ "NetworkRequestHoldingTime" SG_ 3221225472 EPB_GST_Byte3 5000;
BA_ "NetworkRequest" SG_ 3221225472 EPB_GST_Byte3 0;
BA_ "UserSigValidity" SG_ 3221225472 EPB_GST_Byte3 0;
BA_ "GenSigSendType" SG_ 3221225472 EPB_GST_Byte3 2;
BA_ "UsrSigPurpose" SG_ 3221225472 EPB_GST_Byte3 2;
BA_ "Version" SG_ 3221225472 EPB_GST_Byte4 "18.01.08";
BA_ "NetworkRequestHoldingTime" SG_ 3221225472 EPB_GST_Byte4 5000;
BA_ "NetworkRequest" SG_ 3221225472 EPB_GST_Byte4 0;
BA_ "UserSigValidity" SG_ 3221225472 EPB_GST_Byte4 0;
BA_ "GenSigSendType" SG_ 3221225472 EPB_GST_Byte4 2;
BA_ "UsrSigPurpose" SG_ 3221225472 EPB_GST_Byte4 2;
BA_ "Version" SG_ 3221225472 EPB_GST_Byte5 "18.01.08";
BA_ "NetworkRequestHoldingTime" SG_ 3221225472 EPB_GST_Byte5 5000;
BA_ "NetworkRequest" SG_ 3221225472 EPB_GST_Byte5 0;
BA_ "UserSigValidity" SG_ 3221225472 EPB_GST_Byte5 0;
BA_ "GenSigSendType" SG_ 3221225472 EPB_GST_Byte5 2;
BA_ "UsrSigPurpose" SG_ 3221225472 EPB_GST_Byte5 2;
BA_ "Version" SG_ 3221225472 EPB_GST_Byte6 "18.01.08";
BA_ "NetworkRequestHoldingTime" SG_ 3221225472 EPB_GST_Byte6 5000;
BA_ "NetworkRequest" SG_ 3221225472 EPB_GST_Byte6 0;
BA_ "UserSigValidity" SG_ 3221225472 EPB_GST_Byte6 0;
BA_ "GenSigSendType" SG_ 3221225472 EPB_GST_Byte6 2;
BA_ "UsrSigPurpose" SG_ 3221225472 EPB_GST_Byte6 2;
BA_ "Version" SG_ 3221225472 EPB_GST_Byte7 "18.01.08";
BA_ "NetworkRequestHoldingTime" SG_ 3221225472 EPB_GST_Byte7 5000;
BA_ "NetworkRequest" SG_ 3221225472 EPB_GST_Byte7 0;
BA_ "UserSigValidity" SG_ 3221225472 EPB_GST_Byte7 0;
BA_ "GenSigSendType" SG_ 3221225472 EPB_GST_Byte7 2;
BA_ "UsrSigPurpose" SG_ 3221225472 EPB_GST_Byte7 2;
BA_ "Version" SG_ 3221225472 EPB_GST_Byte1 "18.01.08";
BA_ "NetworkRequestHoldingTime" SG_ 3221225472 EPB_GST_Byte1 5000;
BA_ "NetworkRequest" SG_ 3221225472 EPB_GST_Byte1 0;
BA_ "UserSigValidity" SG_ 3221225472 EPB_GST_Byte1 0;
BA_ "GenSigSendType" SG_ 3221225472 EPB_GST_Byte1 2;
BA_ "UsrSigPurpose" SG_ 3221225472 EPB_GST_Byte1 2;
BA_ "Version" SG_ 3221225472 ESC_Logger2_Byte0 "18.08.01";
BA_ "NetworkRequestHoldingTime" SG_ 3221225472 ESC_Logger2_Byte0 5000;
BA_ "NetworkRequest" SG_ 3221225472 ESC_Logger2_Byte0 0;
BA_ "UserSigValidity" SG_ 3221225472 ESC_Logger2_Byte0 0;
BA_ "GenSigSendType" SG_ 3221225472 ESC_Logger2_Byte0 2;
BA_ "UsrSigPurpose" SG_ 3221225472 ESC_Logger2_Byte0 6;
BA_ "Version" SG_ 3221225472 ESC_Logger2_Byte2 "18.08.01";
BA_ "NetworkRequestHoldingTime" SG_ 3221225472 ESC_Logger2_Byte2 5000;
BA_ "NetworkRequest" SG_ 3221225472 ESC_Logger2_Byte2 0;
BA_ "UserSigValidity" SG_ 3221225472 ESC_Logger2_Byte2 0;
BA_ "GenSigSendType" SG_ 3221225472 ESC_Logger2_Byte2 2;
BA_ "UsrSigPurpose" SG_ 3221225472 ESC_Logger2_Byte2 6;
BA_ "Version" SG_ 3221225472 ESC_Logger2_Byte3 "18.08.01";
BA_ "NetworkRequestHoldingTime" SG_ 3221225472 ESC_Logger2_Byte3 5000;
BA_ "NetworkRequest" SG_ 3221225472 ESC_Logger2_Byte3 0;
BA_ "UserSigValidity" SG_ 3221225472 ESC_Logger2_Byte3 0;
BA_ "GenSigSendType" SG_ 3221225472 ESC_Logger2_Byte3 2;
BA_ "UsrSigPurpose" SG_ 3221225472 ESC_Logger2_Byte3 6;
BA_ "Version" SG_ 3221225472 ESC_Logger2_Byte4 "18.08.01";
BA_ "NetworkRequestHoldingTime" SG_ 3221225472 ESC_Logger2_Byte4 5000;
BA_ "NetworkRequest" SG_ 3221225472 ESC_Logger2_Byte4 0;
BA_ "UserSigValidity" SG_ 3221225472 ESC_Logger2_Byte4 0;
BA_ "GenSigSendType" SG_ 3221225472 ESC_Logger2_Byte4 2;
BA_ "UsrSigPurpose" SG_ 3221225472 ESC_Logger2_Byte4 6;
BA_ "Version" SG_ 3221225472 ESC_Logger2_Byte5 "18.08.01";
BA_ "NetworkRequestHoldingTime" SG_ 3221225472 ESC_Logger2_Byte5 5000;
BA_ "NetworkRequest" SG_ 3221225472 ESC_Logger2_Byte5 0;
BA_ "UserSigValidity" SG_ 3221225472 ESC_Logger2_Byte5 0;
BA_ "GenSigSendType" SG_ 3221225472 ESC_Logger2_Byte5 2;
BA_ "UsrSigPurpose" SG_ 3221225472 ESC_Logger2_Byte5 6;
BA_ "Version" SG_ 3221225472 ESC_Logger2_Byte6 "18.08.01";
BA_ "NetworkRequestHoldingTime" SG_ 3221225472 ESC_Logger2_Byte6 5000;
BA_ "NetworkRequest" SG_ 3221225472 ESC_Logger2_Byte6 0;
BA_ "UserSigValidity" SG_ 3221225472 ESC_Logger2_Byte6 0;
BA_ "GenSigSendType" SG_ 3221225472 ESC_Logger2_Byte6 2;
BA_ "UsrSigPurpose" SG_ 3221225472 ESC_Logger2_Byte6 6;
BA_ "Version" SG_ 3221225472 ESC_Logger2_Byte7 "18.08.01";
BA_ "NetworkRequestHoldingTime" SG_ 3221225472 ESC_Logger2_Byte7 5000;
BA_ "NetworkRequest" SG_ 3221225472 ESC_Logger2_Byte7 0;
BA_ "UserSigValidity" SG_ 3221225472 ESC_Logger2_Byte7 0;
BA_ "GenSigSendType" SG_ 3221225472 ESC_Logger2_Byte7 2;
BA_ "UsrSigPurpose" SG_ 3221225472 ESC_Logger2_Byte7 6;
BA_ "Version" SG_ 3221225472 ESC_Logger2_Byte1 "18.08.01";
BA_ "NetworkRequestHoldingTime" SG_ 3221225472 ESC_Logger2_Byte1 5000;
BA_ "NetworkRequest" SG_ 3221225472 ESC_Logger2_Byte1 0;
BA_ "UserSigValidity" SG_ 3221225472 ESC_Logger2_Byte1 0;
BA_ "GenSigSendType" SG_ 3221225472 ESC_Logger2_Byte1 2;
BA_ "UsrSigPurpose" SG_ 3221225472 ESC_Logger2_Byte1 6;
BA_ "Version" SG_ 3221225472 ESC_Logger4_Byte0 "18.08.01";
BA_ "NetworkRequestHoldingTime" SG_ 3221225472 ESC_Logger4_Byte0 5000;
BA_ "NetworkRequest" SG_ 3221225472 ESC_Logger4_Byte0 0;
BA_ "UserSigValidity" SG_ 3221225472 ESC_Logger4_Byte0 0;
BA_ "GenSigSendType" SG_ 3221225472 ESC_Logger4_Byte0 2;
BA_ "UsrSigPurpose" SG_ 3221225472 ESC_Logger4_Byte0 6;
BA_ "Version" SG_ 3221225472 ESC_Logger4_Byte2 "18.08.01";
BA_ "NetworkRequestHoldingTime" SG_ 3221225472 ESC_Logger4_Byte2 5000;
BA_ "NetworkRequest" SG_ 3221225472 ESC_Logger4_Byte2 0;
BA_ "UserSigValidity" SG_ 3221225472 ESC_Logger4_Byte2 0;
BA_ "GenSigSendType" SG_ 3221225472 ESC_Logger4_Byte2 2;
BA_ "UsrSigPurpose" SG_ 3221225472 ESC_Logger4_Byte2 6;
BA_ "Version" SG_ 3221225472 ESC_Logger4_Byte3 "18.08.01";
BA_ "NetworkRequestHoldingTime" SG_ 3221225472 ESC_Logger4_Byte3 5000;
BA_ "NetworkRequest" SG_ 3221225472 ESC_Logger4_Byte3 0;
BA_ "UserSigValidity" SG_ 3221225472 ESC_Logger4_Byte3 0;
BA_ "GenSigSendType" SG_ 3221225472 ESC_Logger4_Byte3 2;
BA_ "UsrSigPurpose" SG_ 3221225472 ESC_Logger4_Byte3 6;
BA_ "Version" SG_ 3221225472 ESC_Logger4_Byte4 "18.08.01";
BA_ "NetworkRequestHoldingTime" SG_ 3221225472 ESC_Logger4_Byte4 5000;
BA_ "NetworkRequest" SG_ 3221225472 ESC_Logger4_Byte4 0;
BA_ "UserSigValidity" SG_ 3221225472 ESC_Logger4_Byte4 0;
BA_ "GenSigSendType" SG_ 3221225472 ESC_Logger4_Byte4 2;
BA_ "UsrSigPurpose" SG_ 3221225472 ESC_Logger4_Byte4 6;
BA_ "Version" SG_ 3221225472 ESC_Logger4_Byte5 "18.08.01";
BA_ "NetworkRequestHoldingTime" SG_ 3221225472 ESC_Logger4_Byte5 5000;
BA_ "NetworkRequest" SG_ 3221225472 ESC_Logger4_Byte5 0;
BA_ "UserSigValidity" SG_ 3221225472 ESC_Logger4_Byte5 0;
BA_ "GenSigSendType" SG_ 3221225472 ESC_Logger4_Byte5 2;
BA_ "UsrSigPurpose" SG_ 3221225472 ESC_Logger4_Byte5 6;
BA_ "Version" SG_ 3221225472 ESC_Logger4_Byte6 "18.08.01";
BA_ "NetworkRequestHoldingTime" SG_ 3221225472 ESC_Logger4_Byte6 5000;
BA_ "NetworkRequest" SG_ 3221225472 ESC_Logger4_Byte6 0;
BA_ "UserSigValidity" SG_ 3221225472 ESC_Logger4_Byte6 0;
BA_ "GenSigSendType" SG_ 3221225472 ESC_Logger4_Byte6 2;
BA_ "UsrSigPurpose" SG_ 3221225472 ESC_Logger4_Byte6 6;
BA_ "Version" SG_ 3221225472 ESC_Logger4_Byte7 "18.08.01";
BA_ "NetworkRequestHoldingTime" SG_ 3221225472 ESC_Logger4_Byte7 5000;
BA_ "NetworkRequest" SG_ 3221225472 ESC_Logger4_Byte7 0;
BA_ "UserSigValidity" SG_ 3221225472 ESC_Logger4_Byte7 0;
BA_ "GenSigSendType" SG_ 3221225472 ESC_Logger4_Byte7 2;
BA_ "UsrSigPurpose" SG_ 3221225472 ESC_Logger4_Byte7 6;
BA_ "Version" SG_ 3221225472 ESC_Logger4_Byte1 "18.08.01";
BA_ "NetworkRequestHoldingTime" SG_ 3221225472 ESC_Logger4_Byte1 5000;
BA_ "NetworkRequest" SG_ 3221225472 ESC_Logger4_Byte1 0;
BA_ "UserSigValidity" SG_ 3221225472 ESC_Logger4_Byte1 0;
BA_ "GenSigSendType" SG_ 3221225472 ESC_Logger4_Byte1 2;
BA_ "UsrSigPurpose" SG_ 3221225472 ESC_Logger4_Byte1 6;
BA_ "Version" SG_ 3221225472 GST_ODS_Byte0 "18.01.08";
BA_ "NetworkRequestHoldingTime" SG_ 3221225472 GST_ODS_Byte0 5000;
BA_ "NetworkRequest" SG_ 3221225472 GST_ODS_Byte0 0;
BA_ "UserSigValidity" SG_ 3221225472 GST_ODS_Byte0 0;
BA_ "GenSigSendType" SG_ 3221225472 GST_ODS_Byte0 2;
BA_ "UsrSigPurpose" SG_ 3221225472 GST_ODS_Byte0 2;
BA_ "Version" SG_ 3221225472 GST_ODS_Byte2 "18.01.08";
BA_ "NetworkRequestHoldingTime" SG_ 3221225472 GST_ODS_Byte2 5000;
BA_ "NetworkRequest" SG_ 3221225472 GST_ODS_Byte2 0;
BA_ "UserSigValidity" SG_ 3221225472 GST_ODS_Byte2 0;
BA_ "GenSigSendType" SG_ 3221225472 GST_ODS_Byte2 2;
BA_ "UsrSigPurpose" SG_ 3221225472 GST_ODS_Byte2 2;
BA_ "Version" SG_ 3221225472 GST_ODS_Byte3 "18.01.08";
BA_ "NetworkRequestHoldingTime" SG_ 3221225472 GST_ODS_Byte3 5000;
BA_ "NetworkRequest" SG_ 3221225472 GST_ODS_Byte3 0;
BA_ "UserSigValidity" SG_ 3221225472 GST_ODS_Byte3 0;
BA_ "GenSigSendType" SG_ 3221225472 GST_ODS_Byte3 2;
BA_ "UsrSigPurpose" SG_ 3221225472 GST_ODS_Byte3 2;
BA_ "Version" SG_ 3221225472 GST_ODS_Byte4 "18.01.08";
BA_ "NetworkRequestHoldingTime" SG_ 3221225472 GST_ODS_Byte4 5000;
BA_ "NetworkRequest" SG_ 3221225472 GST_ODS_Byte4 0;
BA_ "UserSigValidity" SG_ 3221225472 GST_ODS_Byte4 0;
BA_ "GenSigSendType" SG_ 3221225472 GST_ODS_Byte4 2;
BA_ "UsrSigPurpose" SG_ 3221225472 GST_ODS_Byte4 2;
BA_ "Version" SG_ 3221225472 GST_ODS_Byte5 "18.01.08";
BA_ "NetworkRequestHoldingTime" SG_ 3221225472 GST_ODS_Byte5 5000;
BA_ "NetworkRequest" SG_ 3221225472 GST_ODS_Byte5 0;
BA_ "UserSigValidity" SG_ 3221225472 GST_ODS_Byte5 0;
BA_ "GenSigSendType" SG_ 3221225472 GST_ODS_Byte5 2;
BA_ "UsrSigPurpose" SG_ 3221225472 GST_ODS_Byte5 2;
BA_ "Version" SG_ 3221225472 GST_ODS_Byte6 "18.01.08";
BA_ "NetworkRequestHoldingTime" SG_ 3221225472 GST_ODS_Byte6 5000;
BA_ "NetworkRequest" SG_ 3221225472 GST_ODS_Byte6 0;
BA_ "UserSigValidity" SG_ 3221225472 GST_ODS_Byte6 0;
BA_ "GenSigSendType" SG_ 3221225472 GST_ODS_Byte6 2;
BA_ "UsrSigPurpose" SG_ 3221225472 GST_ODS_Byte6 2;
BA_ "Version" SG_ 3221225472 GST_ODS_Byte7 "18.01.08";
BA_ "NetworkRequestHoldingTime" SG_ 3221225472 GST_ODS_Byte7 5000;
BA_ "NetworkRequest" SG_ 3221225472 GST_ODS_Byte7 0;
BA_ "UserSigValidity" SG_ 3221225472 GST_ODS_Byte7 0;
BA_ "GenSigSendType" SG_ 3221225472 GST_ODS_Byte7 2;
BA_ "UsrSigPurpose" SG_ 3221225472 GST_ODS_Byte7 2;
BA_ "Version" SG_ 3221225472 GST_ODS_Byte1 "18.01.08";
BA_ "NetworkRequestHoldingTime" SG_ 3221225472 GST_ODS_Byte1 5000;
BA_ "NetworkRequest" SG_ 3221225472 GST_ODS_Byte1 0;
BA_ "UserSigValidity" SG_ 3221225472 GST_ODS_Byte1 0;
BA_ "GenSigSendType" SG_ 3221225472 GST_ODS_Byte1 2;
BA_ "UsrSigPurpose" SG_ 3221225472 GST_ODS_Byte1 2;
BA_ "Version" SG_ 3221225472 ESC_Logger5_Byte0 "18.08.01";
BA_ "NetworkRequestHoldingTime" SG_ 3221225472 ESC_Logger5_Byte0 5000;
BA_ "NetworkRequest" SG_ 3221225472 ESC_Logger5_Byte0 0;
BA_ "UserSigValidity" SG_ 3221225472 ESC_Logger5_Byte0 0;
BA_ "GenSigSendType" SG_ 3221225472 ESC_Logger5_Byte0 2;
BA_ "UsrSigPurpose" SG_ 3221225472 ESC_Logger5_Byte0 6;
BA_ "Version" SG_ 3221225472 ESC_Logger5_Byte2 "18.08.01";
BA_ "NetworkRequestHoldingTime" SG_ 3221225472 ESC_Logger5_Byte2 5000;
BA_ "NetworkRequest" SG_ 3221225472 ESC_Logger5_Byte2 0;
BA_ "UserSigValidity" SG_ 3221225472 ESC_Logger5_Byte2 0;
BA_ "GenSigSendType" SG_ 3221225472 ESC_Logger5_Byte2 2;
BA_ "UsrSigPurpose" SG_ 3221225472 ESC_Logger5_Byte2 6;
BA_ "Version" SG_ 3221225472 ESC_Logger5_Byte3 "18.08.01";
BA_ "NetworkRequestHoldingTime" SG_ 3221225472 ESC_Logger5_Byte3 5000;
BA_ "NetworkRequest" SG_ 3221225472 ESC_Logger5_Byte3 0;
BA_ "UserSigValidity" SG_ 3221225472 ESC_Logger5_Byte3 0;
BA_ "GenSigSendType" SG_ 3221225472 ESC_Logger5_Byte3 2;
BA_ "UsrSigPurpose" SG_ 3221225472 ESC_Logger5_Byte3 6;
BA_ "Version" SG_ 3221225472 ESC_Logger5_Byte4 "18.08.01";
BA_ "NetworkRequestHoldingTime" SG_ 3221225472 ESC_Logger5_Byte4 5000;
BA_ "NetworkRequest" SG_ 3221225472 ESC_Logger5_Byte4 0;
BA_ "UserSigValidity" SG_ 3221225472 ESC_Logger5_Byte4 0;
BA_ "GenSigSendType" SG_ 3221225472 ESC_Logger5_Byte4 2;
BA_ "UsrSigPurpose" SG_ 3221225472 ESC_Logger5_Byte4 6;
BA_ "Version" SG_ 3221225472 ESC_Logger5_Byte5 "18.08.01";
BA_ "NetworkRequestHoldingTime" SG_ 3221225472 ESC_Logger5_Byte5 5000;
BA_ "NetworkRequest" SG_ 3221225472 ESC_Logger5_Byte5 0;
BA_ "UserSigValidity" SG_ 3221225472 ESC_Logger5_Byte5 0;
BA_ "GenSigSendType" SG_ 3221225472 ESC_Logger5_Byte5 2;
BA_ "UsrSigPurpose" SG_ 3221225472 ESC_Logger5_Byte5 6;
BA_ "Version" SG_ 3221225472 ESC_Logger5_Byte6 "18.08.01";
BA_ "NetworkRequestHoldingTime" SG_ 3221225472 ESC_Logger5_Byte6 5000;
BA_ "NetworkRequest" SG_ 3221225472 ESC_Logger5_Byte6 0;
BA_ "UserSigValidity" SG_ 3221225472 ESC_Logger5_Byte6 0;
BA_ "GenSigSendType" SG_ 3221225472 ESC_Logger5_Byte6 2;
BA_ "UsrSigPurpose" SG_ 3221225472 ESC_Logger5_Byte6 6;
BA_ "Version" SG_ 3221225472 ESC_Logger5_Byte7 "18.08.01";
BA_ "NetworkRequestHoldingTime" SG_ 3221225472 ESC_Logger5_Byte7 5000;
BA_ "NetworkRequest" SG_ 3221225472 ESC_Logger5_Byte7 0;
BA_ "UserSigValidity" SG_ 3221225472 ESC_Logger5_Byte7 0;
BA_ "GenSigSendType" SG_ 3221225472 ESC_Logger5_Byte7 2;
BA_ "UsrSigPurpose" SG_ 3221225472 ESC_Logger5_Byte7 6;
BA_ "Version" SG_ 3221225472 ESC_Logger5_Byte1 "18.08.01";
BA_ "NetworkRequestHoldingTime" SG_ 3221225472 ESC_Logger5_Byte1 5000;
BA_ "NetworkRequest" SG_ 3221225472 ESC_Logger5_Byte1 0;
BA_ "UserSigValidity" SG_ 3221225472 ESC_Logger5_Byte1 0;
BA_ "GenSigSendType" SG_ 3221225472 ESC_Logger5_Byte1 2;
BA_ "UsrSigPurpose" SG_ 3221225472 ESC_Logger5_Byte1 6;
BA_ "Version" SG_ 3221225472 ESC_Logger6_Byte0 "18.08.01";
BA_ "NetworkRequestHoldingTime" SG_ 3221225472 ESC_Logger6_Byte0 5000;
BA_ "NetworkRequest" SG_ 3221225472 ESC_Logger6_Byte0 0;
BA_ "UserSigValidity" SG_ 3221225472 ESC_Logger6_Byte0 0;
BA_ "GenSigSendType" SG_ 3221225472 ESC_Logger6_Byte0 2;
BA_ "UsrSigPurpose" SG_ 3221225472 ESC_Logger6_Byte0 6;
BA_ "Version" SG_ 3221225472 ESC_Logger6_Byte2 "18.08.01";
BA_ "NetworkRequestHoldingTime" SG_ 3221225472 ESC_Logger6_Byte2 5000;
BA_ "NetworkRequest" SG_ 3221225472 ESC_Logger6_Byte2 0;
BA_ "UserSigValidity" SG_ 3221225472 ESC_Logger6_Byte2 0;
BA_ "GenSigSendType" SG_ 3221225472 ESC_Logger6_Byte2 2;
BA_ "UsrSigPurpose" SG_ 3221225472 ESC_Logger6_Byte2 6;
BA_ "Version" SG_ 3221225472 ESC_Logger6_Byte3 "18.08.01";
BA_ "NetworkRequestHoldingTime" SG_ 3221225472 ESC_Logger6_Byte3 5000;
BA_ "NetworkRequest" SG_ 3221225472 ESC_Logger6_Byte3 0;
BA_ "UserSigValidity" SG_ 3221225472 ESC_Logger6_Byte3 0;
BA_ "GenSigSendType" SG_ 3221225472 ESC_Logger6_Byte3 2;
BA_ "UsrSigPurpose" SG_ 3221225472 ESC_Logger6_Byte3 6;
BA_ "Version" SG_ 3221225472 ESC_Logger6_Byte4 "18.08.01";
BA_ "NetworkRequestHoldingTime" SG_ 3221225472 ESC_Logger6_Byte4 5000;
BA_ "NetworkRequest" SG_ 3221225472 ESC_Logger6_Byte4 0;
BA_ "UserSigValidity" SG_ 3221225472 ESC_Logger6_Byte4 0;
BA_ "GenSigSendType" SG_ 3221225472 ESC_Logger6_Byte4 2;
BA_ "UsrSigPurpose" SG_ 3221225472 ESC_Logger6_Byte4 6;
BA_ "Version" SG_ 3221225472 ESC_Logger6_Byte5 "18.08.01";
BA_ "NetworkRequestHoldingTime" SG_ 3221225472 ESC_Logger6_Byte5 5000;
BA_ "NetworkRequest" SG_ 3221225472 ESC_Logger6_Byte5 0;
BA_ "UserSigValidity" SG_ 3221225472 ESC_Logger6_Byte5 0;
BA_ "GenSigSendType" SG_ 3221225472 ESC_Logger6_Byte5 2;
BA_ "UsrSigPurpose" SG_ 3221225472 ESC_Logger6_Byte5 6;
BA_ "Version" SG_ 3221225472 ESC_Logger6_Byte6 "18.08.01";
BA_ "NetworkRequestHoldingTime" SG_ 3221225472 ESC_Logger6_Byte6 5000;
BA_ "NetworkRequest" SG_ 3221225472 ESC_Logger6_Byte6 0;
BA_ "UserSigValidity" SG_ 3221225472 ESC_Logger6_Byte6 0;
BA_ "GenSigSendType" SG_ 3221225472 ESC_Logger6_Byte6 2;
BA_ "UsrSigPurpose" SG_ 3221225472 ESC_Logger6_Byte6 6;
BA_ "Version" SG_ 3221225472 ESC_Logger6_Byte7 "18.08.01";
BA_ "NetworkRequestHoldingTime" SG_ 3221225472 ESC_Logger6_Byte7 5000;
BA_ "NetworkRequest" SG_ 3221225472 ESC_Logger6_Byte7 0;
BA_ "UserSigValidity" SG_ 3221225472 ESC_Logger6_Byte7 0;
BA_ "GenSigSendType" SG_ 3221225472 ESC_Logger6_Byte7 2;
BA_ "UsrSigPurpose" SG_ 3221225472 ESC_Logger6_Byte7 6;
BA_ "Version" SG_ 3221225472 ESC_Logger6_Byte1 "18.08.01";
BA_ "NetworkRequestHoldingTime" SG_ 3221225472 ESC_Logger6_Byte1 5000;
BA_ "NetworkRequest" SG_ 3221225472 ESC_Logger6_Byte1 0;
BA_ "UserSigValidity" SG_ 3221225472 ESC_Logger6_Byte1 0;
BA_ "GenSigSendType" SG_ 3221225472 ESC_Logger6_Byte1 2;
BA_ "UsrSigPurpose" SG_ 3221225472 ESC_Logger6_Byte1 6;
BA_ "Version" SG_ 3221225472 ESC_Logger7_Byte0 "18.08.01";
BA_ "NetworkRequestHoldingTime" SG_ 3221225472 ESC_Logger7_Byte0 5000;
BA_ "NetworkRequest" SG_ 3221225472 ESC_Logger7_Byte0 0;
BA_ "UserSigValidity" SG_ 3221225472 ESC_Logger7_Byte0 0;
BA_ "GenSigSendType" SG_ 3221225472 ESC_Logger7_Byte0 2;
BA_ "UsrSigPurpose" SG_ 3221225472 ESC_Logger7_Byte0 6;
BA_ "Version" SG_ 3221225472 ESC_Logger7_Byte2 "18.08.01";
BA_ "NetworkRequestHoldingTime" SG_ 3221225472 ESC_Logger7_Byte2 5000;
BA_ "NetworkRequest" SG_ 3221225472 ESC_Logger7_Byte2 0;
BA_ "UserSigValidity" SG_ 3221225472 ESC_Logger7_Byte2 0;
BA_ "GenSigSendType" SG_ 3221225472 ESC_Logger7_Byte2 2;
BA_ "UsrSigPurpose" SG_ 3221225472 ESC_Logger7_Byte2 6;
BA_ "Version" SG_ 3221225472 ESC_Logger7_Byte3 "18.08.01";
BA_ "NetworkRequestHoldingTime" SG_ 3221225472 ESC_Logger7_Byte3 5000;
BA_ "NetworkRequest" SG_ 3221225472 ESC_Logger7_Byte3 0;
BA_ "UserSigValidity" SG_ 3221225472 ESC_Logger7_Byte3 0;
BA_ "GenSigSendType" SG_ 3221225472 ESC_Logger7_Byte3 2;
BA_ "UsrSigPurpose" SG_ 3221225472 ESC_Logger7_Byte3 6;
BA_ "Version" SG_ 3221225472 ESC_Logger7_Byte4 "18.08.01";
BA_ "NetworkRequestHoldingTime" SG_ 3221225472 ESC_Logger7_Byte4 5000;
BA_ "NetworkRequest" SG_ 3221225472 ESC_Logger7_Byte4 0;
BA_ "UserSigValidity" SG_ 3221225472 ESC_Logger7_Byte4 0;
BA_ "GenSigSendType" SG_ 3221225472 ESC_Logger7_Byte4 2;
BA_ "UsrSigPurpose" SG_ 3221225472 ESC_Logger7_Byte4 6;
BA_ "Version" SG_ 3221225472 ESC_Logger7_Byte5 "18.08.01";
BA_ "NetworkRequestHoldingTime" SG_ 3221225472 ESC_Logger7_Byte5 5000;
BA_ "NetworkRequest" SG_ 3221225472 ESC_Logger7_Byte5 0;
BA_ "UserSigValidity" SG_ 3221225472 ESC_Logger7_Byte5 0;
BA_ "GenSigSendType" SG_ 3221225472 ESC_Logger7_Byte5 2;
BA_ "UsrSigPurpose" SG_ 3221225472 ESC_Logger7_Byte5 6;
BA_ "Version" SG_ 3221225472 ESC_Logger7_Byte6 "18.08.01";
BA_ "NetworkRequestHoldingTime" SG_ 3221225472 ESC_Logger7_Byte6 5000;
BA_ "NetworkRequest" SG_ 3221225472 ESC_Logger7_Byte6 0;
BA_ "UserSigValidity" SG_ 3221225472 ESC_Logger7_Byte6 0;
BA_ "GenSigSendType" SG_ 3221225472 ESC_Logger7_Byte6 2;
BA_ "UsrSigPurpose" SG_ 3221225472 ESC_Logger7_Byte6 6;
BA_ "Version" SG_ 3221225472 ESC_Logger7_Byte7 "18.08.01";
BA_ "NetworkRequestHoldingTime" SG_ 3221225472 ESC_Logger7_Byte7 5000;
BA_ "NetworkRequest" SG_ 3221225472 ESC_Logger7_Byte7 0;
BA_ "UserSigValidity" SG_ 3221225472 ESC_Logger7_Byte7 0;
BA_ "GenSigSendType" SG_ 3221225472 ESC_Logger7_Byte7 2;
BA_ "UsrSigPurpose" SG_ 3221225472 ESC_Logger7_Byte7 6;
BA_ "Version" SG_ 3221225472 ESC_Logger7_Byte1 "18.08.01";
BA_ "NetworkRequestHoldingTime" SG_ 3221225472 ESC_Logger7_Byte1 5000;
BA_ "NetworkRequest" SG_ 3221225472 ESC_Logger7_Byte1 0;
BA_ "UserSigValidity" SG_ 3221225472 ESC_Logger7_Byte1 0;
BA_ "GenSigSendType" SG_ 3221225472 ESC_Logger7_Byte1 2;
BA_ "UsrSigPurpose" SG_ 3221225472 ESC_Logger7_Byte1 6;
BA_ "Version" SG_ 3221225472 HU_LanguageInfo "18.09.02";
BA_ "NetworkRequest" SG_ 3221225472 HU_LanguageInfo 0;
BA_ "UserSigValidity" SG_ 3221225472 HU_LanguageInfo 1;
BA_ "GenSigStartValue" SG_ 3221225472 HU_LanguageInfo 255;
BA_ "GenSigSendType" SG_ 3221225472 HU_LanguageInfo 4;
BA_ "Version" SG_ 3221225472 HU_MuteStatus "18.04.02";
BA_ "NetworkRequest" SG_ 3221225472 HU_MuteStatus 0;
BA_ "UserSigValidity" SG_ 3221225472 HU_MuteStatus 1;
BA_ "GenSigStartValue" SG_ 3221225472 HU_MuteStatus 3;
BA_ "GenSigSendType" SG_ 3221225472 HU_MuteStatus 4;
BA_ "Version" SG_ 3221225472 HU_WelcomeReady "19.04.06";
BA_ "UserSigValidity" SG_ 3221225472 HU_WelcomeReady 0;
BA_ "GenSigSendType" SG_ 3221225472 HU_WelcomeReady 4;
BA_ "Description" SG_ 3221225472 HU_WelcomeReady "HU playback ready signal to play welcome animation video";
BA_ "Version" SG_ 3221225472 HU_UsmSupport "18.04.02";
BA_ "UserSigValidity" SG_ 3221225472 HU_UsmSupport 1;
BA_ "GenSigStartValue" SG_ 3221225472 HU_UsmSupport 3;
BA_ "GenSigSendType" SG_ 3221225472 HU_UsmSupport 4;
BA_ "Version" SG_ 3221225472 HU_NaviStatus "18.11.01";
BA_ "NetworkRequest" SG_ 3221225472 HU_NaviStatus 0;
BA_ "UserSigValidity" SG_ 3221225472 HU_NaviStatus 1;
BA_ "GenSigSendType" SG_ 3221225472 HU_NaviStatus 4;
BA_ "Version" SG_ 3221225472 HU_NaviDisp "18.04.02";
BA_ "NetworkRequest" SG_ 3221225472 HU_NaviDisp 0;
BA_ "UserSigValidity" SG_ 3221225472 HU_NaviDisp 1;
BA_ "GenSigStartValue" SG_ 3221225472 HU_NaviDisp 3;
BA_ "GenSigSendType" SG_ 3221225472 HU_NaviDisp 4;
BA_ "Version" SG_ 3221225472 HU_BVM_Display_Message "18.09.02";
BA_ "UserSigValidity" SG_ 3221225472 HU_BVM_Display_Message 3;
BA_ "GenSigStartValue" SG_ 3221225472 HU_BVM_Display_Message 7;
BA_ "GenSigSendType" SG_ 3221225472 HU_BVM_Display_Message 4;
BA_ "Version" SG_ 3221225472 HU_SVM_View_Display "18.04.02";
BA_ "UserSigValidity" SG_ 3221225472 HU_SVM_View_Display 3;
BA_ "GenSigStartValue" SG_ 3221225472 HU_SVM_View_Display 31;
BA_ "GenSigSendType" SG_ 3221225472 HU_SVM_View_Display 4;
BA_ "Version" SG_ 3221225472 HU_NaviCamSettingStatus "18.09.02";
BA_ "NetworkRequest" SG_ 3221225472 HU_NaviCamSettingStatus 0;
BA_ "UserSigValidity" SG_ 3221225472 HU_NaviCamSettingStatus 1;
BA_ "GenSigStartValue" SG_ 3221225472 HU_NaviCamSettingStatus 255;
BA_ "GenSigSendType" SG_ 3221225472 HU_NaviCamSettingStatus 4;
BA_ "Version" SG_ 3221225472 HU_VolumeStatus "18.04.02";
BA_ "NetworkRequest" SG_ 3221225472 HU_VolumeStatus 0;
BA_ "UserSigValidity" SG_ 3221225472 HU_VolumeStatus 1;
BA_ "GenSigStartValue" SG_ 3221225472 HU_VolumeStatus 63;
BA_ "GenSigSendType" SG_ 3221225472 HU_VolumeStatus 4;
BA_ "Version" SG_ 3221225472 ESC_Logger8_Byte0 "18.08.01";
BA_ "NetworkRequestHoldingTime" SG_ 3221225472 ESC_Logger8_Byte0 5000;
BA_ "NetworkRequest" SG_ 3221225472 ESC_Logger8_Byte0 0;
BA_ "UserSigValidity" SG_ 3221225472 ESC_Logger8_Byte0 0;
BA_ "GenSigSendType" SG_ 3221225472 ESC_Logger8_Byte0 2;
BA_ "UsrSigPurpose" SG_ 3221225472 ESC_Logger8_Byte0 6;
BA_ "Version" SG_ 3221225472 ESC_Logger8_Byte2 "18.08.01";
BA_ "NetworkRequestHoldingTime" SG_ 3221225472 ESC_Logger8_Byte2 5000;
BA_ "NetworkRequest" SG_ 3221225472 ESC_Logger8_Byte2 0;
BA_ "UserSigValidity" SG_ 3221225472 ESC_Logger8_Byte2 0;
BA_ "GenSigSendType" SG_ 3221225472 ESC_Logger8_Byte2 2;
BA_ "UsrSigPurpose" SG_ 3221225472 ESC_Logger8_Byte2 6;
BA_ "Version" SG_ 3221225472 ESC_Logger8_Byte3 "18.08.01";
BA_ "NetworkRequestHoldingTime" SG_ 3221225472 ESC_Logger8_Byte3 5000;
BA_ "NetworkRequest" SG_ 3221225472 ESC_Logger8_Byte3 0;
BA_ "UserSigValidity" SG_ 3221225472 ESC_Logger8_Byte3 0;
BA_ "GenSigSendType" SG_ 3221225472 ESC_Logger8_Byte3 2;
BA_ "UsrSigPurpose" SG_ 3221225472 ESC_Logger8_Byte3 6;
BA_ "Version" SG_ 3221225472 ESC_Logger8_Byte4 "18.08.01";
BA_ "NetworkRequestHoldingTime" SG_ 3221225472 ESC_Logger8_Byte4 5000;
BA_ "NetworkRequest" SG_ 3221225472 ESC_Logger8_Byte4 0;
BA_ "UserSigValidity" SG_ 3221225472 ESC_Logger8_Byte4 0;
BA_ "GenSigSendType" SG_ 3221225472 ESC_Logger8_Byte4 2;
BA_ "UsrSigPurpose" SG_ 3221225472 ESC_Logger8_Byte4 6;
BA_ "Version" SG_ 3221225472 ESC_Logger8_Byte5 "18.08.01";
BA_ "NetworkRequestHoldingTime" SG_ 3221225472 ESC_Logger8_Byte5 5000;
BA_ "NetworkRequest" SG_ 3221225472 ESC_Logger8_Byte5 0;
BA_ "UserSigValidity" SG_ 3221225472 ESC_Logger8_Byte5 0;
BA_ "GenSigSendType" SG_ 3221225472 ESC_Logger8_Byte5 2;
BA_ "UsrSigPurpose" SG_ 3221225472 ESC_Logger8_Byte5 6;
BA_ "Version" SG_ 3221225472 ESC_Logger8_Byte6 "18.08.01";
BA_ "NetworkRequestHoldingTime" SG_ 3221225472 ESC_Logger8_Byte6 5000;
BA_ "NetworkRequest" SG_ 3221225472 ESC_Logger8_Byte6 0;
BA_ "UserSigValidity" SG_ 3221225472 ESC_Logger8_Byte6 0;
BA_ "GenSigSendType" SG_ 3221225472 ESC_Logger8_Byte6 2;
BA_ "UsrSigPurpose" SG_ 3221225472 ESC_Logger8_Byte6 6;
BA_ "Version" SG_ 3221225472 ESC_Logger8_Byte7 "18.08.01";
BA_ "NetworkRequestHoldingTime" SG_ 3221225472 ESC_Logger8_Byte7 5000;
BA_ "NetworkRequest" SG_ 3221225472 ESC_Logger8_Byte7 0;
BA_ "UserSigValidity" SG_ 3221225472 ESC_Logger8_Byte7 0;
BA_ "GenSigSendType" SG_ 3221225472 ESC_Logger8_Byte7 2;
BA_ "UsrSigPurpose" SG_ 3221225472 ESC_Logger8_Byte7 6;
BA_ "Version" SG_ 3221225472 ESC_Logger8_Byte1 "18.08.01";
BA_ "NetworkRequestHoldingTime" SG_ 3221225472 ESC_Logger8_Byte1 5000;
BA_ "NetworkRequest" SG_ 3221225472 ESC_Logger8_Byte1 0;
BA_ "UserSigValidity" SG_ 3221225472 ESC_Logger8_Byte1 0;
BA_ "GenSigSendType" SG_ 3221225472 ESC_Logger8_Byte1 2;
BA_ "UsrSigPurpose" SG_ 3221225472 ESC_Logger8_Byte1 6;
BA_ "Version" SG_ 3221225472 ESC_Logger9_Byte0 "18.08.01";
BA_ "NetworkRequestHoldingTime" SG_ 3221225472 ESC_Logger9_Byte0 5000;
BA_ "NetworkRequest" SG_ 3221225472 ESC_Logger9_Byte0 0;
BA_ "UserSigValidity" SG_ 3221225472 ESC_Logger9_Byte0 0;
BA_ "GenSigSendType" SG_ 3221225472 ESC_Logger9_Byte0 2;
BA_ "UsrSigPurpose" SG_ 3221225472 ESC_Logger9_Byte0 6;
BA_ "Version" SG_ 3221225472 ESC_Logger9_Byte2 "18.08.01";
BA_ "NetworkRequestHoldingTime" SG_ 3221225472 ESC_Logger9_Byte2 5000;
BA_ "NetworkRequest" SG_ 3221225472 ESC_Logger9_Byte2 0;
BA_ "UserSigValidity" SG_ 3221225472 ESC_Logger9_Byte2 0;
BA_ "GenSigSendType" SG_ 3221225472 ESC_Logger9_Byte2 2;
BA_ "UsrSigPurpose" SG_ 3221225472 ESC_Logger9_Byte2 6;
BA_ "Version" SG_ 3221225472 ESC_Logger9_Byte3 "18.08.01";
BA_ "NetworkRequestHoldingTime" SG_ 3221225472 ESC_Logger9_Byte3 5000;
BA_ "NetworkRequest" SG_ 3221225472 ESC_Logger9_Byte3 0;
BA_ "UserSigValidity" SG_ 3221225472 ESC_Logger9_Byte3 0;
BA_ "GenSigSendType" SG_ 3221225472 ESC_Logger9_Byte3 2;
BA_ "UsrSigPurpose" SG_ 3221225472 ESC_Logger9_Byte3 6;
BA_ "Version" SG_ 3221225472 ESC_Logger9_Byte4 "18.08.01";
BA_ "NetworkRequestHoldingTime" SG_ 3221225472 ESC_Logger9_Byte4 5000;
BA_ "NetworkRequest" SG_ 3221225472 ESC_Logger9_Byte4 0;
BA_ "UserSigValidity" SG_ 3221225472 ESC_Logger9_Byte4 0;
BA_ "GenSigSendType" SG_ 3221225472 ESC_Logger9_Byte4 2;
BA_ "UsrSigPurpose" SG_ 3221225472 ESC_Logger9_Byte4 6;
BA_ "Version" SG_ 3221225472 ESC_Logger9_Byte5 "18.08.01";
BA_ "NetworkRequestHoldingTime" SG_ 3221225472 ESC_Logger9_Byte5 5000;
BA_ "NetworkRequest" SG_ 3221225472 ESC_Logger9_Byte5 0;
BA_ "UserSigValidity" SG_ 3221225472 ESC_Logger9_Byte5 0;
BA_ "GenSigSendType" SG_ 3221225472 ESC_Logger9_Byte5 2;
BA_ "UsrSigPurpose" SG_ 3221225472 ESC_Logger9_Byte5 6;
BA_ "Version" SG_ 3221225472 ESC_Logger9_Byte6 "18.08.01";
BA_ "NetworkRequestHoldingTime" SG_ 3221225472 ESC_Logger9_Byte6 5000;
BA_ "NetworkRequest" SG_ 3221225472 ESC_Logger9_Byte6 0;
BA_ "UserSigValidity" SG_ 3221225472 ESC_Logger9_Byte6 0;
BA_ "GenSigSendType" SG_ 3221225472 ESC_Logger9_Byte6 2;
BA_ "UsrSigPurpose" SG_ 3221225472 ESC_Logger9_Byte6 6;
BA_ "Version" SG_ 3221225472 ESC_Logger9_Byte7 "18.08.01";
BA_ "NetworkRequestHoldingTime" SG_ 3221225472 ESC_Logger9_Byte7 5000;
BA_ "NetworkRequest" SG_ 3221225472 ESC_Logger9_Byte7 0;
BA_ "UserSigValidity" SG_ 3221225472 ESC_Logger9_Byte7 0;
BA_ "GenSigSendType" SG_ 3221225472 ESC_Logger9_Byte7 2;
BA_ "UsrSigPurpose" SG_ 3221225472 ESC_Logger9_Byte7 6;
BA_ "Version" SG_ 3221225472 ESC_Logger9_Byte1 "18.08.01";
BA_ "NetworkRequestHoldingTime" SG_ 3221225472 ESC_Logger9_Byte1 5000;
BA_ "NetworkRequest" SG_ 3221225472 ESC_Logger9_Byte1 0;
BA_ "UserSigValidity" SG_ 3221225472 ESC_Logger9_Byte1 0;
BA_ "GenSigSendType" SG_ 3221225472 ESC_Logger9_Byte1 2;
BA_ "UsrSigPurpose" SG_ 3221225472 ESC_Logger9_Byte1 6;
BA_ "Version" SG_ 3221225472 HU_TimeSetting "18.09.02";
BA_ "NetworkRequest" SG_ 3221225472 HU_TimeSetting 0;
BA_ "UserSigValidity" SG_ 3221225472 HU_TimeSetting 0;
BA_ "GenSigStartValue" SG_ 3221225472 HU_TimeSetting 3;
BA_ "GenSigSendType" SG_ 3221225472 HU_TimeSetting 4;
BA_ "Version" SG_ 3221225472 HU_DisplayMinute "18.09.02";
BA_ "NetworkRequest" SG_ 3221225472 HU_DisplayMinute 0;
BA_ "UserSigValidity" SG_ 3221225472 HU_DisplayMinute 0;
BA_ "GenSigStartValue" SG_ 3221225472 HU_DisplayMinute 255;
BA_ "GenSigSendType" SG_ 3221225472 HU_DisplayMinute 4;
BA_ "Version" SG_ 3221225472 HU_Status "18.09.02";
BA_ "NetworkRequest" SG_ 3221225472 HU_Status 0;
BA_ "UserSigValidity" SG_ 3221225472 HU_Status 0;
BA_ "GenSigStartValue" SG_ 3221225472 HU_Status 15;
BA_ "GenSigSendType" SG_ 3221225472 HU_Status 4;
BA_ "Version" SG_ 3221225472 HU_DisplaySecond "18.09.02";
BA_ "NetworkRequest" SG_ 3221225472 HU_DisplaySecond 0;
BA_ "UserSigValidity" SG_ 3221225472 HU_DisplaySecond 0;
BA_ "GenSigStartValue" SG_ 3221225472 HU_DisplaySecond 255;
BA_ "GenSigSendType" SG_ 3221225472 HU_DisplaySecond 4;
BA_ "Version" SG_ 3221225472 HU_DisplayMonth "18.09.02";
BA_ "NetworkRequest" SG_ 3221225472 HU_DisplayMonth 0;
BA_ "UserSigValidity" SG_ 3221225472 HU_DisplayMonth 0;
BA_ "GenSigStartValue" SG_ 3221225472 HU_DisplayMonth 15;
BA_ "GenSigSendType" SG_ 3221225472 HU_DisplayMonth 4;
BA_ "Version" SG_ 3221225472 HU_DisplayYear1 "18.09.02";
BA_ "NetworkRequest" SG_ 3221225472 HU_DisplayYear1 0;
BA_ "UserSigValidity" SG_ 3221225472 HU_DisplayYear1 0;
BA_ "GenSigStartValue" SG_ 3221225472 HU_DisplayYear1 3;
BA_ "GenSigSendType" SG_ 3221225472 HU_DisplayYear1 4;
BA_ "Version" SG_ 3221225472 HU_DisplayYear2 "18.09.02";
BA_ "NetworkRequest" SG_ 3221225472 HU_DisplayYear2 0;
BA_ "UserSigValidity" SG_ 3221225472 HU_DisplayYear2 0;
BA_ "GenSigStartValue" SG_ 3221225472 HU_DisplayYear2 255;
BA_ "GenSigSendType" SG_ 3221225472 HU_DisplayYear2 4;
BA_ "Version" SG_ 3221225472 HU_DisplayDay "18.09.02";
BA_ "NetworkRequest" SG_ 3221225472 HU_DisplayDay 0;
BA_ "UserSigValidity" SG_ 3221225472 HU_DisplayDay 0;
BA_ "GenSigStartValue" SG_ 3221225472 HU_DisplayDay 255;
BA_ "GenSigSendType" SG_ 3221225472 HU_DisplayDay 4;
BA_ "Version" SG_ 3221225472 HU_AM_PM_INFO "18.09.02";
BA_ "NetworkRequest" SG_ 3221225472 HU_AM_PM_INFO 0;
BA_ "UserSigValidity" SG_ 3221225472 HU_AM_PM_INFO 0;
BA_ "GenSigStartValue" SG_ 3221225472 HU_AM_PM_INFO 3;
BA_ "GenSigSendType" SG_ 3221225472 HU_AM_PM_INFO 4;
BA_ "Version" SG_ 3221225472 HU_ZeroDetection "18.06.03";
BA_ "UserSigValidity" SG_ 3221225472 HU_ZeroDetection 1;
BA_ "GenSigSendType" SG_ 3221225472 HU_ZeroDetection 4;
BA_ "Version" SG_ 3221225472 HU_TimeFormat "18.09.02";
BA_ "NetworkRequest" SG_ 3221225472 HU_TimeFormat 0;
BA_ "UserSigValidity" SG_ 3221225472 HU_TimeFormat 0;
BA_ "GenSigStartValue" SG_ 3221225472 HU_TimeFormat 3;
BA_ "GenSigSendType" SG_ 3221225472 HU_TimeFormat 4;
BA_ "Version" SG_ 3221225472 HU_ComRefresh "18.09.02";
BA_ "NetworkRequest" SG_ 3221225472 HU_ComRefresh 0;
BA_ "UserSigValidity" SG_ 3221225472 HU_ComRefresh 0;
BA_ "GenSigStartValue" SG_ 3221225472 HU_ComRefresh 3;
BA_ "GenSigSendType" SG_ 3221225472 HU_ComRefresh 4;
BA_ "Version" SG_ 3221225472 HU_ClockInfo "18.09.02";
BA_ "NetworkRequest" SG_ 3221225472 HU_ClockInfo 0;
BA_ "UserSigValidity" SG_ 3221225472 HU_ClockInfo 0;
BA_ "GenSigStartValue" SG_ 3221225472 HU_ClockInfo 3;
BA_ "GenSigSendType" SG_ 3221225472 HU_ClockInfo 4;
BA_ "Version" SG_ 3221225472 HU_DisplayHour "18.09.02";
BA_ "NetworkRequest" SG_ 3221225472 HU_DisplayHour 0;
BA_ "UserSigValidity" SG_ 3221225472 HU_DisplayHour 0;
BA_ "GenSigStartValue" SG_ 3221225472 HU_DisplayHour 255;
BA_ "GenSigSendType" SG_ 3221225472 HU_DisplayHour 4;
BA_ "Version" SG_ 3221225472 ESC_Logger10_Byte0 "18.08.01";
BA_ "NetworkRequestHoldingTime" SG_ 3221225472 ESC_Logger10_Byte0 5000;
BA_ "NetworkRequest" SG_ 3221225472 ESC_Logger10_Byte0 0;
BA_ "UserSigValidity" SG_ 3221225472 ESC_Logger10_Byte0 0;
BA_ "GenSigSendType" SG_ 3221225472 ESC_Logger10_Byte0 2;
BA_ "UsrSigPurpose" SG_ 3221225472 ESC_Logger10_Byte0 6;
BA_ "Version" SG_ 3221225472 ESC_Logger10_Byte2 "18.08.01";
BA_ "NetworkRequestHoldingTime" SG_ 3221225472 ESC_Logger10_Byte2 5000;
BA_ "NetworkRequest" SG_ 3221225472 ESC_Logger10_Byte2 0;
BA_ "UserSigValidity" SG_ 3221225472 ESC_Logger10_Byte2 0;
BA_ "GenSigSendType" SG_ 3221225472 ESC_Logger10_Byte2 2;
BA_ "UsrSigPurpose" SG_ 3221225472 ESC_Logger10_Byte2 6;
BA_ "Version" SG_ 3221225472 ESC_Logger10_Byte3 "18.08.01";
BA_ "NetworkRequestHoldingTime" SG_ 3221225472 ESC_Logger10_Byte3 5000;
BA_ "NetworkRequest" SG_ 3221225472 ESC_Logger10_Byte3 0;
BA_ "UserSigValidity" SG_ 3221225472 ESC_Logger10_Byte3 0;
BA_ "GenSigSendType" SG_ 3221225472 ESC_Logger10_Byte3 2;
BA_ "UsrSigPurpose" SG_ 3221225472 ESC_Logger10_Byte3 6;
BA_ "Version" SG_ 3221225472 ESC_Logger10_Byte4 "18.08.01";
BA_ "NetworkRequestHoldingTime" SG_ 3221225472 ESC_Logger10_Byte4 5000;
BA_ "NetworkRequest" SG_ 3221225472 ESC_Logger10_Byte4 0;
BA_ "UserSigValidity" SG_ 3221225472 ESC_Logger10_Byte4 0;
BA_ "GenSigSendType" SG_ 3221225472 ESC_Logger10_Byte4 2;
BA_ "UsrSigPurpose" SG_ 3221225472 ESC_Logger10_Byte4 6;
BA_ "Version" SG_ 3221225472 ESC_Logger10_Byte5 "18.08.01";
BA_ "NetworkRequestHoldingTime" SG_ 3221225472 ESC_Logger10_Byte5 5000;
BA_ "NetworkRequest" SG_ 3221225472 ESC_Logger10_Byte5 0;
BA_ "UserSigValidity" SG_ 3221225472 ESC_Logger10_Byte5 0;
BA_ "GenSigSendType" SG_ 3221225472 ESC_Logger10_Byte5 2;
BA_ "UsrSigPurpose" SG_ 3221225472 ESC_Logger10_Byte5 6;
BA_ "Version" SG_ 3221225472 ESC_Logger10_Byte6 "18.08.01";
BA_ "NetworkRequestHoldingTime" SG_ 3221225472 ESC_Logger10_Byte6 5000;
BA_ "NetworkRequest" SG_ 3221225472 ESC_Logger10_Byte6 0;
BA_ "UserSigValidity" SG_ 3221225472 ESC_Logger10_Byte6 0;
BA_ "GenSigSendType" SG_ 3221225472 ESC_Logger10_Byte6 2;
BA_ "UsrSigPurpose" SG_ 3221225472 ESC_Logger10_Byte6 6;
BA_ "Version" SG_ 3221225472 ESC_Logger10_Byte7 "18.08.01";
BA_ "NetworkRequestHoldingTime" SG_ 3221225472 ESC_Logger10_Byte7 5000;
BA_ "NetworkRequest" SG_ 3221225472 ESC_Logger10_Byte7 0;
BA_ "UserSigValidity" SG_ 3221225472 ESC_Logger10_Byte7 0;
BA_ "GenSigSendType" SG_ 3221225472 ESC_Logger10_Byte7 2;
BA_ "UsrSigPurpose" SG_ 3221225472 ESC_Logger10_Byte7 6;
BA_ "Version" SG_ 3221225472 ESC_Logger10_Byte1 "18.08.01";
BA_ "NetworkRequestHoldingTime" SG_ 3221225472 ESC_Logger10_Byte1 5000;
BA_ "NetworkRequest" SG_ 3221225472 ESC_Logger10_Byte1 0;
BA_ "UserSigValidity" SG_ 3221225472 ESC_Logger10_Byte1 0;
BA_ "GenSigSendType" SG_ 3221225472 ESC_Logger10_Byte1 2;
BA_ "UsrSigPurpose" SG_ 3221225472 ESC_Logger10_Byte1 6;
BA_ "Version" SG_ 3221225472 ESC_Logger11_Byte0 "18.08.01";
BA_ "NetworkRequestHoldingTime" SG_ 3221225472 ESC_Logger11_Byte0 5000;
BA_ "NetworkRequest" SG_ 3221225472 ESC_Logger11_Byte0 0;
BA_ "UserSigValidity" SG_ 3221225472 ESC_Logger11_Byte0 0;
BA_ "GenSigSendType" SG_ 3221225472 ESC_Logger11_Byte0 2;
BA_ "UsrSigPurpose" SG_ 3221225472 ESC_Logger11_Byte0 6;
BA_ "Version" SG_ 3221225472 ESC_Logger11_Byte2 "18.08.01";
BA_ "NetworkRequestHoldingTime" SG_ 3221225472 ESC_Logger11_Byte2 5000;
BA_ "NetworkRequest" SG_ 3221225472 ESC_Logger11_Byte2 0;
BA_ "UserSigValidity" SG_ 3221225472 ESC_Logger11_Byte2 0;
BA_ "GenSigSendType" SG_ 3221225472 ESC_Logger11_Byte2 2;
BA_ "UsrSigPurpose" SG_ 3221225472 ESC_Logger11_Byte2 6;
BA_ "Version" SG_ 3221225472 ESC_Logger11_Byte3 "18.08.01";
BA_ "NetworkRequestHoldingTime" SG_ 3221225472 ESC_Logger11_Byte3 5000;
BA_ "NetworkRequest" SG_ 3221225472 ESC_Logger11_Byte3 0;
BA_ "UserSigValidity" SG_ 3221225472 ESC_Logger11_Byte3 0;
BA_ "GenSigSendType" SG_ 3221225472 ESC_Logger11_Byte3 2;
BA_ "UsrSigPurpose" SG_ 3221225472 ESC_Logger11_Byte3 6;
BA_ "Version" SG_ 3221225472 ESC_Logger11_Byte4 "18.08.01";
BA_ "NetworkRequestHoldingTime" SG_ 3221225472 ESC_Logger11_Byte4 5000;
BA_ "NetworkRequest" SG_ 3221225472 ESC_Logger11_Byte4 0;
BA_ "UserSigValidity" SG_ 3221225472 ESC_Logger11_Byte4 0;
BA_ "GenSigSendType" SG_ 3221225472 ESC_Logger11_Byte4 2;
BA_ "UsrSigPurpose" SG_ 3221225472 ESC_Logger11_Byte4 6;
BA_ "Version" SG_ 3221225472 ESC_Logger11_Byte5 "18.08.01";
BA_ "NetworkRequestHoldingTime" SG_ 3221225472 ESC_Logger11_Byte5 5000;
BA_ "NetworkRequest" SG_ 3221225472 ESC_Logger11_Byte5 0;
BA_ "UserSigValidity" SG_ 3221225472 ESC_Logger11_Byte5 0;
BA_ "GenSigSendType" SG_ 3221225472 ESC_Logger11_Byte5 2;
BA_ "UsrSigPurpose" SG_ 3221225472 ESC_Logger11_Byte5 6;
BA_ "Version" SG_ 3221225472 ESC_Logger11_Byte6 "18.08.01";
BA_ "NetworkRequestHoldingTime" SG_ 3221225472 ESC_Logger11_Byte6 5000;
BA_ "NetworkRequest" SG_ 3221225472 ESC_Logger11_Byte6 0;
BA_ "UserSigValidity" SG_ 3221225472 ESC_Logger11_Byte6 0;
BA_ "GenSigSendType" SG_ 3221225472 ESC_Logger11_Byte6 2;
BA_ "UsrSigPurpose" SG_ 3221225472 ESC_Logger11_Byte6 6;
BA_ "Version" SG_ 3221225472 ESC_Logger11_Byte7 "18.08.01";
BA_ "NetworkRequestHoldingTime" SG_ 3221225472 ESC_Logger11_Byte7 5000;
BA_ "NetworkRequest" SG_ 3221225472 ESC_Logger11_Byte7 0;
BA_ "UserSigValidity" SG_ 3221225472 ESC_Logger11_Byte7 0;
BA_ "GenSigSendType" SG_ 3221225472 ESC_Logger11_Byte7 2;
BA_ "UsrSigPurpose" SG_ 3221225472 ESC_Logger11_Byte7 6;
BA_ "Version" SG_ 3221225472 ESC_Logger11_Byte1 "18.08.01";
BA_ "NetworkRequestHoldingTime" SG_ 3221225472 ESC_Logger11_Byte1 5000;
BA_ "NetworkRequest" SG_ 3221225472 ESC_Logger11_Byte1 0;
BA_ "UserSigValidity" SG_ 3221225472 ESC_Logger11_Byte1 0;
BA_ "GenSigSendType" SG_ 3221225472 ESC_Logger11_Byte1 2;
BA_ "UsrSigPurpose" SG_ 3221225472 ESC_Logger11_Byte1 6;
BA_ "Version" SG_ 3221225472 ODS_GST_Byte0 "18.01.08";
BA_ "NetworkRequestHoldingTime" SG_ 3221225472 ODS_GST_Byte0 5000;
BA_ "NetworkRequest" SG_ 3221225472 ODS_GST_Byte0 0;
BA_ "UserSigValidity" SG_ 3221225472 ODS_GST_Byte0 0;
BA_ "GenSigSendType" SG_ 3221225472 ODS_GST_Byte0 2;
BA_ "UsrSigPurpose" SG_ 3221225472 ODS_GST_Byte0 2;
BA_ "Version" SG_ 3221225472 ODS_GST_Byte2 "18.01.08";
BA_ "NetworkRequestHoldingTime" SG_ 3221225472 ODS_GST_Byte2 5000;
BA_ "NetworkRequest" SG_ 3221225472 ODS_GST_Byte2 0;
BA_ "UserSigValidity" SG_ 3221225472 ODS_GST_Byte2 0;
BA_ "GenSigSendType" SG_ 3221225472 ODS_GST_Byte2 2;
BA_ "UsrSigPurpose" SG_ 3221225472 ODS_GST_Byte2 2;
BA_ "Version" SG_ 3221225472 ODS_GST_Byte3 "18.01.08";
BA_ "NetworkRequestHoldingTime" SG_ 3221225472 ODS_GST_Byte3 5000;
BA_ "NetworkRequest" SG_ 3221225472 ODS_GST_Byte3 0;
BA_ "UserSigValidity" SG_ 3221225472 ODS_GST_Byte3 0;
BA_ "GenSigSendType" SG_ 3221225472 ODS_GST_Byte3 2;
BA_ "UsrSigPurpose" SG_ 3221225472 ODS_GST_Byte3 2;
BA_ "Version" SG_ 3221225472 ODS_GST_Byte4 "18.01.08";
BA_ "NetworkRequestHoldingTime" SG_ 3221225472 ODS_GST_Byte4 5000;
BA_ "NetworkRequest" SG_ 3221225472 ODS_GST_Byte4 0;
BA_ "UserSigValidity" SG_ 3221225472 ODS_GST_Byte4 0;
BA_ "GenSigSendType" SG_ 3221225472 ODS_GST_Byte4 2;
BA_ "UsrSigPurpose" SG_ 3221225472 ODS_GST_Byte4 2;
BA_ "Version" SG_ 3221225472 ODS_GST_Byte5 "18.01.08";
BA_ "NetworkRequestHoldingTime" SG_ 3221225472 ODS_GST_Byte5 5000;
BA_ "NetworkRequest" SG_ 3221225472 ODS_GST_Byte5 0;
BA_ "UserSigValidity" SG_ 3221225472 ODS_GST_Byte5 0;
BA_ "GenSigSendType" SG_ 3221225472 ODS_GST_Byte5 2;
BA_ "UsrSigPurpose" SG_ 3221225472 ODS_GST_Byte5 2;
BA_ "Version" SG_ 3221225472 ODS_GST_Byte6 "18.01.08";
BA_ "NetworkRequestHoldingTime" SG_ 3221225472 ODS_GST_Byte6 5000;
BA_ "NetworkRequest" SG_ 3221225472 ODS_GST_Byte6 0;
BA_ "UserSigValidity" SG_ 3221225472 ODS_GST_Byte6 0;
BA_ "GenSigSendType" SG_ 3221225472 ODS_GST_Byte6 2;
BA_ "UsrSigPurpose" SG_ 3221225472 ODS_GST_Byte6 2;
BA_ "Version" SG_ 3221225472 ODS_GST_Byte7 "18.01.08";
BA_ "NetworkRequestHoldingTime" SG_ 3221225472 ODS_GST_Byte7 5000;
BA_ "NetworkRequest" SG_ 3221225472 ODS_GST_Byte7 0;
BA_ "UserSigValidity" SG_ 3221225472 ODS_GST_Byte7 0;
BA_ "GenSigSendType" SG_ 3221225472 ODS_GST_Byte7 2;
BA_ "UsrSigPurpose" SG_ 3221225472 ODS_GST_Byte7 2;
BA_ "Version" SG_ 3221225472 ODS_GST_Byte1 "18.01.08";
BA_ "NetworkRequestHoldingTime" SG_ 3221225472 ODS_GST_Byte1 5000;
BA_ "NetworkRequest" SG_ 3221225472 ODS_GST_Byte1 0;
BA_ "UserSigValidity" SG_ 3221225472 ODS_GST_Byte1 0;
BA_ "GenSigSendType" SG_ 3221225472 ODS_GST_Byte1 2;
BA_ "UsrSigPurpose" SG_ 3221225472 ODS_GST_Byte1 2;
BA_ "Version" SG_ 3221225472 HU_Type "19.02.08";
BA_ "NetworkRequestHoldingTime" SG_ 3221225472 HU_Type 7000;
BA_ "NetworkRequest" SG_ 3221225472 HU_Type 0;
BA_ "UserSigValidity" SG_ 3221225472 HU_Type 1;
BA_ "GenSigStartValue" SG_ 3221225472 HU_Type 255;
BA_ "GenSigSendType" SG_ 3221225472 HU_Type 4;
BA_ "Version" SG_ 3221225472 HU_DistributeInfo "19.02.08";
BA_ "NetworkRequest" SG_ 3221225472 HU_DistributeInfo 0;
BA_ "UserSigValidity" SG_ 3221225472 HU_DistributeInfo 1;
BA_ "GenSigStartValue" SG_ 3221225472 HU_DistributeInfo 255;
BA_ "GenSigSendType" SG_ 3221225472 HU_DistributeInfo 4;
BA_ "Version" SG_ 3221225472 HU_OptionInfo "19.04.06";
BA_ "UserSigValidity" SG_ 3221225472 HU_OptionInfo 0;
BA_ "GenSigStartValue" SG_ 3221225472 HU_OptionInfo 32768;
BA_ "GenSigSendType" SG_ 3221225472 HU_OptionInfo 4;
BA_ "Description" SG_ 3221225472 HU_OptionInfo "Bit0 : Navi (0: Not Support / 1: Support)

Bit1 : USM (0: Not Support / 1: Support)

Bit2 : TMS (0: Not Support / 1: Support)

Bit3 : Multi Profile (0: Not Support(No Profile or Single Profile)  / 1: Support)

Bit4 : Camera Guideline (0: Displayed by Cam";
BA_ "Version" SG_ 3221225472 HU_CamViewDispStatus "19.07.05";
BA_ "UserSigValidity" SG_ 3221225472 HU_CamViewDispStatus 1;
BA_ "GenSigSendType" SG_ 3221225472 HU_CamViewDispStatus 4;
BA_ "Description" SG_ 3221225472 HU_CamViewDispStatus "Information for Camera View displayed status";
BA_ "Version" SG_ 3221225472 HU_AMP_EQVariant "18.08.03";
BA_ "UserSigValidity" SG_ 3221225472 HU_AMP_EQVariant 1;
BA_ "GenSigStartValue" SG_ 3221225472 HU_AMP_EQVariant 31;
BA_ "GenSigSendType" SG_ 3221225472 HU_AMP_EQVariant 4;
BA_ "Version" SG_ 3221225472 HU_AdasSupport "19.04.06";
BA_ "NetworkRequestHoldingTime" SG_ 3221225472 HU_AdasSupport 5000;
BA_ "NetworkRequest" SG_ 3221225472 HU_AdasSupport 0;
BA_ "UserSigValidity" SG_ 3221225472 HU_AdasSupport 1;
BA_ "GenSigStartValue" SG_ 3221225472 HU_AdasSupport 7;
BA_ "GenSigSendType" SG_ 3221225472 HU_AdasSupport 4;
BA_ "Version" SG_ 3221225472 ESC_Logger12_Byte0 "18.08.01";
BA_ "NetworkRequestHoldingTime" SG_ 3221225472 ESC_Logger12_Byte0 5000;
BA_ "NetworkRequest" SG_ 3221225472 ESC_Logger12_Byte0 0;
BA_ "UserSigValidity" SG_ 3221225472 ESC_Logger12_Byte0 0;
BA_ "GenSigSendType" SG_ 3221225472 ESC_Logger12_Byte0 2;
BA_ "UsrSigPurpose" SG_ 3221225472 ESC_Logger12_Byte0 6;
BA_ "Version" SG_ 3221225472 ESC_Logger12_Byte2 "18.08.01";
BA_ "NetworkRequestHoldingTime" SG_ 3221225472 ESC_Logger12_Byte2 5000;
BA_ "NetworkRequest" SG_ 3221225472 ESC_Logger12_Byte2 0;
BA_ "UserSigValidity" SG_ 3221225472 ESC_Logger12_Byte2 0;
BA_ "GenSigSendType" SG_ 3221225472 ESC_Logger12_Byte2 2;
BA_ "UsrSigPurpose" SG_ 3221225472 ESC_Logger12_Byte2 6;
BA_ "Version" SG_ 3221225472 ESC_Logger12_Byte3 "18.08.01";
BA_ "NetworkRequestHoldingTime" SG_ 3221225472 ESC_Logger12_Byte3 5000;
BA_ "NetworkRequest" SG_ 3221225472 ESC_Logger12_Byte3 0;
BA_ "UserSigValidity" SG_ 3221225472 ESC_Logger12_Byte3 0;
BA_ "GenSigSendType" SG_ 3221225472 ESC_Logger12_Byte3 2;
BA_ "UsrSigPurpose" SG_ 3221225472 ESC_Logger12_Byte3 6;
BA_ "Version" SG_ 3221225472 ESC_Logger12_Byte4 "18.08.01";
BA_ "NetworkRequestHoldingTime" SG_ 3221225472 ESC_Logger12_Byte4 5000;
BA_ "NetworkRequest" SG_ 3221225472 ESC_Logger12_Byte4 0;
BA_ "UserSigValidity" SG_ 3221225472 ESC_Logger12_Byte4 0;
BA_ "GenSigSendType" SG_ 3221225472 ESC_Logger12_Byte4 2;
BA_ "UsrSigPurpose" SG_ 3221225472 ESC_Logger12_Byte4 6;
BA_ "Version" SG_ 3221225472 ESC_Logger12_Byte5 "18.08.01";
BA_ "NetworkRequestHoldingTime" SG_ 3221225472 ESC_Logger12_Byte5 5000;
BA_ "NetworkRequest" SG_ 3221225472 ESC_Logger12_Byte5 0;
BA_ "UserSigValidity" SG_ 3221225472 ESC_Logger12_Byte5 0;
BA_ "GenSigSendType" SG_ 3221225472 ESC_Logger12_Byte5 2;
BA_ "UsrSigPurpose" SG_ 3221225472 ESC_Logger12_Byte5 6;
BA_ "Version" SG_ 3221225472 ESC_Logger12_Byte6 "18.08.01";
BA_ "NetworkRequestHoldingTime" SG_ 3221225472 ESC_Logger12_Byte6 5000;
BA_ "NetworkRequest" SG_ 3221225472 ESC_Logger12_Byte6 0;
BA_ "UserSigValidity" SG_ 3221225472 ESC_Logger12_Byte6 0;
BA_ "GenSigSendType" SG_ 3221225472 ESC_Logger12_Byte6 2;
BA_ "UsrSigPurpose" SG_ 3221225472 ESC_Logger12_Byte6 6;
BA_ "Version" SG_ 3221225472 ESC_Logger12_Byte7 "18.08.01";
BA_ "NetworkRequestHoldingTime" SG_ 3221225472 ESC_Logger12_Byte7 5000;
BA_ "NetworkRequest" SG_ 3221225472 ESC_Logger12_Byte7 0;
BA_ "UserSigValidity" SG_ 3221225472 ESC_Logger12_Byte7 0;
BA_ "GenSigSendType" SG_ 3221225472 ESC_Logger12_Byte7 2;
BA_ "UsrSigPurpose" SG_ 3221225472 ESC_Logger12_Byte7 6;
BA_ "Version" SG_ 3221225472 ESC_Logger12_Byte1 "18.08.01";
BA_ "NetworkRequestHoldingTime" SG_ 3221225472 ESC_Logger12_Byte1 5000;
BA_ "NetworkRequest" SG_ 3221225472 ESC_Logger12_Byte1 0;
BA_ "UserSigValidity" SG_ 3221225472 ESC_Logger12_Byte1 0;
BA_ "GenSigSendType" SG_ 3221225472 ESC_Logger12_Byte1 2;
BA_ "UsrSigPurpose" SG_ 3221225472 ESC_Logger12_Byte1 6;
BA_ "Version" SG_ 3221225472 ADAS_CMD_Crc20Val "18.11.08";
BA_ "RoutingFactor" SG_ 3221225472 ADAS_CMD_Crc20Val 5;
BA_ "UserSigValidity" SG_ 3221225472 ADAS_CMD_Crc20Val 3;
BA_ "GenSigStartValue" SG_ 3221225472 ADAS_CMD_Crc20Val 65535;
BA_ "Description" SG_ 3221225472 ADAS_CMD_Crc20Val "The data area for CRC calculation is based on the data length (DLC) of the message DB.

The CRC shall be calculated over the entire data block (excluding the CRC bytes) including the user data, alive counter and Data ID

 

- CRC Polynomial (0x1021) , In";
BA_ "Version" SG_ 3221225472 SCC_NSCCOpSta "17.12.00";
BA_ "RoutingFactor" SG_ 3221225472 SCC_NSCCOpSta 5;
BA_ "UserSigValidity" SG_ 3221225472 SCC_NSCCOpSta 3;
BA_ "Description" SG_ 3221225472 SCC_NSCCOpSta "This signal describes the operational status of NSCC-Z/C/R function. 



NSCC-Z/C/R  �۵� ���� ����(off/ready/active)";
BA_ "Version" SG_ 3221225472 SCC_NSCCOnOffSta "17.12.00";
BA_ "RoutingFactor" SG_ 3221225472 SCC_NSCCOnOffSta 5;
BA_ "UserSigValidity" SG_ 3221225472 SCC_NSCCOnOffSta 3;
BA_ "Description" SG_ 3221225472 SCC_NSCCOnOffSta "This signal describes the on/off status of NSCC-Z/C/R and HDA Auto-set function. 



NSCC-Z/C/R  and HDA auto-set on/off ���� ����";
BA_ "Version" SG_ 3221225472 SCC_ObjSta "19.07.02";
BA_ "RoutingFactor" SG_ 3221225472 SCC_ObjSta 5;
BA_ "UserSigValidity" SG_ 3221225472 SCC_ObjSta 3;
BA_ "Description" SG_ 3221225472 SCC_ObjSta "This signal represents the state of in-path object and information of controllable state.

- ���������� ���� ���� �ν� ���� �� ���� ���� ���� ����";
BA_ "Version" SG_ 3221225472 SCC_SnstvtyModRetVal "17.12.00";
BA_ "RoutingFactor" SG_ 3221225472 SCC_SnstvtyModRetVal 5;
BA_ "UserSigValidity" SG_ 3221225472 SCC_SnstvtyModRetVal 3;
BA_ "GenSigStartValue" SG_ 3221225472 SCC_SnstvtyModRetVal 2;
BA_ "Description" SG_ 3221225472 SCC_SnstvtyModRetVal "This signal is SCC sensitive set mode switch info return value to cluster

- SCC �ΰ��� ���� ���� USM ���� ����ġ ������ ���� ��";
BA_ "Version" SG_ 3221225472 SCC_NSCCAutoSetSpdUpdtSta "18.10.02";
BA_ "RoutingFactor" SG_ 3221225472 SCC_NSCCAutoSetSpdUpdtSta 5;
BA_ "UserSigValidity" SG_ 3221225472 SCC_NSCCAutoSetSpdUpdtSta 3;
BA_ "Description" SG_ 3221225472 SCC_NSCCAutoSetSpdUpdtSta "This is information if Auto Set Speed Control is updated or not.";
BA_ "Version" SG_ 3221225472 SCC_NSCCInfoPUDis "18.10.02";
BA_ "RoutingFactor" SG_ 3221225472 SCC_NSCCInfoPUDis 5;
BA_ "UserSigValidity" SG_ 3221225472 SCC_NSCCInfoPUDis 3;
BA_ "Description" SG_ 3221225472 SCC_NSCCInfoPUDis "This signal shows the cluster pop-up for NSCC Information.";
BA_ "Version" SG_ 3221225472 SCC_AccelReqVal "17.12.00";
BA_ "RoutingFactor" SG_ 3221225472 SCC_AccelReqVal 5;
BA_ "UserSigValidity" SG_ 3221225472 SCC_AccelReqVal 3;
BA_ "Description" SG_ 3221225472 SCC_AccelReqVal "This signal represents the SCC acceleration request after jerk limit.

- Jerk limit�� ��ģ SCC �� �䱸 ���ӵ�/���ӵ� ��";
BA_ "Version" SG_ 3221225472 SCC_AccelReqRawVal "17.12.00";
BA_ "RoutingFactor" SG_ 3221225472 SCC_AccelReqRawVal 5;
BA_ "UserSigValidity" SG_ 3221225472 SCC_AccelReqRawVal 3;
BA_ "Description" SG_ 3221225472 SCC_AccelReqRawVal "This signal represents the SCC acceleration request before jerk limit. 

- Jerk limit�� ��ġ�� ���� SCC �� �䱸 ���ӵ�/���ӵ� ��";
BA_ "Version" SG_ 3221225472 SCC_JrkUppLimVal "17.12.00";
BA_ "RoutingFactor" SG_ 3221225472 SCC_JrkUppLimVal 5;
BA_ "UserSigValidity" SG_ 3221225472 SCC_JrkUppLimVal 3;
BA_ "Description" SG_ 3221225472 SCC_JrkUppLimVal "This signal is the value of positive jerk limit request. 

- SCC �� �䱸 ���ӵ� ��º�ȭ�� ���� ��";
BA_ "Version" SG_ 3221225472 ADAS_CMD_AlvCnt20Val "18.11.08";
BA_ "RoutingFactor" SG_ 3221225472 ADAS_CMD_AlvCnt20Val 5;
BA_ "UserSigValidity" SG_ 3221225472 ADAS_CMD_AlvCnt20Val 3;
BA_ "Description" SG_ 3221225472 ADAS_CMD_AlvCnt20Val "For the first transmission request for a data element the counter shall be initialized with 0 and shall be incremented by 1 for every subsequent send request. 

When the counter reaches the maximum value(0xFF), then it shall restart with 0 for the next s";
BA_ "Version" SG_ 3221225472 SCC_JrkLwrLimVal "17.12.00";
BA_ "RoutingFactor" SG_ 3221225472 SCC_JrkLwrLimVal 5;
BA_ "UserSigValidity" SG_ 3221225472 SCC_JrkLwrLimVal 3;
BA_ "Description" SG_ 3221225472 SCC_JrkLwrLimVal "This signal is the value of negative jerk limit request. 

- SCC �� �䱸 ���ӵ� �ϰ���ȭ�� ���� ��";
BA_ "Version" SG_ 3221225472 SCC_AccelLimBandUppVal "17.12.03";
BA_ "RoutingFactor" SG_ 3221225472 SCC_AccelLimBandUppVal 5;
BA_ "UserSigValidity" SG_ 3221225472 SCC_AccelLimBandUppVal 3;
BA_ "Description" SG_ 3221225472 SCC_AccelLimBandUppVal "This signal is the upper value of acceleration limit band.

- SCC �� ���ӵ� ���� ��� ���� ���� ������";
BA_ "Version" SG_ 3221225472 SCC_AccelLimBandLwrVal "17.12.03";
BA_ "RoutingFactor" SG_ 3221225472 SCC_AccelLimBandLwrVal 5;
BA_ "UserSigValidity" SG_ 3221225472 SCC_AccelLimBandLwrVal 3;
BA_ "Description" SG_ 3221225472 SCC_AccelLimBandLwrVal "This signal is the lower value of acceleration limit band.

- SCC �� ���ӵ� ���� ��� ���� ���� ������";
BA_ "Version" SG_ 3221225472 SCC_VehStpReq "17.12.00";
BA_ "RoutingFactor" SG_ 3221225472 SCC_VehStpReq 5;
BA_ "UserSigValidity" SG_ 3221225472 SCC_VehStpReq 3;
BA_ "Description" SG_ 3221225472 SCC_VehStpReq "A control request flag for vehicle stop. SCC expects vehicle to be controlled to a complete stop and hold its state.

- SCC ���� ��Ȳ �߻��� ���� ���� ������ ���� ���� ��û ��ȣ";
BA_ "Version" SG_ 3221225472 SCC_DclModReq "17.11.00";
BA_ "RoutingFactor" SG_ 3221225472 SCC_DclModReq 5;
BA_ "UserSigValidity" SG_ 3221225472 SCC_DclModReq 3;
BA_ "Description" SG_ 3221225472 SCC_DclModReq "A control request flag for deceleration mode.

- SCC ���� ��� ��û ��ȣ";
BA_ "Version" SG_ 3221225472 SCC_TrgtDstVal "18.10.09";
BA_ "RoutingFactor" SG_ 3221225472 SCC_TrgtDstVal 5;
BA_ "UserSigValidity" SG_ 3221225472 SCC_TrgtDstVal 3;
BA_ "GenSigStartValue" SG_ 3221225472 SCC_TrgtDstVal 2046;
BA_ "Description" SG_ 3221225472 SCC_TrgtDstVal "This signal provides the target distance for SCC fallowing control.

- SCC �Ÿ� ��� ���� ��ǥ ���� �Ÿ� ����";
BA_ "Version" SG_ 3221225472 SCC_ObjDstVal "18.10.09";
BA_ "RoutingFactor" SG_ 3221225472 SCC_ObjDstVal 5;
BA_ "UserSigValidity" SG_ 3221225472 SCC_ObjDstVal 3;
BA_ "GenSigStartValue" SG_ 3221225472 SCC_ObjDstVal 2046;
BA_ "Description" SG_ 3221225472 SCC_ObjDstVal "This signal provides the distance to the in lane detected SCC object regarding to the own vehicle.

- ���������� ���� �νĵ� ��ü���� �Ÿ�";
BA_ "Version" SG_ 3221225472 SCC_ObjRelSpdVal "18.10.09";
BA_ "RoutingFactor" SG_ 3221225472 SCC_ObjRelSpdVal 5;
BA_ "UserSigValidity" SG_ 3221225472 SCC_ObjRelSpdVal 3;
BA_ "GenSigStartValue" SG_ 3221225472 SCC_ObjRelSpdVal 4094;
BA_ "Description" SG_ 3221225472 SCC_ObjRelSpdVal "This signal provides the relative speed to the in lane detected SCC object regarding to the own vehicle.

- ���������� ���� �νĵ� ��ü�� ������ ��� �ӵ�";
BA_ "Version" SG_ 3221225472 SCC_ObjLatPosVal "18.10.09";
BA_ "RoutingFactor" SG_ 3221225472 SCC_ObjLatPosVal 5;
BA_ "UserSigValidity" SG_ 3221225472 SCC_ObjLatPosVal 3;
BA_ "GenSigStartValue" SG_ 3221225472 SCC_ObjLatPosVal 510;
BA_ "Description" SG_ 3221225472 SCC_ObjLatPosVal "This signal provides the lateral position of the detected SCC object regarding to the own vehicle. 

The position of the SCC object on the left side in driving direction of the vehicle longitudinal axis correlates with a negative signal value. 

Thus an ";
BA_ "Version" SG_ 3221225472 SCC_SysFlrSta "17.12.00";
BA_ "RoutingFactor" SG_ 3221225472 SCC_SysFlrSta 5;
BA_ "UserSigValidity" SG_ 3221225472 SCC_SysFlrSta 3;
BA_ "Description" SG_ 3221225472 SCC_SysFlrSta "This signal is evaluated by the driver information device to release the failure information to the driver.

If this signal is set to anything other than 0, the TCS/ESC shall ignore any requests from SCC

- �ý��� ���� �߻� ������

- �ش� ���� 0 �̿��� �";
BA_ "Version" SG_ 3221225472 SCC_MainOnOffSta "17.12.00";
BA_ "RoutingFactor" SG_ 3221225472 SCC_MainOnOffSta 5;
BA_ "UserSigValidity" SG_ 3221225472 SCC_MainOnOffSta 3;
BA_ "Description" SG_ 3221225472 SCC_MainOnOffSta "This signal specifies the status of a Main switch of SCC system

- Main swith �� ���� SCC ON/OFF ���� ����";
BA_ "Version" SG_ 3221225472 SCC_OpSta "19.04.02";
BA_ "RoutingFactor" SG_ 3221225472 SCC_OpSta 5;
BA_ "UserSigValidity" SG_ 3221225472 SCC_OpSta 3;
BA_ "GenSigStartValue" SG_ 3221225472 SCC_OpSta 3;
BA_ "Description" SG_ 3221225472 SCC_OpSta "The signal ACCmode specifies the operational mode of SCC

- ACC �۵� ���� ����(off&ready / active / override / shut off)";
BA_ "Version" SG_ 3221225472 SCC_TakeoverReq "17.12.00";
BA_ "RoutingFactor" SG_ 3221225472 SCC_TakeoverReq 5;
BA_ "UserSigValidity" SG_ 3221225472 SCC_TakeoverReq 3;
BA_ "Description" SG_ 3221225472 SCC_TakeoverReq "The Take-over Request supports the driver to identify the limits of the SCC control. Reasons for such a request may be:

- Deceleration capability insufficient for the current situation.

Clutch actuation by the driver is necessary to avoid stopping of t";
BA_ "Version" SG_ 3221225472 SCC_InfoDis "18.10.09";
BA_ "RoutingFactor" SG_ 3221225472 SCC_InfoDis 5;
BA_ "UserSigValidity" SG_ 3221225472 SCC_InfoDis 3;
BA_ "Description" SG_ 3221225472 SCC_InfoDis "This signal carries information that indicates below 4 signals.

(1) SCC Mode display

(2) CC Mode display

(3) Object disapearing display

(4) Go notifying display

- SCC ���� �� ���¸� �����ִ� ���� ��ȣ

(SCC ��� / CC ��� / �������� ���� / ���� ��";
BA_ "Version" SG_ 3221225472 SCC_DrvAlrtDis "19.07.02";
BA_ "RoutingFactor" SG_ 3221225472 SCC_DrvAlrtDis 5;
BA_ "UserSigValidity" SG_ 3221225472 SCC_DrvAlrtDis 3;
BA_ "Description" SG_ 3221225472 SCC_DrvAlrtDis "This signal carries the information which message shall be displayed to the driver 

when the SCC must be disengaged by the system or cann��t be engaged.

A signal value unequal 00H is repeated for 5 messages cycles in order to ensure it appears for at l";
BA_ "Version" SG_ 3221225472 SCC_HeadwayDstSetVal "17.12.00";
BA_ "RoutingFactor" SG_ 3221225472 SCC_HeadwayDstSetVal 5;
BA_ "UserSigValidity" SG_ 3221225472 SCC_HeadwayDstSetVal 3;
BA_ "Description" SG_ 3221225472 SCC_HeadwayDstSetVal "The desired time gap from which a following distance is extracted has to be presented to the driver at least if the value changes. 

The representation of the information depends on the display concept.

- ���� �������� �Ÿ� setting ����

�� SCC-ML: SCC ";
BA_ "Version" SG_ 3221225472 SCC_NSCCAutoSetSpdSta "18.10.02";
BA_ "RoutingFactor" SG_ 3221225472 SCC_NSCCAutoSetSpdSta 5;
BA_ "UserSigValidity" SG_ 3221225472 SCC_NSCCAutoSetSpdSta 3;
BA_ "Description" SG_ 3221225472 SCC_NSCCAutoSetSpdSta "This is information if Auto Set Speed Control is enabled or not.";
BA_ "Version" SG_ 3221225472 SCC_TrgtSpdSetVal "17.12.00";
BA_ "RoutingFactor" SG_ 3221225472 SCC_TrgtSpdSetVal 5;
BA_ "UserSigValidity" SG_ 3221225472 SCC_TrgtSpdSetVal 3;
BA_ "Description" SG_ 3221225472 SCC_TrgtSpdSetVal "The desired vehicle speed for free cruising has to be displayed all the time SCC is under active control.

��This signal can be sent in km/h or MPH according to the ��SPEED_UNIT�� signal (See CLU1 message).

SPEED_UNIT = 0 : [km/h], SPEED_UNIT = 1 : [MPH";
BA_ "Version" SG_ 3221225472 ESC_Logger13_Byte0 "18.08.01";
BA_ "NetworkRequestHoldingTime" SG_ 3221225472 ESC_Logger13_Byte0 5000;
BA_ "NetworkRequest" SG_ 3221225472 ESC_Logger13_Byte0 0;
BA_ "UserSigValidity" SG_ 3221225472 ESC_Logger13_Byte0 0;
BA_ "GenSigSendType" SG_ 3221225472 ESC_Logger13_Byte0 2;
BA_ "UsrSigPurpose" SG_ 3221225472 ESC_Logger13_Byte0 6;
BA_ "Version" SG_ 3221225472 ESC_Logger13_Byte2 "18.08.01";
BA_ "NetworkRequestHoldingTime" SG_ 3221225472 ESC_Logger13_Byte2 5000;
BA_ "NetworkRequest" SG_ 3221225472 ESC_Logger13_Byte2 0;
BA_ "UserSigValidity" SG_ 3221225472 ESC_Logger13_Byte2 0;
BA_ "GenSigSendType" SG_ 3221225472 ESC_Logger13_Byte2 2;
BA_ "UsrSigPurpose" SG_ 3221225472 ESC_Logger13_Byte2 6;
BA_ "Version" SG_ 3221225472 ESC_Logger13_Byte3 "18.08.01";
BA_ "NetworkRequestHoldingTime" SG_ 3221225472 ESC_Logger13_Byte3 5000;
BA_ "NetworkRequest" SG_ 3221225472 ESC_Logger13_Byte3 0;
BA_ "UserSigValidity" SG_ 3221225472 ESC_Logger13_Byte3 0;
BA_ "GenSigSendType" SG_ 3221225472 ESC_Logger13_Byte3 2;
BA_ "UsrSigPurpose" SG_ 3221225472 ESC_Logger13_Byte3 6;
BA_ "Version" SG_ 3221225472 ESC_Logger13_Byte4 "18.08.01";
BA_ "NetworkRequestHoldingTime" SG_ 3221225472 ESC_Logger13_Byte4 5000;
BA_ "NetworkRequest" SG_ 3221225472 ESC_Logger13_Byte4 0;
BA_ "UserSigValidity" SG_ 3221225472 ESC_Logger13_Byte4 0;
BA_ "GenSigSendType" SG_ 3221225472 ESC_Logger13_Byte4 2;
BA_ "UsrSigPurpose" SG_ 3221225472 ESC_Logger13_Byte4 6;
BA_ "Version" SG_ 3221225472 ESC_Logger13_Byte5 "18.08.01";
BA_ "NetworkRequestHoldingTime" SG_ 3221225472 ESC_Logger13_Byte5 5000;
BA_ "NetworkRequest" SG_ 3221225472 ESC_Logger13_Byte5 0;
BA_ "UserSigValidity" SG_ 3221225472 ESC_Logger13_Byte5 0;
BA_ "GenSigSendType" SG_ 3221225472 ESC_Logger13_Byte5 2;
BA_ "UsrSigPurpose" SG_ 3221225472 ESC_Logger13_Byte5 6;
BA_ "Version" SG_ 3221225472 ESC_Logger13_Byte6 "18.08.01";
BA_ "NetworkRequestHoldingTime" SG_ 3221225472 ESC_Logger13_Byte6 5000;
BA_ "NetworkRequest" SG_ 3221225472 ESC_Logger13_Byte6 0;
BA_ "UserSigValidity" SG_ 3221225472 ESC_Logger13_Byte6 0;
BA_ "GenSigSendType" SG_ 3221225472 ESC_Logger13_Byte6 2;
BA_ "UsrSigPurpose" SG_ 3221225472 ESC_Logger13_Byte6 6;
BA_ "Version" SG_ 3221225472 ESC_Logger13_Byte7 "18.08.01";
BA_ "NetworkRequestHoldingTime" SG_ 3221225472 ESC_Logger13_Byte7 5000;
BA_ "NetworkRequest" SG_ 3221225472 ESC_Logger13_Byte7 0;
BA_ "UserSigValidity" SG_ 3221225472 ESC_Logger13_Byte7 0;
BA_ "GenSigSendType" SG_ 3221225472 ESC_Logger13_Byte7 2;
BA_ "UsrSigPurpose" SG_ 3221225472 ESC_Logger13_Byte7 6;
BA_ "Version" SG_ 3221225472 ESC_Logger13_Byte1 "18.08.01";
BA_ "NetworkRequestHoldingTime" SG_ 3221225472 ESC_Logger13_Byte1 5000;
BA_ "NetworkRequest" SG_ 3221225472 ESC_Logger13_Byte1 0;
BA_ "UserSigValidity" SG_ 3221225472 ESC_Logger13_Byte1 0;
BA_ "GenSigSendType" SG_ 3221225472 ESC_Logger13_Byte1 2;
BA_ "UsrSigPurpose" SG_ 3221225472 ESC_Logger13_Byte1 6;
BA_ "Version" SG_ 3221225472 ICSC_Crc1Val "18.11.08";
BA_ "RoutingFactor" SG_ 3221225472 ICSC_Crc1Val 5;
BA_ "UserSigValidity" SG_ 3221225472 ICSC_Crc1Val 3;
BA_ "GenSigStartValue" SG_ 3221225472 ICSC_Crc1Val 65535;
BA_ "Description" SG_ 3221225472 ICSC_Crc1Val "The data area for CRC calculation is based on the data length (DLC) of the message DB.

The CRC shall be calculated over the entire data block (excluding the CRC bytes) including the user data, alive counter and Data ID

 

- CRC Polynomial (0x1021) , In";
BA_ "Version" SG_ 3221225472 ICSC_BrkActvSta "18.12.08";
BA_ "RoutingFactor" SG_ 3221225472 ICSC_BrkActvSta 5;
BA_ "UserSigValidity" SG_ 3221225472 ICSC_BrkActvSta 3;
BA_ "Description" SG_ 3221225472 ICSC_BrkActvSta "ICSC Brake Control Activation Status";
BA_ "Version" SG_ 3221225472 DAC_RwsOvrlayStrkReq "19.03.08";
BA_ "RoutingFactor" SG_ 3221225472 DAC_RwsOvrlayStrkReq 5;
BA_ "UserSigValidity" SG_ 3221225472 DAC_RwsOvrlayStrkReq 3;
BA_ "GenSigStartValue" SG_ 3221225472 DAC_RwsOvrlayStrkReq 32767;
BA_ "Description" SG_ 3221225472 DAC_RwsOvrlayStrkReq "RWS Overlay Stroke Request for Dynamic Angle Control";
BA_ "Version" SG_ 3221225472 ICSC_AlvCnt1Val "18.11.08";
BA_ "RoutingFactor" SG_ 3221225472 ICSC_AlvCnt1Val 5;
BA_ "UserSigValidity" SG_ 3221225472 ICSC_AlvCnt1Val 3;
BA_ "Description" SG_ 3221225472 ICSC_AlvCnt1Val "For the first transmission request for a data element the counter shall be initialized with 0 and shall be incremented by 1 for every subsequent send request. 

When the counter reaches the maximum value(0xFF), then it shall restart with 0 for the next s";
BA_ "Version" SG_ 3221225472 DAC_RwsActvSta "18.12.08";
BA_ "RoutingFactor" SG_ 3221225472 DAC_RwsActvSta 5;
BA_ "UserSigValidity" SG_ 3221225472 DAC_RwsActvSta 3;
BA_ "Description" SG_ 3221225472 DAC_RwsActvSta "DAC(RWS) Activation Flag";
BA_ "Version" SG_ 3221225472 DAC_RwsDfctvSta "18.12.08";
BA_ "RoutingFactor" SG_ 3221225472 DAC_RwsDfctvSta 5;
BA_ "UserSigValidity" SG_ 3221225472 DAC_RwsDfctvSta 3;
BA_ "Description" SG_ 3221225472 DAC_RwsDfctvSta "Information regarding to the DAC(RWS) 'defective' indication";
BA_ "Version" SG_ 3221225472 DAC_RwsCtrlMod "18.12.08";
BA_ "RoutingFactor" SG_ 3221225472 DAC_RwsCtrlMod 5;
BA_ "UserSigValidity" SG_ 3221225472 DAC_RwsCtrlMod 3;
BA_ "Description" SG_ 3221225472 DAC_RwsCtrlMod "Information regarding to the DAC(RWS) mode";
BA_ "Version" SG_ 3221225472 DSDC_EcsFLNrmlCurrReq "18.11.06";
BA_ "RoutingFactor" SG_ 3221225472 DSDC_EcsFLNrmlCurrReq 5;
BA_ "UserSigValidity" SG_ 3221225472 DSDC_EcsFLNrmlCurrReq 3;
BA_ "Description" SG_ 3221225472 DSDC_EcsFLNrmlCurrReq "DSDC Request Normalized Current to ECS FL (%)



0~100%=00h~C8h

C9h~FEh:Reserved

FFh:Invalid





(PH)=0.5*(HEX) [%]



- 0%: Full Soft

- 100%: Full Hard";
BA_ "Version" SG_ 3221225472 DSDC_EcsFRNrmlCurrReq "18.11.06";
BA_ "RoutingFactor" SG_ 3221225472 DSDC_EcsFRNrmlCurrReq 5;
BA_ "UserSigValidity" SG_ 3221225472 DSDC_EcsFRNrmlCurrReq 3;
BA_ "Description" SG_ 3221225472 DSDC_EcsFRNrmlCurrReq "DSDC Request Normalized Current to ECS FR (%)



0~100%=00h~C8h

C9h~FEh:Reserved

FFh:Invalid





(PH)=0.5*(HEX) [%]



- 0%: Full Soft

- 100%: Full Hard";
BA_ "Version" SG_ 3221225472 DSDC_EcsRLNrmlCurrReq "18.11.06";
BA_ "RoutingFactor" SG_ 3221225472 DSDC_EcsRLNrmlCurrReq 5;
BA_ "UserSigValidity" SG_ 3221225472 DSDC_EcsRLNrmlCurrReq 3;
BA_ "Description" SG_ 3221225472 DSDC_EcsRLNrmlCurrReq "DSDC Request Normalized Current to ECS RL (%)



0~100%=00h~C8h

C9h~FEh:Reserved

FFh:Invalid





(PH)=0.5*(HEX) [%]



- 0%: Full Soft

- 100%: Full Hard";
BA_ "Version" SG_ 3221225472 DSDC_EcsRRNrmlCurrReq "18.11.06";
BA_ "RoutingFactor" SG_ 3221225472 DSDC_EcsRRNrmlCurrReq 5;
BA_ "UserSigValidity" SG_ 3221225472 DSDC_EcsRRNrmlCurrReq 3;
BA_ "Description" SG_ 3221225472 DSDC_EcsRRNrmlCurrReq "DSDC Request Normalized Current to ECS RR (%)



0~100%=00h~C8h

C9h~FEh:Reserved

FFh:Invalid





(PH)=0.5*(HEX) [%]



- 0%: Full Soft

- 100%: Full Hard";
BA_ "Version" SG_ 3221225472 DSDC_EcsActvSta "18.10.07";
BA_ "RoutingFactor" SG_ 3221225472 DSDC_EcsActvSta 5;
BA_ "UserSigValidity" SG_ 3221225472 DSDC_EcsActvSta 3;
BA_ "Description" SG_ 3221225472 DSDC_EcsActvSta "DSDC Activation Flag";
BA_ "Version" SG_ 3221225472 DSDC_EcsDfctvSta "17.12.00";
BA_ "RoutingFactor" SG_ 3221225472 DSDC_EcsDfctvSta 5;
BA_ "UserSigValidity" SG_ 3221225472 DSDC_EcsDfctvSta 3;
BA_ "Description" SG_ 3221225472 DSDC_EcsDfctvSta "Information regarding to the DSDC 'defective' indication";
BA_ "Version" SG_ 3221225472 DTVC_AwdTqReq "17.12.00";
BA_ "RoutingFactor" SG_ 3221225472 DTVC_AwdTqReq 5;
BA_ "UserSigValidity" SG_ 3221225472 DTVC_AwdTqReq 3;
BA_ "Description" SG_ 3221225472 DTVC_AwdTqReq "AWD Torque Request for Dynamic Torque Vectoring Control";
BA_ "Version" SG_ 3221225472 DTVC_AwdActvSta "18.01.07";
BA_ "RoutingFactor" SG_ 3221225472 DTVC_AwdActvSta 5;
BA_ "UserSigValidity" SG_ 3221225472 DTVC_AwdActvSta 3;
BA_ "Description" SG_ 3221225472 DTVC_AwdActvSta "DTVC(4WD) Activation Flag";
BA_ "Version" SG_ 3221225472 DTVC_AwdDfctvSta "17.12.00";
BA_ "RoutingFactor" SG_ 3221225472 DTVC_AwdDfctvSta 5;
BA_ "UserSigValidity" SG_ 3221225472 DTVC_AwdDfctvSta 3;
BA_ "Description" SG_ 3221225472 DTVC_AwdDfctvSta "Information regarding to the DTVC(4WD) 'defective' indication";
BA_ "Version" SG_ 3221225472 ESC_Logger14_Byte0 "18.08.01";
BA_ "NetworkRequestHoldingTime" SG_ 3221225472 ESC_Logger14_Byte0 5000;
BA_ "NetworkRequest" SG_ 3221225472 ESC_Logger14_Byte0 0;
BA_ "UserSigValidity" SG_ 3221225472 ESC_Logger14_Byte0 0;
BA_ "GenSigSendType" SG_ 3221225472 ESC_Logger14_Byte0 2;
BA_ "UsrSigPurpose" SG_ 3221225472 ESC_Logger14_Byte0 6;
BA_ "Version" SG_ 3221225472 ESC_Logger14_Byte2 "18.08.01";
BA_ "NetworkRequestHoldingTime" SG_ 3221225472 ESC_Logger14_Byte2 5000;
BA_ "NetworkRequest" SG_ 3221225472 ESC_Logger14_Byte2 0;
BA_ "UserSigValidity" SG_ 3221225472 ESC_Logger14_Byte2 0;
BA_ "GenSigSendType" SG_ 3221225472 ESC_Logger14_Byte2 2;
BA_ "UsrSigPurpose" SG_ 3221225472 ESC_Logger14_Byte2 6;
BA_ "Version" SG_ 3221225472 ESC_Logger14_Byte3 "18.08.01";
BA_ "NetworkRequestHoldingTime" SG_ 3221225472 ESC_Logger14_Byte3 5000;
BA_ "NetworkRequest" SG_ 3221225472 ESC_Logger14_Byte3 0;
BA_ "UserSigValidity" SG_ 3221225472 ESC_Logger14_Byte3 0;
BA_ "GenSigSendType" SG_ 3221225472 ESC_Logger14_Byte3 2;
BA_ "UsrSigPurpose" SG_ 3221225472 ESC_Logger14_Byte3 6;
BA_ "Version" SG_ 3221225472 ESC_Logger14_Byte4 "18.08.01";
BA_ "NetworkRequestHoldingTime" SG_ 3221225472 ESC_Logger14_Byte4 5000;
BA_ "NetworkRequest" SG_ 3221225472 ESC_Logger14_Byte4 0;
BA_ "UserSigValidity" SG_ 3221225472 ESC_Logger14_Byte4 0;
BA_ "GenSigSendType" SG_ 3221225472 ESC_Logger14_Byte4 2;
BA_ "UsrSigPurpose" SG_ 3221225472 ESC_Logger14_Byte4 6;
BA_ "Version" SG_ 3221225472 ESC_Logger14_Byte5 "18.08.01";
BA_ "NetworkRequestHoldingTime" SG_ 3221225472 ESC_Logger14_Byte5 5000;
BA_ "NetworkRequest" SG_ 3221225472 ESC_Logger14_Byte5 0;
BA_ "UserSigValidity" SG_ 3221225472 ESC_Logger14_Byte5 0;
BA_ "GenSigSendType" SG_ 3221225472 ESC_Logger14_Byte5 2;
BA_ "UsrSigPurpose" SG_ 3221225472 ESC_Logger14_Byte5 6;
BA_ "Version" SG_ 3221225472 ESC_Logger14_Byte6 "18.08.01";
BA_ "NetworkRequestHoldingTime" SG_ 3221225472 ESC_Logger14_Byte6 5000;
BA_ "NetworkRequest" SG_ 3221225472 ESC_Logger14_Byte6 0;
BA_ "UserSigValidity" SG_ 3221225472 ESC_Logger14_Byte6 0;
BA_ "GenSigSendType" SG_ 3221225472 ESC_Logger14_Byte6 2;
BA_ "UsrSigPurpose" SG_ 3221225472 ESC_Logger14_Byte6 6;
BA_ "Version" SG_ 3221225472 ESC_Logger14_Byte7 "18.08.01";
BA_ "NetworkRequestHoldingTime" SG_ 3221225472 ESC_Logger14_Byte7 5000;
BA_ "NetworkRequest" SG_ 3221225472 ESC_Logger14_Byte7 0;
BA_ "UserSigValidity" SG_ 3221225472 ESC_Logger14_Byte7 0;
BA_ "GenSigSendType" SG_ 3221225472 ESC_Logger14_Byte7 2;
BA_ "UsrSigPurpose" SG_ 3221225472 ESC_Logger14_Byte7 6;
BA_ "Version" SG_ 3221225472 ESC_Logger14_Byte1 "18.08.01";
BA_ "NetworkRequestHoldingTime" SG_ 3221225472 ESC_Logger14_Byte1 5000;
BA_ "NetworkRequest" SG_ 3221225472 ESC_Logger14_Byte1 0;
BA_ "UserSigValidity" SG_ 3221225472 ESC_Logger14_Byte1 0;
BA_ "GenSigSendType" SG_ 3221225472 ESC_Logger14_Byte1 2;
BA_ "UsrSigPurpose" SG_ 3221225472 ESC_Logger14_Byte1 6;
BA_ "Version" SG_ 3221225472 ESC_Logger15_Byte0 "18.08.01";
BA_ "NetworkRequestHoldingTime" SG_ 3221225472 ESC_Logger15_Byte0 5000;
BA_ "NetworkRequest" SG_ 3221225472 ESC_Logger15_Byte0 0;
BA_ "UserSigValidity" SG_ 3221225472 ESC_Logger15_Byte0 0;
BA_ "GenSigSendType" SG_ 3221225472 ESC_Logger15_Byte0 2;
BA_ "UsrSigPurpose" SG_ 3221225472 ESC_Logger15_Byte0 6;
BA_ "Version" SG_ 3221225472 ESC_Logger15_Byte2 "18.08.01";
BA_ "NetworkRequestHoldingTime" SG_ 3221225472 ESC_Logger15_Byte2 5000;
BA_ "NetworkRequest" SG_ 3221225472 ESC_Logger15_Byte2 0;
BA_ "UserSigValidity" SG_ 3221225472 ESC_Logger15_Byte2 0;
BA_ "GenSigSendType" SG_ 3221225472 ESC_Logger15_Byte2 2;
BA_ "UsrSigPurpose" SG_ 3221225472 ESC_Logger15_Byte2 6;
BA_ "Version" SG_ 3221225472 ESC_Logger15_Byte3 "18.08.01";
BA_ "NetworkRequestHoldingTime" SG_ 3221225472 ESC_Logger15_Byte3 5000;
BA_ "NetworkRequest" SG_ 3221225472 ESC_Logger15_Byte3 0;
BA_ "UserSigValidity" SG_ 3221225472 ESC_Logger15_Byte3 0;
BA_ "GenSigSendType" SG_ 3221225472 ESC_Logger15_Byte3 2;
BA_ "UsrSigPurpose" SG_ 3221225472 ESC_Logger15_Byte3 6;
BA_ "Version" SG_ 3221225472 ESC_Logger15_Byte4 "18.08.01";
BA_ "NetworkRequestHoldingTime" SG_ 3221225472 ESC_Logger15_Byte4 5000;
BA_ "NetworkRequest" SG_ 3221225472 ESC_Logger15_Byte4 0;
BA_ "UserSigValidity" SG_ 3221225472 ESC_Logger15_Byte4 0;
BA_ "GenSigSendType" SG_ 3221225472 ESC_Logger15_Byte4 2;
BA_ "UsrSigPurpose" SG_ 3221225472 ESC_Logger15_Byte4 6;
BA_ "Version" SG_ 3221225472 ESC_Logger15_Byte5 "18.08.01";
BA_ "NetworkRequestHoldingTime" SG_ 3221225472 ESC_Logger15_Byte5 5000;
BA_ "NetworkRequest" SG_ 3221225472 ESC_Logger15_Byte5 0;
BA_ "UserSigValidity" SG_ 3221225472 ESC_Logger15_Byte5 0;
BA_ "GenSigSendType" SG_ 3221225472 ESC_Logger15_Byte5 2;
BA_ "UsrSigPurpose" SG_ 3221225472 ESC_Logger15_Byte5 6;
BA_ "Version" SG_ 3221225472 ESC_Logger15_Byte6 "18.08.01";
BA_ "NetworkRequestHoldingTime" SG_ 3221225472 ESC_Logger15_Byte6 5000;
BA_ "NetworkRequest" SG_ 3221225472 ESC_Logger15_Byte6 0;
BA_ "UserSigValidity" SG_ 3221225472 ESC_Logger15_Byte6 0;
BA_ "GenSigSendType" SG_ 3221225472 ESC_Logger15_Byte6 2;
BA_ "UsrSigPurpose" SG_ 3221225472 ESC_Logger15_Byte6 6;
BA_ "Version" SG_ 3221225472 ESC_Logger15_Byte7 "18.08.01";
BA_ "NetworkRequestHoldingTime" SG_ 3221225472 ESC_Logger15_Byte7 5000;
BA_ "NetworkRequest" SG_ 3221225472 ESC_Logger15_Byte7 0;
BA_ "UserSigValidity" SG_ 3221225472 ESC_Logger15_Byte7 0;
BA_ "GenSigSendType" SG_ 3221225472 ESC_Logger15_Byte7 2;
BA_ "UsrSigPurpose" SG_ 3221225472 ESC_Logger15_Byte7 6;
BA_ "Version" SG_ 3221225472 ESC_Logger15_Byte1 "18.08.01";
BA_ "NetworkRequestHoldingTime" SG_ 3221225472 ESC_Logger15_Byte1 5000;
BA_ "NetworkRequest" SG_ 3221225472 ESC_Logger15_Byte1 0;
BA_ "UserSigValidity" SG_ 3221225472 ESC_Logger15_Byte1 0;
BA_ "GenSigSendType" SG_ 3221225472 ESC_Logger15_Byte1 2;
BA_ "UsrSigPurpose" SG_ 3221225472 ESC_Logger15_Byte1 6;
BA_ "Version" SG_ 3221225472 ESC_Logger16_Byte0 "18.08.01";
BA_ "NetworkRequestHoldingTime" SG_ 3221225472 ESC_Logger16_Byte0 5000;
BA_ "NetworkRequest" SG_ 3221225472 ESC_Logger16_Byte0 0;
BA_ "UserSigValidity" SG_ 3221225472 ESC_Logger16_Byte0 0;
BA_ "GenSigSendType" SG_ 3221225472 ESC_Logger16_Byte0 2;
BA_ "UsrSigPurpose" SG_ 3221225472 ESC_Logger16_Byte0 6;
BA_ "Version" SG_ 3221225472 ESC_Logger16_Byte2 "18.08.01";
BA_ "NetworkRequestHoldingTime" SG_ 3221225472 ESC_Logger16_Byte2 5000;
BA_ "NetworkRequest" SG_ 3221225472 ESC_Logger16_Byte2 0;
BA_ "UserSigValidity" SG_ 3221225472 ESC_Logger16_Byte2 0;
BA_ "GenSigSendType" SG_ 3221225472 ESC_Logger16_Byte2 2;
BA_ "UsrSigPurpose" SG_ 3221225472 ESC_Logger16_Byte2 6;
BA_ "Version" SG_ 3221225472 ESC_Logger16_Byte3 "18.08.01";
BA_ "NetworkRequestHoldingTime" SG_ 3221225472 ESC_Logger16_Byte3 5000;
BA_ "NetworkRequest" SG_ 3221225472 ESC_Logger16_Byte3 0;
BA_ "UserSigValidity" SG_ 3221225472 ESC_Logger16_Byte3 0;
BA_ "GenSigSendType" SG_ 3221225472 ESC_Logger16_Byte3 2;
BA_ "UsrSigPurpose" SG_ 3221225472 ESC_Logger16_Byte3 6;
BA_ "Version" SG_ 3221225472 ESC_Logger16_Byte4 "18.08.01";
BA_ "NetworkRequestHoldingTime" SG_ 3221225472 ESC_Logger16_Byte4 5000;
BA_ "NetworkRequest" SG_ 3221225472 ESC_Logger16_Byte4 0;
BA_ "UserSigValidity" SG_ 3221225472 ESC_Logger16_Byte4 0;
BA_ "GenSigSendType" SG_ 3221225472 ESC_Logger16_Byte4 2;
BA_ "UsrSigPurpose" SG_ 3221225472 ESC_Logger16_Byte4 6;
BA_ "Version" SG_ 3221225472 ESC_Logger16_Byte5 "18.08.01";
BA_ "NetworkRequestHoldingTime" SG_ 3221225472 ESC_Logger16_Byte5 5000;
BA_ "NetworkRequest" SG_ 3221225472 ESC_Logger16_Byte5 0;
BA_ "UserSigValidity" SG_ 3221225472 ESC_Logger16_Byte5 0;
BA_ "GenSigSendType" SG_ 3221225472 ESC_Logger16_Byte5 2;
BA_ "UsrSigPurpose" SG_ 3221225472 ESC_Logger16_Byte5 6;
BA_ "Version" SG_ 3221225472 ESC_Logger16_Byte6 "18.08.01";
BA_ "NetworkRequestHoldingTime" SG_ 3221225472 ESC_Logger16_Byte6 5000;
BA_ "NetworkRequest" SG_ 3221225472 ESC_Logger16_Byte6 0;
BA_ "UserSigValidity" SG_ 3221225472 ESC_Logger16_Byte6 0;
BA_ "GenSigSendType" SG_ 3221225472 ESC_Logger16_Byte6 2;
BA_ "UsrSigPurpose" SG_ 3221225472 ESC_Logger16_Byte6 6;
BA_ "Version" SG_ 3221225472 ESC_Logger16_Byte7 "18.08.01";
BA_ "NetworkRequestHoldingTime" SG_ 3221225472 ESC_Logger16_Byte7 5000;
BA_ "NetworkRequest" SG_ 3221225472 ESC_Logger16_Byte7 0;
BA_ "UserSigValidity" SG_ 3221225472 ESC_Logger16_Byte7 0;
BA_ "GenSigSendType" SG_ 3221225472 ESC_Logger16_Byte7 2;
BA_ "UsrSigPurpose" SG_ 3221225472 ESC_Logger16_Byte7 6;
BA_ "Version" SG_ 3221225472 ESC_Logger16_Byte1 "18.08.01";
BA_ "NetworkRequestHoldingTime" SG_ 3221225472 ESC_Logger16_Byte1 5000;
BA_ "NetworkRequest" SG_ 3221225472 ESC_Logger16_Byte1 0;
BA_ "UserSigValidity" SG_ 3221225472 ESC_Logger16_Byte1 0;
BA_ "GenSigSendType" SG_ 3221225472 ESC_Logger16_Byte1 2;
BA_ "UsrSigPurpose" SG_ 3221225472 ESC_Logger16_Byte1 6;
BA_ "Version" SG_ 3221225472 ESC_Logger17_Byte0 "18.08.01";
BA_ "NetworkRequestHoldingTime" SG_ 3221225472 ESC_Logger17_Byte0 5000;
BA_ "NetworkRequest" SG_ 3221225472 ESC_Logger17_Byte0 0;
BA_ "UserSigValidity" SG_ 3221225472 ESC_Logger17_Byte0 0;
BA_ "GenSigSendType" SG_ 3221225472 ESC_Logger17_Byte0 2;
BA_ "UsrSigPurpose" SG_ 3221225472 ESC_Logger17_Byte0 6;
BA_ "Version" SG_ 3221225472 ESC_Logger17_Byte2 "18.08.01";
BA_ "NetworkRequestHoldingTime" SG_ 3221225472 ESC_Logger17_Byte2 5000;
BA_ "NetworkRequest" SG_ 3221225472 ESC_Logger17_Byte2 0;
BA_ "UserSigValidity" SG_ 3221225472 ESC_Logger17_Byte2 0;
BA_ "GenSigSendType" SG_ 3221225472 ESC_Logger17_Byte2 2;
BA_ "UsrSigPurpose" SG_ 3221225472 ESC_Logger17_Byte2 6;
VAL_ 3221225472 Brake_Control_FL 0 "Front left control off" 1 "Front left control on" 2 "Not used" 3 "Error Indicator" ;
VAL_ 3221225472 Brake_Control_FR 0 "Front right control off" 1 "Front right control on" 2 "Not used" 3 "Error Indicator" ;
VAL_ 3221225472 Brake_Control_RL 0 "Rear left control off" 1 "Rear left control on" 2 "Not used" 3 "Error Indicator" ;
VAL_ 3221225472 Brake_Control_RR 0 "Rear right control off" 1 "Rear right control on" 2 "Not used" 3 "Error Indicator" ;
VAL_ 3221225472 BCW_Sta 0 "Default" 1 "System is Off" 2 "System Passive" 3 "System Active" 4 "System Failure" 5 "System Blockage" 6 "System minor failure" 7 "Reserved" 8 "Reserved" 9 "Reserved" 10 "Reserved" 11 "Reserved" 12 "Reserved" 13 "Reserved" 14 "Reserved" ;
VAL_ 3221225472 BCW_OnOffEquipSta 0 "Default" 1 "Off" 2 "Warning" 3 "Invalid" ;
VAL_ 3221225472 BCW_LftIndSta 0 "Indicator output off" 1 "Indicator on (information)" 2 "Indicator blinking(warning)" 3 "Indicator output check" ;
VAL_ 3221225472 BCW_RtIndSta 0 "Indicator output off" 1 "Indicator on (information)" 2 "Indicator blinking(warning)" 3 "Indicator output check" ;
VAL_ 3221225472 BCW_LftSndWrngSta 0 "Speaker is Off" 1 "Speaker On" 2 "Not used" 3 "Error Indicator" ;
VAL_ 3221225472 BCW_RtSndWrngSta 0 "Speaker is Off" 1 "Speaker On" 2 "Not used" 3 "Error Indicator" ;
VAL_ 3221225472 BCW_SnstvtyModRetVal 0 "Default" 1 "Late" 2 "Normal" 3 "Early" 4 "Reserved" 5 "Reserved" 6 "Reserved" 7 "Invalid" ;
VAL_ 3221225472 BCW_IndSta 0 "Default" 1 "Normal" 2 "Inidicator Failure" 3 "Reserved" ;
VAL_ 3221225472 BCA_Sta 0 "Default" 1 "BCA Function is off" 2 "BCA Function is passive" 3 "BCA Function active" 4 "BCA Function failure" 5 "BCA Function Blockage" 6 ":BCA Function minor failure" 7 "Failure low priority" 8 "Reserved" 9 "Reserved" 10 "Reserved" 11 "Reserved" 12 "Reserved" 13 "Reserved" 14 "Reserved" ;
VAL_ 3221225472 BCA_OnOffEquipSta 0 "Default" 1 "Off" 2 "Warning" 3 "Assist" 4 "Reserved" 5 "Reserved" 6 "Reserved" 7 "Invalid" ;
VAL_ 3221225472 BCA_R_Brake_Warning 0 "No Warning" 1 "BCA Left Warning is On" 2 "BCA Right Warning is On" 3 "Left Control" 4 "Right Control" 5 "Reserved" 6 "Reserved" 7 "Error Indicator" ;
VAL_ 3221225472 BCA_Plus_BrkCmdSta 0 "BCA_Plus Brake off" 1 "BCA_Plus Brake on" 2 "Not used" 3 "Error Indicator" ;
VAL_ 3221225472 BCA_Plus_LftWrngSta 0 "BCA_Plus Left Warning is Off" 1 "BCA_Plus Left Warning is On" 2 "BCA_Plus Left Control is On" 3 "BCA_Plus Left Control is Ended" ;
VAL_ 3221225472 BCA_Plus_RtWrngSta 0 "BCA_Plus Right Warning is Off" 1 "BCA_Plus Right Warning is On" 2 "BCA_Plus Right Control is On" 3 "BCA_Plus Right Control is Ended" ;
VAL_ 3221225472 BCA_Plus_OnOffEquipSta 0 "Default" 1 "Off" 2 "Warning" 3 "Assist" 4 "Reserved" 5 "Reserved" 6 "Reserved" 7 "Invalid" ;
VAL_ 3221225472 BCA_Plus_FuncStat 0 "ESC Normal" 1 "Not support (ESC failure)" 2 "Not used" 3 "Error Indicator" ;
VAL_ 3221225472 BCA_Plus_Sta 0 "Default" 1 "BCA Plus Function is off" 2 "BCA Plus Function is passive" 3 "BCA Plus Function active" 4 "BCA Plus Function failure" 5 "BCA Plus Function Blockage" 6 "BCA Plus Function minor failure" 7 "Reserved" 8 "Reserved" 9 "Reserved" 10 "Reserved" 11 "Reserved" 12 "Reserved" 13 "Reserved" 14 "Reserved" ;
VAL_ 3221225472 SAS_CmdCodWrdVal 3 "Request calibration and acceptance of SAS_CID" 5 "Reset SAS_CAL flag" ;
VAL_ 3221225472 ECSIVSS_RdIndxVal 0 "Normal" 1 "Small Rough" 2 "Small Wave" 4 "Bump" 8 "Big Rough" 10 "Long Wave" 14 "Not used" 15 "Invalid" ;
VAL_ 3221225472 HU_LanguageInfo 0 "Off" 1 "Korea" 2 "English(US)" 3 "English(UK)" 4 "Simplified chinese" 5 "Traditional chinese" 6 "French(EU)" 7 "Spanish(EU)" 8 "Arabic" 9 "Czech" 10 "Danish" 11 "German" 12 "Italian" 13 "Dutch" 14 "Polish" 15 "Portuguese" 16 "Russain" 17 "Slovak" 18 "Swedish" 19 "Turkish" 20 "French(US)" 21 "Spanish(US)" 22 "English(India)" 23 "Norwegian" 24 "Finnish" 25 "Indonesian" 26 "Brazilian Portuguese" 27 "Malay" 28 "Hungarian" 29 "English (Australia)" 30 "Japanese" 31 "0x1F~0xFE:reserved" 254 "0x1F~0xFE:reserved" 255 "Invalid" ;
VAL_ 3221225472 HU_MuteStatus 0 "Off" 1 "Mute On" 2 "reserved" 3 "Invalid" ;
VAL_ 3221225472 HU_WelcomeReady 0 "Default" 1 "Ready" 2 "Reserved" 3 "Invalid" ;
VAL_ 3221225472 HU_UsmSupport 0 "Not support" 1 "Support" 2 "reserved" 3 "Invalid" ;
VAL_ 3221225472 HU_NaviStatus 0 "Booting" 1 "Normal Operation" 2 "No SD Card(Map)" 3 "Invalid" ;
VAL_ 3221225472 HU_NaviDisp 0 "Non_Navi" 1 "Navi" 2 "reserved" 3 "Invalid" ;
VAL_ 3221225472 HU_BVM_Display_Message 0 "Not Used" 1 "No Message" 2 "Rain_Warning Message" 3 "Reserved" 4 "Reserved" 5 "Reserved" 6 "Reserved" 7 "Invalid" ;
VAL_ 3221225472 HU_SVM_View_Display 0 "Not Used" 1 "AVM Display View OFF" 31 "Invalid" 2 "AVM Display View ON(LH)" 3 "AVM Display View ON(RH)" 4 "Reserved" 5 "Reserved" 6 "Reserved" 7 "Reserved" 8 "Reserved" 9 "Reserved" 10 "Reserved" 11 "Reserved" 12 "Reserved" 13 "Reserved" 14 "Reserved" 15 "Reserved" 16 "Reserved" 17 "Reserved" 18 "Reserved" 19 "Reserved" 20 "Reserved" 21 "Reserved" 22 "Reserved" 23 "Reserved" 24 "Reserved" 25 "Reserved" 26 "Reserved" 27 "Reserved" 28 "Reserved" 29 "Reserved" 30 "Reserved" ;
VAL_ 3221225472 HU_NaviCamSettingStatus 0 "Navi Camera Alert Setting Status" 1 "Navi Camera Alert Setting Status" 2 "Navi Camera Alert Setting Status" 3 "Navi Camera Alert Setting Status" 4 "Navi Camera Alert Setting Status" 5 "Navi Camera Alert Setting Status" 6 "Navi Camera Alert Setting Status" 7 "Navi Camera Alert Setting Status" 8 "Navi Camera Alert Setting Status" 9 "Navi Camera Alert Setting Status" 10 "Navi Camera Alert Setting Status" 11 "Navi Camera Alert Setting Status" 12 "Navi Camera Alert Setting Status" 13 "Navi Camera Alert Setting Status" 14 "Navi Camera Alert Setting Status" 15 "Navi Camera Alert Setting Status" 16 "Navi Camera Alert Setting Status" 17 "Navi Camera Alert Setting Status" 18 "Navi Camera Alert Setting Status" 19 "Navi Camera Alert Setting Status" 20 "Navi Camera Alert Setting Status" 21 "Navi Camera Alert Setting Status" 22 "Navi Camera Alert Setting Status" 23 "Navi Camera Alert Setting Status" 24 "Navi Camera Alert Setting Status" 25 "Navi Camera Alert Setting Status" 26 "Navi Camera Alert Setting Status" 27 "Navi Camera Alert Setting Status" 28 "Navi Camera Alert Setting Status" 29 "Navi Camera Alert Setting Status" 30 "Navi Camera Alert Setting Status" 31 "Navi Camera Alert Setting Status" 32 "0x20~0xFE:Reserved" 254 "0x20~0xFE:Reserved" 255 "Invalid" ;
VAL_ 3221225472 HU_VolumeStatus 63 "Invalid" ;
VAL_ 3221225472 HU_TimeSetting 0 "not used" 1 "User Time" 2 "GPS Time" 3 "invalid" ;
VAL_ 3221225472 HU_DisplayMinute 0 "0 minute" 59 "59 Minute" 255 "invalid" ;
VAL_ 3221225472 HU_Status 0 "not used" 1 "Booting Head Unit" 2 "GPS receiving" 3 "Setting Mode" 4 "GPS Unavailable Mode" 5 "No GPS" 15 "invalid" ;
VAL_ 3221225472 HU_DisplaySecond 0 "0 minute" 59 "59 second" 255 "invalid" ;
VAL_ 3221225472 HU_DisplayMonth 0 "not used" 1 "1 month" 12 "12 month" 15 "invalid" ;
VAL_ 3221225472 HU_DisplayYear1 0 "19" 1 "20" 2 "21" 3 "invalid" ;
VAL_ 3221225472 HU_DisplayYear2 0 "0 year" 99 "99 year" 255 "invalid" ;
VAL_ 3221225472 HU_DisplayDay 0 "not used" 1 "1 day" 31 "31 day" 255 "invalid" ;
VAL_ 3221225472 HU_AM_PM_INFO 0 "Not Used" 1 "AM" 2 "PM" 3 "invalid" ;
VAL_ 3221225472 HU_ZeroDetection 0 "Off(Default)" 1 "Zero Detction" 2 "Reserved" 3 "Invalid" ;
VAL_ 3221225472 HU_TimeFormat 0 "Not used" 1 "12Hour" 2 "24Hour" 3 "invalid" ;
VAL_ 3221225472 HU_ComRefresh 0 "Not Used" 1 "Internal Clock None" 2 "Internal Clock Exist" 3 "Invalid" ;
VAL_ 3221225472 HU_ClockInfo 0 "Not Used" 1 "ACLOCK Refresh" 2 "Not Used" 3 "invalid" ;
VAL_ 3221225472 HU_DisplayHour 0 "0 Hour" 23 "23 Hour" 255 "invalid" ;
VAL_ 3221225472 HU_Type 16 "AVN(Tuner DVD KOR)" 17 "AVN(Tuner DVD EUR)" 18 "AVN(Tuner DVD China)" 19 "AVN(Tuner DVD Japan)" 20 "AVN(Tuner DVD EUR)" 21 "AVN(Tuner CDP KOR)" 22 "AVN(Tuner CDP EUR)" 23 "AVN(Tuner CDP China)" 24 "AVN(Tuner CDP Japan)" 25 "AVN(Tuner CDP EUR)" 32 "AVNT (Open)" 33 "AVNT (Not open)" 48 "Economic Audio" 64 "Standard Audio (3.0 below)" 65 "Standard Audio 4.0" 66 "STD Audio-3.0Below,No interwork" 67 "Audio 4.0 Value" 80 "AV(Tuner DVD KOR)" 81 "AV(Tuner DVD EUR)" 82 "AV(Tuner DVD China)" 83 "AV(Tuner DVD Japan)" 84 "AV(Tuner DVD EUR)" 85 "AV(Tuner CDP KOR)" 86 "AV(Tuner CDP EUR)" 87 "AV(Tuner CDP China)" 88 "AV(Tuner CDP Japan)" 89 "AV(Tuner CDP EUR)" 96 "AVN 4.0" 97 "Premium AVN2.0" 98 "EU AVN 2.0" 99 "Super Premium w Navi" 100 "Super Premium w_o Navi" 101 "Premium w Navi" 102 "Premium w_o Navi" 103 "Display Audio w_o Navi" 104 "Integrated AVN 1.0 Mobis" 105 "Gen5 Standard Nav Wide" 112 "Compact AVN & Integrated AVN 1.0 LG" 128 "Premium Navi 5th Gen(w_Navi)" 129 "Premium Navi 5th Gen(w_o Navi)" 130 "Premium Navi 6th Gen(w_Navi)" 131 "Premium Navi 6th Gen(w_o Navi)" 238 "India PIO w_o CLU interface" 239 "India PIO w_CLU interface" 250 "PIO AVN" 251 "China only OEM AV" 252 "China OPIO w_o CLU interface" 253 "China OPIO w_CLU interface" 254 "China OEM AVNT" 255 "Invalid" ;
VAL_ 3221225472 HU_DistributeInfo 0 "Default (Korea)" 1 "Korea" 2 "North America" 3 "Canada" 4 "East Europe" 5 "West Europe" 6 "China" 7 "India" 8 "Australia" 9 "Middle East" 10 "Africa" 11 "South America" 12 "Russia" 13 "Reserved" 14 "General" 15 "0x0F~0xFE:Reserved" 254 "0x0F~0xFE:Reserved" 255 "Invalid" ;
VAL_ 3221225472 HU_OptionInfo 32768 "Invalid" ;
VAL_ 3221225472 HU_CamViewDispStatus 0 "Default(Camera View not displayed)" 1 "Camera View displayed" 2 "Reserved" 3 "Invalid" ;
VAL_ 3221225472 HU_AMP_EQVariant 0 "Default" 1 "WGN" 2 "WGN PHEV" 3 "5DR" 4 "SB" 5 "CUV" 6 "Reserved" 7 "Reserved" 8 "Reserved" 9 "Reserved" 10 "Reserved" 11 "Reserved" 12 "Reserved" 13 "Reserved" 14 "Reserved" 15 "Reserved" 16 "Reserved" 17 "Reserved" 18 "Reserved" 19 "Reserved" 20 "Reserved" 21 "Reserved" 22 "Reserved" 23 "Reserved" 24 "Reserved" 25 "Reserved" 26 "Reserved" 27 "Reserved" 28 "Reserved" 29 "Reserved" 30 "Reserved" 31 "Invalid" ;
VAL_ 3221225472 HU_AdasSupport 0 "Not Support" 1 "ADAS Support(General Map)" 2 "ADAS Support(Precise Map v1)" 3 "ADAS Support(Precise Map v2)" 4 "ADAS Support(Handshaking)" 5 "Reserved" 6 "Reserved" 7 "Invalid" ;
VAL_ 3221225472 SCC_NSCCOpSta 0 "Off" 1 "Ready" 2 "Act" 3 "Error Indicator" ;
VAL_ 3221225472 SCC_NSCCOnOffSta 0 "Default" 1 "Off" 2 "On" 3 "Invalid" ;
VAL_ 3221225472 SCC_ObjSta 0 "No in-path object detected" 1 "In-path object detected (uncontrollable)" 2 "In-path object detected (controllable:longitudinal)" 3 "Reserved" 4 "Reserved" 5 "Reserved" 6 "Reserved" 7 "Reserved" ;
VAL_ 3221225472 SCC_SnstvtyModRetVal 0 "Default" 1 "Comford Mode" 2 "Normal Mode" 3 "Dynamic Mode" 4 "Reserved" 5 "Reserved" 6 "Reserved" 7 "Invalid" ;
VAL_ 3221225472 SCC_NSCCAutoSetSpdUpdtSta 0 "Auto Set Speed Update Off" 1 "Auto Set Speed Update On" 2 "Reserved" 3 "Error Indicator" ;
VAL_ 3221225472 SCC_NSCCInfoPUDis 0 "None" 1 "NSCC Warning" 2 "Reserved" 3 "Reserved" 4 "Reserved" 5 "Reserved" 6 "Reserved" 7 "Reserved" ;
VAL_ 3221225472 SCC_AccelReqVal 2047 "Error" ;
VAL_ 3221225472 SCC_AccelReqRawVal 2047 "Error" ;
VAL_ 3221225472 SCC_JrkUppLimVal 127 "No Limit" ;
VAL_ 3221225472 SCC_JrkLwrLimVal 127 "No Limit" ;
VAL_ 3221225472 SCC_AccelLimBandUppVal 0 "Precise Control" ;
VAL_ 3221225472 SCC_AccelLimBandLwrVal 0 "Precise Control" ;
VAL_ 3221225472 SCC_VehStpReq 0 "No request" 1 "Stop control is required" 2 "Not used" 3 "Error Indicator" ;
VAL_ 3221225472 SCC_DclModReq 0 "Deceleration with Engine Braking and Brake Control" 1 "Deceleration with Only Engine Braking" 2 "Not used" 3 "Error Indicator" ;
VAL_ 3221225472 SCC_TrgtDstVal 1501 "0x0x5DD~0x7FF:Reserved" 2047 "0x0x5DD~0x7FF:Reserved" 2046 "Default" 2047 "Error" ;
VAL_ 3221225472 SCC_ObjDstVal 1501 "0x0x5DD~0x7FF:Reserved" 2047 "0x0x5DD~0x7FF:Reserved" 2046 "Default" 2047 "Error" ;
VAL_ 3221225472 SCC_ObjRelSpdVal 4094 "Default" 4095 "Error" ;
VAL_ 3221225472 SCC_ObjLatPosVal 510 "Default" 511 "Error" ;
VAL_ 3221225472 SCC_SysFlrSta 0 "System without error" 1 "Performance degredation" 2 "System temporairy unavailable" 3 "SCC Service Required" ;
VAL_ 3221225472 SCC_MainOnOffSta 0 "OFF" 1 "ON" 2 "Not used" 3 "Error Indicator" ;
VAL_ 3221225472 SCC_OpSta 0 "Off" 1 "Engaged" 2 "Override" 3 "Shutoff" 4 "Canceled or Paused" 5 "Reserved" 6 "Reserved" 7 "Reserved" ;
VAL_ 3221225472 SCC_TakeoverReq 0 "No takeover request" 1 "Takeover request" 2 "Not used" 3 "Error Indicator" ;
VAL_ 3221225472 SCC_InfoDis 0 "-" 1 "Display ��SCC Mode��" 2 "Display ��Conventional Cruise Mode��" 3 "Display ��Object disappeared at low speed��" 4 "Display ��Available to resume acceleration control��" 5 "Reserved" 6 "Reserved" 7 "Invalid" ;
VAL_ 3221225472 SCC_DrvAlrtDis 0 "-" 1 "Display 'SCC Disengaged'" 2 "Display 'No SCC Engage Condition!'" 3 "Display 'Driving Speed Limited'" ;
VAL_ 3221225472 SCC_HeadwayDstSetVal 0 "No time gap set" 1 "1st level distance" 2 "2nd level distance" 3 "3rd level distance" 4 "4th level distance" 5 "Reserved" 6 "Reserved" 7 "Reserved" 8 "Reserved" 9 "Reserved" 10 "Reserved" 11 "Reserved" 12 "Reserved" 13 "Reserved" 14 "SCC-ML Active" 15 "Error Indicator" ;
VAL_ 3221225472 SCC_NSCCAutoSetSpdSta 0 "Auto Set Speed Off" 1 "Auto Set Speed On" 2 "Reserved" 3 "Error Indicator" ;
VAL_ 3221225472 SCC_TrgtSpdSetVal 255 "Error" ;
VAL_ 3221225472 ICSC_BrkActvSta 0 "ICSC Brake Control Inactivate" 1 "ICSC Brake Control Activate" 2 "Not Used" 3 "Error Indicator" ;
VAL_ 3221225472 DAC_RwsOvrlayStrkReq 65535 "Error Indicator" ;
VAL_ 3221225472 DAC_RwsActvSta 0 "DAC(RWS) Inactivate" 1 "DAC(RWS) Activate" 2 "Not used" 3 "Error Indicator" ;
VAL_ 3221225472 DAC_RwsDfctvSta 0 "DAC(RWS) is not defective" 1 "DAC(RWS) is defective" 2 "Not used" 3 "Error Indicator" ;
VAL_ 3221225472 DAC_RwsCtrlMod 0 "Reserved" 1 "Reserved" 2 "Reserved" 3 "Reserved" 4 "Reserved" 5 "Reserved" 6 "Reserved" 7 "Error Indicator" ;
VAL_ 3221225472 DSDC_EcsActvSta 0 "DSDC Inactivate" 1 "DSDC Active mode1" 2 "DSDC Active mode2" 3 "Error Indicator" ;
VAL_ 3221225472 DSDC_EcsDfctvSta 0 "DSDC is not defective" 1 "DSDC is defective" 2 "Not used" 3 "Error Indicator" ;
VAL_ 3221225472 DTVC_AwdActvSta 0 "ICSC(4WD) inactive" 1 "ICSC(4WD) inactive" 2 "ICSC(4WD) active (Torque replace at c point)" 3 "ICSC(4WD) active (Torque replace at e point)" ;
VAL_ 3221225472 DTVC_AwdDfctvSta 0 "DTVC(4WD) is not defective" 1 "DTVC(4WD) is defective" 2 "Not used" 3 "Error Indicator" ;
