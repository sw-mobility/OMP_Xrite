VERSION ""

NS_ :

BS_:

BU_: MXC CGW

BO_ 3221225472 VECTOR__INDEPENDENT_SIG_MSG: 0 Vector__XXX
 SG_ ABS_ESC_Crc1Val : 0|16@1+ (1,0) [0|0] "" Vector__XXX
 SG_ ABS_ESC_AlvCnt1Val : 0|8@1+ (1,0) [0|0] "" Vector__XXX
 SG_ ABS_WrngLmpSta : 0|2@1+ (1,0) [0|0] "" Vector__XXX
 SG_ ABS_DfctvSta : 0|2@1+ (1,0) [0|0] "" Vector__XXX
 SG_ ABS_ActvSta : 0|2@1+ (1,0) [0|0] "" Vector__XXX
 SG_ ABS_DiagSta : 0|2@1+ (1,0) [0|0] "" Vector__XXX
 SG_ EBD_WrngLmpSta : 0|2@1+ (1,0) [0|0] "" Vector__XXX
 SG_ EBD_DfctvSta : 0|2@1+ (1,0) [0|0] "" Vector__XXX
 SG_ ESC_BrkLtActSta : 0|2@1+ (1,0) [0|0] "" Vector__XXX
 SG_ ESS_Sta : 0|2@1+ (1,0) [0|0] "" Vector__XXX
 SG_ ECS_Crc1Val : 0|16@1+ (1,0) [0|0] "" Vector__XXX
 SG_ ECS_AlvCnt1Val : 0|8@1+ (1,0) [0|0] "" Vector__XXX
 SG_ ECS_WrngLmpSta : 0|2@1+ (1,0) [0|0] "" Vector__XXX
 SG_ ECS_DfctvSta : 0|2@1+ (1,0) [0|0] "" Vector__XXX
 SG_ ECS_DmpModSta : 0|3@1+ (1,0) [0|0] "" Vector__XXX
 SG_ ECS_DmpModReq : 0|3@1+ (1,0) [0|0] "" Vector__XXX
 SG_ FR_CMR_Crc1Val : 0|16@1+ (1,0) [0|0] "" Vector__XXX
 SG_ FR_CMR_AlvCnt1Val : 0|8@1+ (1,0) [0|0] "" Vector__XXX
 SG_ HBA_SysOptSta : 0|2@1+ (1,0) [0|0] "" Vector__XXX
 SG_ HBA_SysSta : 0|3@1+ (1,0) [0|0] "" Vector__XXX
 SG_ HBA_IndLmpReq : 0|2@1+ (1,0) [0|0] "" Vector__XXX
 SG_ FCA_Equip_MFC : 0|3@1+ (1,0) [0|0] "" Vector__XXX
 SG_ HBA_OptUsmSta : 0|2@1+ (1,0) [0|0] "" Vector__XXX
 SG_ DAW_LVDA_PUDis : 0|2@1+ (1,0) [0|0] "" Vector__XXX
 SG_ DAW_LVDA_OptUsmSta : 0|2@1+ (1,0) [0|0] "" Vector__XXX
 SG_ DAW_OptUsmSta : 0|3@1+ (1,0) [0|0] "" Vector__XXX
 SG_ DAW_SysSta : 0|4@1+ (1,0) [0|0] "" Vector__XXX
 SG_ DAW_WrnMsgSta : 0|3@1+ (1,0) [0|0] "" Vector__XXX
 SG_ DAW_TimeRstReq : 0|2@1+ (1,0) [0|0] "" Vector__XXX
 SG_ DAW_SnstvtyModRetVal : 0|3@1+ (1,0) [0|0] "" Vector__XXX
 SG_ FR_CMR_FCAEquipSta : 0|2@1+ (1,0) [0|0] "" Vector__XXX
 SG_ FR_CMR_MDPSCtrlSta : 0|2@1+ (1,0) [0|0] "" Vector__XXX
 SG_ FR_CMR_FailInfoSta : 0|3@1+ (1,0) [0|0] "" Vector__XXX
 SG_ FR_CMR_CodingSta : 0|2@1+ (1,0) [0|0] "" Vector__XXX
 SG_ FR_CMR_ACANMonSta : 0|2@1+ (1,0) [0|0] "" Vector__XXX
 SG_ PRVECS_CodedSta : 0|2@1+ (1,0) [0|0] "" Vector__XXX
 SG_ CCP_ECS_RESP_9_Byte0 : 0|8@1+ (1,0) [0|0] "" Vector__XXX
 SG_ CCP_ECS_RESP_9_Byte2 : 0|8@1+ (1,0) [0|0] "" Vector__XXX
 SG_ CCP_ECS_RESP_9_Byte3 : 0|8@1+ (1,0) [0|0] "" Vector__XXX
 SG_ CCP_ECS_RESP_9_Byte4 : 0|8@1+ (1,0) [0|0] "" Vector__XXX
 SG_ CCP_ECS_RESP_9_Byte5 : 0|8@1+ (1,0) [0|0] "" Vector__XXX
 SG_ CCP_ECS_RESP_9_Byte6 : 0|8@1+ (1,0) [0|0] "" Vector__XXX
 SG_ CCP_ECS_RESP_9_Byte7 : 0|8@1+ (1,0) [0|0] "" Vector__XXX
 SG_ CCP_ECS_RESP_9_Byte1 : 0|8@1+ (1,0) [0|0] "" Vector__XXX
 SG_ CCP_ECS_RESP_8_Byte0 : 0|8@1+ (1,0) [0|0] "" Vector__XXX
 SG_ CCP_ECS_RESP_8_Byte2 : 0|8@1+ (1,0) [0|0] "" Vector__XXX
 SG_ CCP_ECS_RESP_8_Byte3 : 0|8@1+ (1,0) [0|0] "" Vector__XXX
 SG_ CCP_ECS_RESP_8_Byte4 : 0|8@1+ (1,0) [0|0] "" Vector__XXX
 SG_ CCP_ECS_RESP_8_Byte5 : 0|8@1+ (1,0) [0|0] "" Vector__XXX
 SG_ CCP_ECS_RESP_8_Byte6 : 0|8@1+ (1,0) [0|0] "" Vector__XXX
 SG_ CCP_ECS_RESP_8_Byte7 : 0|8@1+ (1,0) [0|0] "" Vector__XXX
 SG_ CCP_ECS_RESP_8_Byte1 : 0|8@1+ (1,0) [0|0] "" Vector__XXX
 SG_ MCU_Crc1Val : 0|16@1+ (1,0) [0|0] "" Vector__XXX
 SG_ MCU_Mg1TempVal : 0|8@1+ (1,-40) [0|0] "��" Vector__XXX
 SG_ MCU_Mg1IgbtJnctnTempVal : 0|8@1+ (1,-40) [0|0] "��" Vector__XXX
 SG_ MCU_Mg1HtsnkTempVal : 0|8@1+ (1,-40) [0|0] "��" Vector__XXX
 SG_ MCU_Mg1InvtInVoltVal : 0|16@1+ (1,0) [0|0] "V" Vector__XXX
 SG_ MCU_AlvCnt1Val : 0|8@1+ (1,0) [0|0] "" Vector__XXX
 SG_ MCU_Mg1MainRlyCutOffReq : 0|2@1+ (1,0) [0|0] "flag" Vector__XXX
 SG_ MCU_Mg1MainRlyCutOffDelayReq : 0|2@1+ (1,0) [0|0] "flag" Vector__XXX
 SG_ MCU_Mg1PwmOnSta : 0|2@1+ (1,0) [0|0] "flag" Vector__XXX
 SG_ MCU_Mg1HiVoltIntlkReq : 0|2@1+ (1,0) [0|0] "flag" Vector__XXX
 SG_ MCU_Mg1MilOnReq : 0|2@1+ (1,0) [0|0] "flag" Vector__XXX
 SG_ MCU_Mg1SrvLmpOnReq : 0|2@1+ (1,0) [0|0] "flag" Vector__XXX
 SG_ MCU_Mg1AnkJrkActvSta : 0|2@1+ (1,0) [0|0] "flag" Vector__XXX
 SG_ MCU_Mg1ActnTestModSta : 0|2@1+ (1,0) [0|0] "flag" Vector__XXX
 SG_ MCU_Mg1PwmRetryStatus : 0|2@1+ (1,0) [0|0] "flag" Vector__XXX
 SG_ MCU_Mg1TrqCmdStat : 0|2@1+ (1,0) [0|0] "flag" Vector__XXX
 SG_ MCU_Mg1RsvrCalibReq : 0|2@1+ (1,0) [0|0] "" Vector__XXX
 SG_ MCU_Mg1RsvrCalibProcSta : 0|2@1+ (1,0) [0|0] "" Vector__XXX
 SG_ MCU_Mg1RsvrCalibSta : 0|3@1+ (1,0) [0|0] "" Vector__XXX
 SG_ MCU_Mg1EstTqVal : 0|14@1- (0.125,0) [0|0] "Nm" Vector__XXX
 SG_ MCU_Mg1RadPwmDtyReq : 0|8@1+ (1,0) [0|0] "%" Vector__XXX
 SG_ MCU_Mg1ActlRadFanRotatSpdRpmVal : 0|8@1+ (20,0) [0|0] "rpm" Vector__XXX
 SG_ MCU_Mg1EstTqBfrAjVal : 0|14@1- (0.125,0) [0|0] "Nm" Vector__XXX
 SG_ MCU_Mg1TqUppLimMtrngVal : 0|9@1+ (2,0) [0|0] "Nm" Vector__XXX
 SG_ MCU_Mg1ActlRotatSpdRpmVal : 0|16@1- (1,0) [0|0] "rpm" Vector__XXX
 SG_ MCU_Mg1TqUppLimGenVal : 0|9@1+ (2,0) [0|0] "Nm" Vector__XXX
 SG_ MCU_Mg1InvtCtrlRdySta : 0|2@1+ (1,0) [0|0] "flag" Vector__XXX
 SG_ MCU_Mg1CtrlablSta : 0|2@1+ (1,0) [0|0] "flag" Vector__XXX
 SG_ MCU_Mg1WrngSta : 0|2@1+ (1,0) [0|0] "flag" Vector__XXX
 SG_ MCU_Mg1FltSta : 0|2@1+ (1,0) [0|0] "flag" Vector__XXX
 SG_ MCU_Mg1DeratingFctrPcVal : 0|9@1+ (0.1953125,0) [0|0] "%" Vector__XXX
 SG_ MCU_Mg1InvtTempVal : 0|8@1+ (1,-40) [0|0] "��" Vector__XXX
 SG_ CCP_ECS_RESP_3_Byte0 : 0|8@1+ (1,0) [0|0] "" Vector__XXX
 SG_ CCP_ECS_RESP_3_Byte2 : 0|8@1+ (1,0) [0|0] "" Vector__XXX
 SG_ CCP_ECS_RESP_3_Byte3 : 0|8@1+ (1,0) [0|0] "" Vector__XXX
 SG_ CCP_ECS_RESP_3_Byte4 : 0|8@1+ (1,0) [0|0] "" Vector__XXX
 SG_ CCP_ECS_RESP_3_Byte5 : 0|8@1+ (1,0) [0|0] "" Vector__XXX
 SG_ CCP_ECS_RESP_3_Byte6 : 0|8@1+ (1,0) [0|0] "" Vector__XXX
 SG_ CCP_ECS_RESP_3_Byte7 : 0|8@1+ (1,0) [0|0] "" Vector__XXX
 SG_ CCP_ECS_RESP_3_Byte1 : 0|8@1+ (1,0) [0|0] "" Vector__XXX
 SG_ CCP_ECS_RESP_2_Byte0 : 0|8@1+ (1,0) [0|0] "" Vector__XXX
 SG_ CCP_ECS_RESP_2_Byte2 : 0|8@1+ (1,0) [0|0] "" Vector__XXX
 SG_ CCP_ECS_RESP_2_Byte3 : 0|8@1+ (1,0) [0|0] "" Vector__XXX
 SG_ CCP_ECS_RESP_2_Byte4 : 0|8@1+ (1,0) [0|0] "" Vector__XXX
 SG_ CCP_ECS_RESP_2_Byte5 : 0|8@1+ (1,0) [0|0] "" Vector__XXX
 SG_ CCP_ECS_RESP_2_Byte6 : 0|8@1+ (1,0) [0|0] "" Vector__XXX
 SG_ CCP_ECS_RESP_2_Byte7 : 0|8@1+ (1,0) [0|0] "" Vector__XXX
 SG_ CCP_ECS_RESP_2_Byte1 : 0|8@1+ (1,0) [0|0] "" Vector__XXX
 SG_ CCP_ECS_RESP_1_Byte0 : 0|8@1+ (1,0) [0|0] "" Vector__XXX
 SG_ CCP_ECS_RESP_1_Byte2 : 0|8@1+ (1,0) [0|0] "" Vector__XXX
 SG_ CCP_ECS_RESP_1_Byte3 : 0|8@1+ (1,0) [0|0] "" Vector__XXX
 SG_ CCP_ECS_RESP_1_Byte4 : 0|8@1+ (1,0) [0|0] "" Vector__XXX
 SG_ CCP_ECS_RESP_1_Byte5 : 0|8@1+ (1,0) [0|0] "" Vector__XXX
 SG_ CCP_ECS_RESP_1_Byte6 : 0|8@1+ (1,0) [0|0] "" Vector__XXX
 SG_ CCP_ECS_RESP_1_Byte7 : 0|8@1+ (1,0) [0|0] "" Vector__XXX
 SG_ CCP_ECS_RESP_1_Byte1 : 0|8@1+ (1,0) [0|0] "" Vector__XXX
 SG_ CCP_ECS_REQ1_Byte0 : 0|8@1+ (1,0) [0|0] "" Vector__XXX
 SG_ CCP_ECS_REQ1_Byte2 : 0|8@1+ (1,0) [0|0] "" Vector__XXX
 SG_ CCP_ECS_REQ1_Byte3 : 0|8@1+ (1,0) [0|0] "" Vector__XXX
 SG_ CCP_ECS_REQ1_Byte4 : 0|8@1+ (1,0) [0|0] "" Vector__XXX
 SG_ CCP_ECS_REQ1_Byte5 : 0|8@1+ (1,0) [0|0] "" Vector__XXX
 SG_ CCP_ECS_REQ1_Byte6 : 0|8@1+ (1,0) [0|0] "" Vector__XXX
 SG_ CCP_ECS_REQ1_Byte7 : 0|8@1+ (1,0) [0|0] "" Vector__XXX
 SG_ CCP_ECS_REQ1_Byte1 : 0|8@1+ (1,0) [0|0] "" Vector__XXX
 SG_ CCP_ECS_RESP_7_Byte0 : 0|8@1+ (1,0) [0|0] "" Vector__XXX
 SG_ CCP_ECS_RESP_7_Byte2 : 0|8@1+ (1,0) [0|0] "" Vector__XXX
 SG_ CCP_ECS_RESP_7_Byte3 : 0|8@1+ (1,0) [0|0] "" Vector__XXX
 SG_ CCP_ECS_RESP_7_Byte4 : 0|8@1+ (1,0) [0|0] "" Vector__XXX
 SG_ CCP_ECS_RESP_7_Byte5 : 0|8@1+ (1,0) [0|0] "" Vector__XXX
 SG_ CCP_ECS_RESP_7_Byte6 : 0|8@1+ (1,0) [0|0] "" Vector__XXX
 SG_ CCP_ECS_RESP_7_Byte7 : 0|8@1+ (1,0) [0|0] "" Vector__XXX
 SG_ CCP_ECS_RESP_7_Byte1 : 0|8@1+ (1,0) [0|0] "" Vector__XXX
 SG_ CCP_ECS_RESP_6_Byte0 : 0|8@1+ (1,0) [0|0] "" Vector__XXX
 SG_ CCP_ECS_RESP_6_Byte2 : 0|8@1+ (1,0) [0|0] "" Vector__XXX
 SG_ CCP_ECS_RESP_6_Byte3 : 0|8@1+ (1,0) [0|0] "" Vector__XXX
 SG_ CCP_ECS_RESP_6_Byte4 : 0|8@1+ (1,0) [0|0] "" Vector__XXX
 SG_ CCP_ECS_RESP_6_Byte5 : 0|8@1+ (1,0) [0|0] "" Vector__XXX
 SG_ CCP_ECS_RESP_6_Byte6 : 0|8@1+ (1,0) [0|0] "" Vector__XXX
 SG_ CCP_ECS_RESP_6_Byte7 : 0|8@1+ (1,0) [0|0] "" Vector__XXX
 SG_ CCP_ECS_RESP_6_Byte1 : 0|8@1+ (1,0) [0|0] "" Vector__XXX
 SG_ CCP_ECS_RESP_5_Byte0 : 0|8@1+ (1,0) [0|0] "" Vector__XXX
 SG_ CCP_ECS_RESP_5_Byte2 : 0|8@1+ (1,0) [0|0] "" Vector__XXX
 SG_ CCP_ECS_RESP_5_Byte3 : 0|8@1+ (1,0) [0|0] "" Vector__XXX
 SG_ CCP_ECS_RESP_5_Byte4 : 0|8@1+ (1,0) [0|0] "" Vector__XXX
 SG_ CCP_ECS_RESP_5_Byte5 : 0|8@1+ (1,0) [0|0] "" Vector__XXX
 SG_ CCP_ECS_RESP_5_Byte6 : 0|8@1+ (1,0) [0|0] "" Vector__XXX
 SG_ CCP_ECS_RESP_5_Byte7 : 0|8@1+ (1,0) [0|0] "" Vector__XXX
 SG_ CCP_ECS_RESP_5_Byte1 : 0|8@1+ (1,0) [0|0] "" Vector__XXX
 SG_ CCP_ECS_RESP_4_Byte0 : 0|8@1+ (1,0) [0|0] "" Vector__XXX
 SG_ CCP_ECS_RESP_4_Byte2 : 0|8@1+ (1,0) [0|0] "" Vector__XXX
 SG_ CCP_ECS_RESP_4_Byte3 : 0|8@1+ (1,0) [0|0] "" Vector__XXX
 SG_ CCP_ECS_RESP_4_Byte4 : 0|8@1+ (1,0) [0|0] "" Vector__XXX
 SG_ CCP_ECS_RESP_4_Byte5 : 0|8@1+ (1,0) [0|0] "" Vector__XXX
 SG_ CCP_ECS_RESP_4_Byte6 : 0|8@1+ (1,0) [0|0] "" Vector__XXX
 SG_ CCP_ECS_RESP_4_Byte7 : 0|8@1+ (1,0) [0|0] "" Vector__XXX
 SG_ CCP_ECS_RESP_4_Byte1 : 0|8@1+ (1,0) [0|0] "" Vector__XXX
 SG_ ICSC_Crc2Val : 0|16@1+ (1,0) [0|0] "" Vector__XXX
 SG_ DMIC_IndBrkModSta : 0|4@1+ (1,0) [0|0] "" Vector__XXX
 SG_ DMIC_DrvModTyp : 0|4@1+ (1,0) [0|0] "" Vector__XXX
 SG_ DMIC_EngFltSta : 0|2@1+ (1,0) [0|0] "" Vector__XXX
 SG_ DMIC_MdpsFltSta : 0|2@1+ (1,0) [0|0] "" Vector__XXX
 SG_ DMIC_EcsFltSta : 0|2@1+ (1,0) [0|0] "" Vector__XXX
 SG_ DMIC_AwdFltSta : 0|2@1+ (1,0) [0|0] "" Vector__XXX
 SG_ ICSC_AlvCnt2Val : 0|8@1+ (1,0) [0|0] "" Vector__XXX
 SG_ DMIC_BrkFltSta : 0|2@1+ (1,0) [0|0] "" Vector__XXX
 SG_ DMIC_DrvModSta : 0|4@1+ (1,0) [0|0] "" Vector__XXX
 SG_ DMIC_SmtShftModSta : 0|2@1+ (1,0) [0|0] "" Vector__XXX
 SG_ DMIC_EngModSta : 0|4@1+ (1,0) [0|0] "" Vector__XXX
 SG_ DMIC_IndEngModSta : 0|4@1+ (1,0) [0|0] "" Vector__XXX
 SG_ DMIC_MdpsModSta : 0|4@1+ (1,0) [0|0] "" Vector__XXX
 SG_ DMIC_IndMdpsModSta : 0|4@1+ (1,0) [0|0] "" Vector__XXX
 SG_ DMIC_EcsModSta : 0|4@1+ (1,0) [0|0] "" Vector__XXX
 SG_ DMIC_IndEcsModSta : 0|4@1+ (1,0) [0|0] "" Vector__XXX
 SG_ DMIC_AwdModSta : 0|4@1+ (1,0) [0|0] "" Vector__XXX
 SG_ DMIC_IndAwdModSta : 0|4@1+ (1,0) [0|0] "" Vector__XXX
 SG_ FR_CMR_Crc5Val : 0|16@1+ (1,0) [0|0] "" Vector__XXX
 SG_ Info_RdProfSts : 0|2@1+ (1,0) [0|0] "" Vector__XXX
 SG_ FR_CMR_AlvCnt5Val : 0|8@1+ (1,0) [0|0] "" Vector__XXX
 SG_ Info_DistL : 0|8@1+ (0.0625,0) [0|0] "m" Vector__XXX
 SG_ Info_HeightL : 0|9@1+ (0.625,-160) [0|0] "mm" Vector__XXX
 SG_ Info_LengthL : 0|7@1+ (0.0625,0) [0|0] "m" Vector__XXX
 SG_ Info_TypeL : 0|2@1+ (1,0) [0|0] "" Vector__XXX
 SG_ Info_ConfL : 0|4@1+ (1,0) [0|0] "" Vector__XXX
 SG_ Info_CyclicCounterL : 0|2@1+ (1,0) [0|0] "" Vector__XXX
 SG_ Info_VariL : 0|7@1+ (1,0) [0|0] "" Vector__XXX
 SG_ Info_DistR : 0|8@1+ (0.0625,0) [0|0] "m" Vector__XXX
 SG_ Info_HeightR : 0|9@1+ (0.625,-160) [0|0] "mm" Vector__XXX
 SG_ Info_LengthR : 0|7@1+ (0.0625,0) [0|0] "m" Vector__XXX
 SG_ Info_TypeR : 0|2@1+ (1,0) [0|0] "" Vector__XXX
 SG_ Info_ConfR : 0|4@1+ (1,0) [0|0] "" Vector__XXX
 SG_ Info_CyclicCounterR : 0|2@1+ (1,0) [0|0] "" Vector__XXX
 SG_ Info_VariR : 0|7@1+ (1,0) [0|0] "" Vector__XXX
 SG_ SAS_GST_Byte0 : 0|8@1+ (1,0) [0|0] "" Vector__XXX
 SG_ SAS_GST_Byte2 : 0|8@1+ (1,0) [0|0] "" Vector__XXX
 SG_ SAS_GST_Byte3 : 0|8@1+ (1,0) [0|0] "" Vector__XXX
 SG_ SAS_GST_Byte4 : 0|8@1+ (1,0) [0|0] "" Vector__XXX
 SG_ SAS_GST_Byte5 : 0|8@1+ (1,0) [0|0] "" Vector__XXX
 SG_ SAS_GST_Byte6 : 0|8@1+ (1,0) [0|0] "" Vector__XXX
 SG_ SAS_GST_Byte7 : 0|8@1+ (1,0) [0|0] "" Vector__XXX
 SG_ SAS_GST_Byte1 : 0|8@1+ (1,0) [0|0] "" Vector__XXX
 SG_ GCU_Crc2Val : 0|16@1+ (1,0) [0|0] "" Vector__XXX
 SG_ MCU_Mg2TempVal : 0|8@1+ (1,-40) [0|0] "��" Vector__XXX
 SG_ MCU_Mg2IgbtJnctnTempVal : 0|8@1+ (1,-40) [0|0] "��" Vector__XXX
 SG_ MCU_Mg2HtsnkTempVal : 0|8@1+ (1,-40) [0|0] "��" Vector__XXX
 SG_ MCU_Mg2InvtInVoltVal : 0|16@1+ (1,0) [0|0] "V" Vector__XXX
 SG_ GCU_AlvCnt2Val : 0|8@1+ (1,0) [0|0] "" Vector__XXX
 SG_ MCU_Mg2MainRlyCutOffReq : 0|2@1+ (1,0) [0|0] "flag" Vector__XXX
 SG_ MCU_Mg2MainRlyCutOffDelayReq : 0|2@1+ (1,0) [0|0] "flag" Vector__XXX
 SG_ MCU_Mg2PwmOnSta : 0|2@1+ (1,0) [0|0] "flag" Vector__XXX
 SG_ MCU_Mg2HiVoltIntlkReq : 0|2@1+ (1,0) [0|0] "flag" Vector__XXX
 SG_ MCU_Mg2MilOnReq : 0|2@1+ (1,0) [0|0] "flag" Vector__XXX
 SG_ MCU_Mg2SrvLmpOnReq : 0|2@1+ (1,0) [0|0] "flag" Vector__XXX
 SG_ MCU_Mg2AnkJrkActvSta : 0|2@1+ (1,0) [0|0] "flag" Vector__XXX
 SG_ MCU_Mg2ActnTestModSta : 0|2@1+ (1,0) [0|0] "flag" Vector__XXX
 SG_ MCU_Mg2PwmRetryStatus : 0|2@1+ (1,0) [0|0] "flag" Vector__XXX
 SG_ MCU_Mg2TrqCmdStat : 0|2@1+ (1,0) [0|0] "flag" Vector__XXX
 SG_ MCU_Mg2RsvrCalibReq : 0|2@1+ (1,0) [0|0] "flag" Vector__XXX
 SG_ MCU_Mg2RsvrCalibProcSta : 0|2@1+ (1,0) [0|0] "" Vector__XXX
 SG_ MCU_Mg2RsvrCalibSta : 0|3@1+ (1,0) [0|0] "" Vector__XXX
 SG_ MCU_Mg2EstTqVal : 0|14@1- (0.125,0) [0|0] "Nm" Vector__XXX
 SG_ MCU_Mg2RadPwmDtyReq : 0|8@1+ (20,0) [0|0] "" Vector__XXX
 SG_ MCU_Mg2EstBfrAjVal : 0|14@1- (0.125,0) [0|0] "Nm" Vector__XXX
 SG_ MCU_Mg2TqUppLimMtrngVal : 0|9@1+ (2,0) [0|0] "Nm" Vector__XXX
 SG_ MCU_Mg2ActlRotatSpdRpmVal : 0|16@1- (1,0) [0|0] "rpm" Vector__XXX
 SG_ MCU_Mg2TqUppLimGenVal : 0|9@1+ (2,0) [0|0] "Nm" Vector__XXX
 SG_ MCU_Mg2InvtRdySta : 0|2@1+ (1,0) [0|0] "flag" Vector__XXX
 SG_ MCU_Mg2CtrlablSta : 0|2@1+ (1,0) [0|0] "flag" Vector__XXX
 SG_ MCU_Mg2WrngSta : 0|2@1+ (1,0) [0|0] "flag" Vector__XXX
 SG_ MCU_Mg2FltSta : 0|2@1+ (1,0) [0|0] "flag" Vector__XXX
 SG_ MCU_Mg2DeratingFctrPcVal : 0|9@1+ (0.1953125,0) [0|0] "%" Vector__XXX
 SG_ MCU_Mg2InvtTempVal : 0|8@1+ (1,-40) [0|0] "��" Vector__XXX
 SG_ GST_SAS_Byte0 : 0|8@1+ (1,0) [0|0] "" Vector__XXX
 SG_ GST_SAS_Byte2 : 0|8@1+ (1,0) [0|0] "" Vector__XXX
 SG_ GST_SAS_Byte3 : 0|8@1+ (1,0) [0|0] "" Vector__XXX
 SG_ GST_SAS_Byte4 : 0|8@1+ (1,0) [0|0] "" Vector__XXX
 SG_ GST_SAS_Byte5 : 0|8@1+ (1,0) [0|0] "" Vector__XXX
 SG_ GST_SAS_Byte6 : 0|8@1+ (1,0) [0|0] "" Vector__XXX
 SG_ GST_SAS_Byte7 : 0|8@1+ (1,0) [0|0] "" Vector__XXX
 SG_ GST_SAS_Byte1 : 0|8@1+ (1,0) [0|0] "" Vector__XXX
 SG_ ADAS_CMD_Crc30Val : 0|16@1+ (1,0) [0|0] "" Vector__XXX
 SG_ FCA_ESA_CtrlSta : 0|3@1+ (1,0) [0|0] "" Vector__XXX
 SG_ ADAS_Damping_Gain : 0|8@1+ (1,0) [0|0] "" Vector__XXX
 SG_ ADAS_CMD_AlvCnt30Val : 0|8@1+ (1,0) [0|0] "" Vector__XXX
 SG_ LKA_OptUsmSta : 0|3@1+ (1,0) [0|0] "" Vector__XXX
 SG_ LKA_RcgSta : 0|3@1+ (1,0) [0|0] "" Vector__XXX
 SG_ LKA_LHLnWrnSta : 0|2@1+ (1,0) [0|0] "" Vector__XXX
 SG_ LKA_RHLnWrnSta : 0|2@1+ (1,0) [0|0] "" Vector__XXX
 SG_ LKA_HndsoffSnd : 0|2@1+ (1,0) [0|0] "" Vector__XXX
 SG_ LKA_SysIndReq : 0|3@1+ (1,0) [0|0] "" Vector__XXX
 SG_ ADAS_StrTqReqVal : 0|11@1+ (0.0078125,-8) [0|0] "Nm" Vector__XXX
 SG_ ADAS_ActToiSta : 0|2@1+ (1,0) [0|0] "" Vector__XXX
 SG_ ADAS_ToiFltSta : 0|2@1+ (1,0) [0|0] "" Vector__XXX
 SG_ BCA_Rear_WrnSta : 0|3@1+ (1,0) [0|0] "" Vector__XXX
 SG_ LKA_SysWrn : 0|4@1+ (1,0) [0|0] "" Vector__XXX
 SG_ FCA_LO_WrnSta : 0|3@1+ (1,0) [0|0] "" Vector__XXX
 SG_ FCA_LS_WrnSta : 0|3@1+ (1,0) [0|0] "" Vector__XXX
 SG_ LKA_UsmMod : 0|2@1+ (1,0) [0|0] "" Vector__XXX
 SG_ Info_PedtrnDst : 0|3@1+ (1,0) [0|0] "" Vector__XXX
 SG_ FCA_ESA_WrnSta : 0|3@1+ (1,0) [0|0] "" Vector__XXX
 SG_ RWS_CCP_RESP1_Byte0 : 0|8@1+ (1,0) [0|0] "" Vector__XXX
 SG_ RWS_CCP_RESP1_Byte2 : 0|8@1+ (1,0) [0|0] "" Vector__XXX
 SG_ RWS_CCP_RESP1_Byte3 : 0|8@1+ (1,0) [0|0] "" Vector__XXX
 SG_ RWS_CCP_RESP1_Byte4 : 0|8@1+ (1,0) [0|0] "" Vector__XXX
 SG_ RWS_CCP_RESP1_Byte5 : 0|8@1+ (1,0) [0|0] "" Vector__XXX
 SG_ RWS_CCP_RESP1_Byte6 : 0|8@1+ (1,0) [0|0] "" Vector__XXX
 SG_ RWS_CCP_RESP1_Byte7 : 0|8@1+ (1,0) [0|0] "" Vector__XXX
 SG_ RWS_CCP_RESP1_Byte1 : 0|8@1+ (1,0) [0|0] "" Vector__XXX
 SG_ RWS_CCP_REQ1_Byte0 : 0|8@1+ (1,0) [0|0] "" Vector__XXX
 SG_ RWS_CCP_REQ1_Byte2 : 0|8@1+ (1,0) [0|0] "" Vector__XXX
 SG_ RWS_CCP_REQ1_Byte3 : 0|8@1+ (1,0) [0|0] "" Vector__XXX
 SG_ RWS_CCP_REQ1_Byte4 : 0|8@1+ (1,0) [0|0] "" Vector__XXX
 SG_ RWS_CCP_REQ1_Byte5 : 0|8@1+ (1,0) [0|0] "" Vector__XXX
 SG_ RWS_CCP_REQ1_Byte6 : 0|8@1+ (1,0) [0|0] "" Vector__XXX
 SG_ RWS_CCP_REQ1_Byte7 : 0|8@1+ (1,0) [0|0] "" Vector__XXX
 SG_ RWS_CCP_REQ1_Byte1 : 0|8@1+ (1,0) [0|0] "" Vector__XXX
 SG_ ICU_Crc12Val : 0|8@1+ (1,0) [0|0] "" Vector__XXX
 SG_ Warn_ChaDrSwRrSta : 0|2@1+ (1,0) [0|0] "" Vector__XXX
 SG_ ICU_AlvCnt12Val : 0|4@1+ (1,0) [0|0] "" Vector__XXX
 SG_ ICU_IGN3On_RequestState : 0|4@1+ (1,0) [0|0] "" Vector__XXX
 SG_ Warn_ChaDrSwFrtSta : 0|2@1+ (1,0) [0|0] "" Vector__XXX
 SG_ YRS_Crc1Val : 0|16@1+ (1,0) [0|0] "" Vector__XXX
 SG_ YRS_SnsrTempVal : 0|8@1+ (1,-68) [0|0] "��" Vector__XXX
 SG_ YRS_ImuSeralNumVal : 0|48@1+ (1,0) [0|0] "" Vector__XXX
 SG_ YRS_AlvCnt1Val : 0|8@1+ (1,0) [0|0] "" Vector__XXX
 SG_ YRS_YawSigSta : 0|4@1+ (1,0) [0|0] "" Vector__XXX
 SG_ YRS_LatAccelSigSta : 0|4@1+ (1,0) [0|0] "" Vector__XXX
 SG_ YRS_LongAccelSigSta : 0|4@1+ (1,0) [0|0] "" Vector__XXX
 SG_ YRS_McuVoltSta : 0|4@1+ (1,0) [0|0] "" Vector__XXX
 SG_ YRS_AcuRstSta : 0|4@1+ (1,0) [0|0] "" Vector__XXX
 SG_ YRS_SnsrTyp : 0|4@1+ (1,0) [0|0] "" Vector__XXX
 SG_ YRS_YawRtVal : 0|16@1+ (0.005,-163.84) [0|0] "��/s" Vector__XXX
 SG_ YRS_LatAccelVal : 0|16@1+ (0.000127465,-4.17677312) [0|0] "g" Vector__XXX
 SG_ YRS_LongAccelVal : 0|16@1+ (0.000127465,-4.17677312) [0|0] "g" Vector__XXX
 SG_ GATEWAY_CrcVal : 0|8@1+ (1,0) [0|0] "" Vector__XXX
 SG_ GATEWAY_AlvCntVal : 0|4@1+ (1,0) [0|0] "" Vector__XXX
 SG_ GATEWAY_MM_STS : 0|3@1+ (1,0) [0|0] "" Vector__XXX
 SG_ GATEWAY_HS_B_STS : 0|3@1+ (1,0) [0|0] "" Vector__XXX
 SG_ GATEWAY_HS_D_STS : 0|3@1+ (1,0) [0|0] "" Vector__XXX
 SG_ GATEWAY_HS_I_STS : 0|3@1+ (1,0) [0|0] "" Vector__XXX
 SG_ GATEWAY_FD_P_STS : 0|3@1+ (1,0) [0|0] "" Vector__XXX
 SG_ GATEWAY_FD_C_STS : 0|3@1+ (1,0) [0|0] "" Vector__XXX
 SG_ GATEWAY_FD_V_STS : 0|3@1+ (1,0) [0|0] "" Vector__XXX
 SG_ GATEWAY_FD_G_STS : 0|3@1+ (1,0) [0|0] "" Vector__XXX
 SG_ GATEWAY_FD_E_STS : 0|3@1+ (1,0) [0|0] "" Vector__XXX
 SG_ ICU_Crc8Val : 0|8@1+ (1,0) [0|0] "" Vector__XXX
 SG_ HeatedSteerWheel_StrWhlHtrSwSta : 0|2@1+ (1,0) [0|0] "" Vector__XXX
 SG_ ICU_AlvCnt8Val : 0|4@1+ (1,0) [0|0] "" Vector__XXX
 SG_ DriveTypeOption : 0|2@1+ (1,0) [0|0] "" Vector__XXX
 SG_ Warn_RrLftSBRMATSwSta : 0|2@1+ (1,0) [0|0] "" Vector__XXX
 SG_ Warn_RrRhtSBRMATSwSta : 0|2@1+ (1,0) [0|0] "" Vector__XXX
 SG_ StrWheelAutoHeatSta : 0|2@1+ (1,0) [0|0] "" Vector__XXX
 SG_ StrWheelHeatIndSta : 0|2@1+ (1,0) [0|0] "" Vector__XXX
 SG_ Warn_LftSEA : 0|2@1+ (1,0) [0|0] "" Vector__XXX
 SG_ Warn_RhtSEA : 0|2@1+ (1,0) [0|0] "" Vector__XXX
 SG_ Lamp_FootLampOnReq : 0|2@1+ (1,0) [0|0] "" Vector__XXX
 SG_ Lamp_MoodLampOnReq : 0|3@1+ (1,0) [0|0] "" Vector__XXX
 SG_ ICU_PowerAutoCutModSta : 0|2@1+ (1,0) [0|0] "" Vector__XXX
 SG_ ICU_SoCBattStaMsgReq : 0|2@1+ (1,0) [0|0] "" Vector__XXX
 SG_ C_ICUPowerAutoCutType : 0|2@1+ (1,0) [0|0] "" Vector__XXX
 SG_ DrvDrLockIND : 0|2@1+ (1,0) [0|0] "" Vector__XXX
 SG_ Brake_SwSta_ICU : 0|2@1+ (1,0) [0|0] "" Vector__XXX
 SG_ HSWS_SysWrngSta_ICU : 0|2@1+ (1,0) [0|0] "" Vector__XXX
 SG_ DATC_Crc1Val : 0|16@1+ (1,0) [0|0] "" Vector__XXX
 SG_ DATC_BattChlrVlvSta : 0|2@1+ (1,0) [0|0] "" Vector__XXX
 SG_ DATC_AcnECompSpdVal : 0|16@1+ (1,0) [0|0] "rpm" Vector__XXX
 SG_ DATC_AcnCompSlpModCodVal : 0|8@1+ (1,0) [0|0] "" Vector__XXX
 SG_ DATC_AcnCompWaitCodVal : 0|8@1+ (1,0) [0|0] "" Vector__XXX

CM_ BO_ 3221225472 "This is a message for not used signals, created by Vector CANdb++ DBC OLE DB Provider.";
CM_ SG_ 3221225472 ABS_ESC_Crc1Val "ABS_ESC_CyclicRedundancyCheck1Value";
CM_ SG_ 3221225472 ABS_ESC_AlvCnt1Val "ABS_ESC_AliveCounter1Value";
CM_ SG_ 3221225472 ABS_WrngLmpSta "ABS_WarningLampStatus ##2G##ESC - TCS15 - ABS_W_LAMP";
CM_ SG_ 3221225472 ABS_DfctvSta "ABS_DefectiveStatus ##2G##ESC - TCS11 - ABS_DEF";
CM_ SG_ 3221225472 ABS_ActvSta "ABS_ActiveStatus ##2G##ESC - TCS11 - ABS_ACT";
CM_ SG_ 3221225472 ABS_DiagSta "ABS_DiagnosticStatus ##2G##ESC - TCS11 - ABS_DIAG";
CM_ SG_ 3221225472 EBD_WrngLmpSta "EBD_WarningLampStatus ##2G##ESC - TCS15 - EBD_W_LAMP";
CM_ SG_ 3221225472 EBD_DfctvSta "EBD_DefectiveStatus ##2G##ESC - TCS11 - EBD_DEF";
CM_ SG_ 3221225472 ESC_BrkLtActSta "ESC_BrakeLightActiveStatus ##2G##ESC - TCS11 - BLA_CTL";
CM_ SG_ 3221225472 ESS_Sta "ESS_Status ##2G##ESC - TCS11 - ESS_STAT";
CM_ SG_ 3221225472 ECS_Crc1Val "ECS_CyclicRedundancyCheck1Value";
CM_ SG_ 3221225472 ECS_AlvCnt1Val "ECS_AliveCounter1Value";
CM_ SG_ 3221225472 ECS_WrngLmpSta "ECS_WarningLampStatus ##2G##ECS - ECS11 - ECS_W_LAMP";
CM_ SG_ 3221225472 ECS_DfctvSta "ECS_DefectiveStatus ##2G##ECS - ECS11 - ECS_DEF";
CM_ SG_ 3221225472 ECS_DmpModSta "ECS_DampingModeStatus ##2G##ECS - ECS11 - Damping_Mode";
CM_ SG_ 3221225472 ECS_DmpModReq "ECS_DampingModeRequest ##2G##ECS - ECS11 - REQ_Damping";
CM_ SG_ 3221225472 FR_CMR_Crc1Val "FR_CMR_CyclicRedundancyCheck1Value";
CM_ SG_ 3221225472 FR_CMR_AlvCnt1Val "FR_CMR_AliveCounter1Value";
CM_ SG_ 3221225472 HBA_SysOptSta "HBA_SystemOptionStatus ##2G##LDW_LKA - LKA11 - CF_HBA_Opt_USM";
CM_ SG_ 3221225472 HBA_SysSta "HBA_SystemStatus ##2G##LDW_LKA - LKA11 - CF_HBA_SysState";
CM_ SG_ 3221225472 HBA_IndLmpReq "HBA_IndicatorLampRequest ##2G##LDW_LKA - LKA11 - CF_HBA_Lamp";
CM_ SG_ 3221225472 FCA_Equip_MFC "FCA_Equipment_MFC ##2G##LDW_LKA - LKA15 - CF_FCA_Equip_MFC";
CM_ SG_ 3221225472 HBA_OptUsmSta "HBA Option USM Status";
CM_ SG_ 3221225472 DAW_LVDA_PUDis "LVDA_PopUpDisplay ##2G##LDW_LKA - LKA12 - CF_LeadVehDptAlert_Display";
CM_ SG_ 3221225472 DAW_LVDA_OptUsmSta "LVDA_OptionUsmStatus ##2G##LDW_LKA - LKA12 - CF_LeadVehDptAlert_USM";
CM_ SG_ 3221225472 DAW_OptUsmSta "DAW_OptionUsmStatus ##2G##LDW_LKA - LKA12 - CF_DAW_Opt_USM_NEW";
CM_ SG_ 3221225472 DAW_SysSta "DAW_SystemStatus ##2G##LDW_LKA - LKA12 - CF_DAW_Status";
CM_ SG_ 3221225472 DAW_WrnMsgSta "DAW_WarningMessageStatus ##2G##LDW_LKA - LKA12 - CF_DAW_Warn";
CM_ SG_ 3221225472 DAW_TimeRstReq "DAW_TimeResetRequest ##2G##LDW_LKA - LKA12 - CF_DAW_TimeReset";
CM_ SG_ 3221225472 DAW_SnstvtyModRetVal "DAW_SensitivityModeReturnValue##2G##LDW_LKA - LKA12 - CF_DAW_Opt_USM";
CM_ SG_ 3221225472 FR_CMR_FCAEquipSta "FR_CMR_FCAEquipmentStatus";
CM_ SG_ 3221225472 FR_CMR_MDPSCtrlSta "Steering control status by MDPS";
CM_ SG_ 3221225472 FR_CMR_FailInfoSta "Failure state of FR_CMR Sensor/ECU";
CM_ SG_ 3221225472 FR_CMR_CodingSta "Coding state of FR_CMR";
CM_ SG_ 3221225472 FR_CMR_ACANMonSta "A-CANFD network monitoring result";
CM_ SG_ 3221225472 MCU_Crc1Val "MCU_CyclicRedundancyCheck1Value";
CM_ SG_ 3221225472 MCU_Mg1TempVal "MCU_Mg1TemperatureValue";
CM_ SG_ 3221225472 MCU_Mg1IgbtJnctnTempVal "MCU_Mg1IgbtJunctionTemperatureValue";
CM_ SG_ 3221225472 MCU_Mg1HtsnkTempVal "MCU_Mg1HeatsinkTemperatureValue";
CM_ SG_ 3221225472 MCU_Mg1InvtInVoltVal "MCU_Mg1InverterInputVoltageValue";
CM_ SG_ 3221225472 MCU_AlvCnt1Val "MCU_AliveCounter1Value";
CM_ SG_ 3221225472 MCU_Mg1MainRlyCutOffReq "MCU_Mg1MainRelayCutOffRequest";
CM_ SG_ 3221225472 MCU_Mg1MainRlyCutOffDelayReq "MCU_MainRelayCutOffDelayedRequestByMg1";
CM_ SG_ 3221225472 MCU_Mg1PwmOnSta "MCU_Mg1PwmOnStatus";
CM_ SG_ 3221225472 MCU_Mg1HiVoltIntlkReq "MCU_HighVoltageInterlockRequestByMg1";
CM_ SG_ 3221225472 MCU_Mg1MilOnReq "MCU_MilOnRequestByMg1";
CM_ SG_ 3221225472 MCU_Mg1SrvLmpOnReq "MCU_ServiceLampOnRequestByMg1";
CM_ SG_ 3221225472 MCU_Mg1AnkJrkActvSta "MCU_Mg1AntiJerkActivationStatus";
CM_ SG_ 3221225472 MCU_Mg1ActnTestModSta "MCU_Mg1ActuationTestModeStatus";
CM_ SG_ 3221225472 MCU_Mg1PwmRetryStatus "MCU_Mg1PwmRetryStatus";
CM_ SG_ 3221225472 MCU_Mg1TrqCmdStat "MCU_Mg1TorqueqCommandStat";
CM_ SG_ 3221225472 MCU_Mg1RsvrCalibReq "MCU_ResolverCalibrationRequestByMg1";
CM_ SG_ 3221225472 MCU_Mg1RsvrCalibProcSta "MCU_MG1ResolverCalibrationProcessStatus";
CM_ SG_ 3221225472 MCU_Mg1RsvrCalibSta "MCU_MG1ResolverCalibrationStatus";
CM_ SG_ 3221225472 MCU_Mg1EstTqVal "MCU_Mg1EstimatedTorqueValue";
CM_ SG_ 3221225472 MCU_Mg1RadPwmDtyReq "MCU_RadiatorPwmDutyRequestByMg1";
CM_ SG_ 3221225472 MCU_Mg1ActlRadFanRotatSpdRpmVal "MCU_ActualRadiatorFanRotationSpeedRpmValueByMg1";
CM_ SG_ 3221225472 MCU_Mg1EstTqBfrAjVal "MCU_EstimatedMg1TorqueBeforeAjValue";
CM_ SG_ 3221225472 MCU_Mg1TqUppLimMtrngVal "MCU_Mg1TorqueUpperLimitMotoringValue";
CM_ SG_ 3221225472 MCU_Mg1ActlRotatSpdRpmVal "MCU_Mg1ActualRotationSpeedRpmValue";
CM_ SG_ 3221225472 MCU_Mg1TqUppLimGenVal "MCU_Mg1TorqueUpperLimitGeneratingValue";
CM_ SG_ 3221225472 MCU_Mg1InvtCtrlRdySta "MCU_Mg1InverterControllerReadyStatus";
CM_ SG_ 3221225472 MCU_Mg1CtrlablSta "MCU_Mg1ControllableStatus";
CM_ SG_ 3221225472 MCU_Mg1WrngSta "MCU_Mg1WarningStatus";
CM_ SG_ 3221225472 MCU_Mg1FltSta "MCU_Mg1FaultStatus";
CM_ SG_ 3221225472 MCU_Mg1DeratingFctrPcVal "MCU_Mg1DeratingFactorPcValue";
CM_ SG_ 3221225472 MCU_Mg1InvtTempVal "MCU_Mg1InverterTemperatureValue";
CM_ SG_ 3221225472 ICSC_Crc2Val "ICSC_CyclicRedundancyCheck2Value";
CM_ SG_ 3221225472 DMIC_IndBrkModSta "DMIC_IndividualFlexBrakeModeStatus";
CM_ SG_ 3221225472 DMIC_DrvModTyp "DMIC_DriveModeType ##2G##ICSC - IVSS11 - DRIVE_MODE_TYPE";
CM_ SG_ 3221225472 DMIC_EngFltSta "DMIC_EngineFaultStatus ##2G##ICSC - IVSS11 - MODE_ENG_FltStat";
CM_ SG_ 3221225472 DMIC_MdpsFltSta "DMIC_MdpsFaultStatus ##2G##ICSC - IVSS11 - MODE_MDPS_FltStat";
CM_ SG_ 3221225472 DMIC_EcsFltSta "DMIC_EcsFltSta ##2G##ICSC - IVSS11 - MODE_ECS_FltStat";
CM_ SG_ 3221225472 DMIC_AwdFltSta "DMIC_AwdFaultStatus ##2G##ICSC - IVSS11 - MODE_4WD_FltStat";
CM_ SG_ 3221225472 ICSC_AlvCnt2Val "ICSC_AliveCounter2Value";
CM_ SG_ 3221225472 DMIC_BrkFltSta "DMIC_BrkFltSta";
CM_ SG_ 3221225472 DMIC_DrvModSta "DMIC_DriveModeStatus ##2G##ICSC - IVSS11 - DrivingModeState";
CM_ SG_ 3221225472 DMIC_SmtShftModSta "DMIC_SmartShiftModeStatus ##2G##ICSC - IVSS11 - SMART_SHIFT_MODE";
CM_ SG_ 3221225472 DMIC_EngModSta "DMIC_EngineModeStatus ##2G##ICSC - IVSS11 - MODE_ENG";
CM_ SG_ 3221225472 DMIC_IndEngModSta "DMIC_IndividualEngineModeStatus ##2G##ICSC - IVSS11 - MODE_PT_IND";
CM_ SG_ 3221225472 DMIC_MdpsModSta "DMIC_MdpsModeStatus ##2G##ICSC - IVSS11 - MODE_MDPS";
CM_ SG_ 3221225472 DMIC_IndMdpsModSta "DMIC_IndividualMdpsModeStatus ##2G##ICSC - IVSS11 - MODE_MDPS_IND";
CM_ SG_ 3221225472 DMIC_EcsModSta "DMIC_EcsModeStatus ##2G##ICSC - IVSS11 - MODE_ECS";
CM_ SG_ 3221225472 DMIC_IndEcsModSta "DMIC_IndividualEcsModeStatus ##2G##ICSC - IVSS11 - MODE_ECS_IND";
CM_ SG_ 3221225472 DMIC_AwdModSta "DMIC_AwdModeStatus ##2G##ICSC - IVSS11 - MODE_4WD";
CM_ SG_ 3221225472 DMIC_IndAwdModSta "DMIC_IndividualAwdModeStatus ##2G##ICSC - IVSS11 - MODE_4WD_IND";
CM_ SG_ 3221225472 FR_CMR_Crc5Val "FR_CMR_CyclicRedundancyCheck5Value";
CM_ SG_ 3221225472 Info_RdProfSts "Info_RoadProfileStatus";
CM_ SG_ 3221225472 FR_CMR_AlvCnt5Val "FR_CMR_AliveCounter5Value";
CM_ SG_ 3221225472 Info_DistL "Info_DistanceLeft";
CM_ SG_ 3221225472 Info_HeightL "Info_HeightLeft";
CM_ SG_ 3221225472 Info_LengthL "Info_LengthLeft";
CM_ SG_ 3221225472 Info_TypeL "Info_TypeLeft";
CM_ SG_ 3221225472 Info_ConfL "Info_ConfidenceLeft";
CM_ SG_ 3221225472 Info_CyclicCounterL "Info_CyclicCounterLeft";
CM_ SG_ 3221225472 Info_VariL "Info_VarianceLeft";
CM_ SG_ 3221225472 Info_DistR "Info_DistanceRight";
CM_ SG_ 3221225472 Info_HeightR "Info_HeightRight";
CM_ SG_ 3221225472 Info_LengthR "Info_LengthRight";
CM_ SG_ 3221225472 Info_TypeR "Info_TypeRight";
CM_ SG_ 3221225472 Info_ConfR "Info_ConfidenceRight";
CM_ SG_ 3221225472 Info_CyclicCounterR "Info_CyclicCounterRight";
CM_ SG_ 3221225472 Info_VariR "Info_VarianceRight";
CM_ SG_ 3221225472 GCU_Crc2Val "GCU_CyclicRedundancyCheck2Value";
CM_ SG_ 3221225472 MCU_Mg2TempVal "MCU_Mg2TemperatureValue";
CM_ SG_ 3221225472 MCU_Mg2IgbtJnctnTempVal "MCU_Mg2IgbtJunctionTemperatureValue";
CM_ SG_ 3221225472 MCU_Mg2HtsnkTempVal "MCU_Mg2HeatsinkTemperatureValue";
CM_ SG_ 3221225472 MCU_Mg2InvtInVoltVal "MCU_Mg2InverterInputVoltageValue";
CM_ SG_ 3221225472 GCU_AlvCnt2Val "GCU_AliveCounter2Value";
CM_ SG_ 3221225472 MCU_Mg2MainRlyCutOffReq "MCU_MainRelayCutOffRequestByMg2";
CM_ SG_ 3221225472 MCU_Mg2MainRlyCutOffDelayReq "MCU_MainRelayCutOffDelayedRequestByMg2";
CM_ SG_ 3221225472 MCU_Mg2PwmOnSta "MCU_Mg2PwmOnStatus";
CM_ SG_ 3221225472 MCU_Mg2HiVoltIntlkReq "MCU_HighVoltageInterlockRequestByMg1";
CM_ SG_ 3221225472 MCU_Mg2MilOnReq "MCU_MilOnRequestByMg2";
CM_ SG_ 3221225472 MCU_Mg2SrvLmpOnReq "MCU_ServiceLampOnRequestByMg2";
CM_ SG_ 3221225472 MCU_Mg2AnkJrkActvSta "MCU_Mg2AntiJerkActivationStatus";
CM_ SG_ 3221225472 MCU_Mg2ActnTestModSta "MCU_Mg2ActuationTestModeStatus";
CM_ SG_ 3221225472 MCU_Mg2PwmRetryStatus "MCU_Mg2PwmRetryStatus";
CM_ SG_ 3221225472 MCU_Mg2TrqCmdStat "MCU_Mg2TorqueCommandStat";
CM_ SG_ 3221225472 MCU_Mg2RsvrCalibReq "MCU_ResolverCalibrationRequestByMg2";
CM_ SG_ 3221225472 MCU_Mg2RsvrCalibProcSta "MCU_Mg2ResolverCalibrationProcessStatus";
CM_ SG_ 3221225472 MCU_Mg2RsvrCalibSta "GCU_ResolverCalibrationStatus";
CM_ SG_ 3221225472 MCU_Mg2EstTqVal "MCU_EstimatedMg2TorqueValue";
CM_ SG_ 3221225472 MCU_Mg2RadPwmDtyReq "MCU_RadiatorPwmDutyRequestByMg2";
CM_ SG_ 3221225472 MCU_Mg2EstBfrAjVal "MCU_EstimatedMg2TorqueBeforeAjValue";
CM_ SG_ 3221225472 MCU_Mg2TqUppLimMtrngVal "MCU_Mg2TorqueUpperLimitMotoringValue";
CM_ SG_ 3221225472 MCU_Mg2ActlRotatSpdRpmVal "MCU_ActualMg2RotationSpeedRpmValue";
CM_ SG_ 3221225472 MCU_Mg2TqUppLimGenVal "MCU_Mg2TorqueUpperLimitGeneratingValue";
CM_ SG_ 3221225472 MCU_Mg2InvtRdySta "MCU_Mg2InverterControllerReadyStatus";
CM_ SG_ 3221225472 MCU_Mg2CtrlablSta "GCU_HsgControllableStatus";
CM_ SG_ 3221225472 MCU_Mg2WrngSta "MCU_Mg2WarningStatus";
CM_ SG_ 3221225472 MCU_Mg2FltSta "MCU_Mg2FaultStatus";
CM_ SG_ 3221225472 MCU_Mg2DeratingFctrPcVal "MCU_Mg2DeratingFactorPcValue";
CM_ SG_ 3221225472 MCU_Mg2InvtTempVal "MCU_Mg2InverterTemperatureValue";
CM_ SG_ 3221225472 ADAS_CMD_Crc30Val "ADAS_CMD_CyclicRedundancyCheck30Value";
CM_ SG_ 3221225472 FCA_ESA_CtrlSta "FCA w/ ESA Control Status";
CM_ SG_ 3221225472 ADAS_Damping_Gain "ADAS_Damping_Gain";
CM_ SG_ 3221225472 ADAS_CMD_AlvCnt30Val "ADAS_CMD_AliveCounter30Value";
CM_ SG_ 3221225472 LKA_OptUsmSta "LKA_OptionUsmStatus ##2G##LDW_LKA - LKA11 - CF_LKA_Opt_USM";
CM_ SG_ 3221225472 LKA_RcgSta "LKA_RecognitionStatus ##2G##LDW_LKA - LKA11 - CF_LKA_LaneRecogState";
CM_ SG_ 3221225472 LKA_LHLnWrnSta "LKA_LHLaneWarningStatus ##2G##LDW_LKA - LKA11 - CF_LKA_LHWarning";
CM_ SG_ 3221225472 LKA_RHLnWrnSta "LKA_RHLaneWarningStatus ##2G##LDW_LKA - LKA11 - CF_LKA_RHWarning";
CM_ SG_ 3221225472 LKA_HndsoffSnd "LKA_HandsoffSound ##2G##LDW_LKA - LKA11 - CF_LKA_HandsOff_Snd";
CM_ SG_ 3221225472 LKA_SysIndReq "LKA_SystemIndicatorRequest ##2G##LDW_LKA - LKA11 - CF_LKA_SymbolState";
CM_ SG_ 3221225472 ADAS_StrTqReqVal "LKA_SteeringTorqueRequestValue ##2G##LDW_LKA - LKA11 - CR_LKA_StrToqReq";
CM_ SG_ 3221225472 ADAS_ActToiSta "ADAS_ActiveTorqueOverlayInterfaceStatus ##2G##LDW_LKA - LKA11 - CF_LKA_ActToi";
CM_ SG_ 3221225472 ADAS_ToiFltSta "ADAS_TorqueOverlayInterfaceFaultStatus ##2G##LDW_LKA - LKA11 - CF_LKA_ToiFlt";
CM_ SG_ 3221225472 BCA_Rear_WrnSta "BCA_Rear_WarningStatus";
CM_ SG_ 3221225472 LKA_SysWrn "LKA_Additional_Info";
CM_ SG_ 3221225472 FCA_LO_WrnSta "FCA_LO_WarningStatus";
CM_ SG_ 3221225472 FCA_LS_WrnSta "FCA_LS_WarningStatus";
CM_ SG_ 3221225472 LKA_UsmMod "LKA_USM Mode ##2G##LDW_LKA-LKA11-CF_LKA_USM_Mode";
CM_ SG_ 3221225472 Info_PedtrnDst "Distance of the nearest pedestrian ##2G##LDW_LKA-LKA12-CF_Vess_ref_Ped_Distance";
CM_ SG_ 3221225472 FCA_ESA_WrnSta "FCA w/ ESA HMI";
CM_ SG_ 3221225472 ICU_Crc12Val "ICU_CyclicRedundancyCheck12Value";
CM_ SG_ 3221225472 Warn_ChaDrSwRrSta "##2G## -  - CF_Gway_ChaDrSwRr";
CM_ SG_ 3221225472 ICU_AlvCnt12Val "ICU_AliveCounter12Value";
CM_ SG_ 3221225472 ICU_IGN3On_RequestState "EV IGN3 Relay Request unit State";
CM_ SG_ 3221225472 Warn_ChaDrSwFrtSta "##2G## - -  CF_Gway_ChaDrSwFrt";
CM_ SG_ 3221225472 YRS_Crc1Val "YRS_CyclicRedundancyCheck1Value";
CM_ SG_ 3221225472 YRS_SnsrTempVal "YRS_SensorTemperatureValue ##2G##YRS - YRS12 - YRS_Temp";
CM_ SG_ 3221225472 YRS_ImuSeralNumVal "YRS_ImuSerialNumberValue ##2G##YRS - YRS13 - YRS_SeralNo";
CM_ SG_ 3221225472 YRS_AlvCnt1Val "YRS_AliveCounter1Value";
CM_ SG_ 3221225472 YRS_YawSigSta "YRS_YawSignalStatus ##2G##YRS - YRS11 - CF_Yrs_YrStat";
CM_ SG_ 3221225472 YRS_LatAccelSigSta "YRS_LateralAccelerationSignalStatus ##2G##YRS - YRS11 - CF_Yrs_LatAcStat";
CM_ SG_ 3221225472 YRS_LongAccelSigSta "YRS_LongitudinalAccelerationSignalStatus ##2G##YRS - YRS12 - CF_Yrs_LongAcStat";
CM_ SG_ 3221225472 YRS_McuVoltSta "YRS_McuVoltageStatus ##2G##YRS - YRS11 - CF_Yrs_MCUStat";
CM_ SG_ 3221225472 YRS_AcuRstSta "YRS_AcuResetStatus ##2G##YRS - YRS12 - CF_IMU_ResetStat";
CM_ SG_ 3221225472 YRS_SnsrTyp "YRS_SensorType ##2G##YRS - YRS12 - CF_Yrs_Type";
CM_ SG_ 3221225472 YRS_YawRtVal "YRS_YawRateValue ##2G##YRS - YRS11 - CR_Yrs_Yr";
CM_ SG_ 3221225472 YRS_LatAccelVal "YRS_LateralAccelerationValue ##2G##YRS - YRS11 - CR_Yrs_LatAc";
CM_ SG_ 3221225472 YRS_LongAccelVal "YRS_LongitudinalAccelerationValue ##2G##YRS - YRS12 - CR_Yrs_LongAc";
CM_ SG_ 3221225472 GATEWAY_CrcVal "GATEWAY_CyclicRedundancyCheckValue";
CM_ SG_ 3221225472 GATEWAY_AlvCntVal "GATEWAY_AliveCounterValue";
CM_ SG_ 3221225472 ICU_Crc8Val "ICU_CyclicRedundancyCheck8Value";
CM_ SG_ 3221225472 HeatedSteerWheel_StrWhlHtrSwSta "Use for Telematics Remote Heating Control ##2G## -  - C_StrgWhlHeatedState";
CM_ SG_ 3221225472 ICU_AlvCnt8Val "ICU_AliveCounter8Value";
CM_ SG_ 3221225472 DriveTypeOption "##2G## -  - C_DriveTypeOption,CF_Gway_DriveTypeOption";
CM_ SG_ 3221225472 Warn_RrLftSBRMATSwSta "##2G## -  - C_RLSBRMatSw";
CM_ SG_ 3221225472 Warn_RrRhtSBRMATSwSta "##2G## -  - C_RRSBRMatSw";
CM_ SG_ 3221225472 StrWheelAutoHeatSta "##2G## -  - C_StrWheelAutoHeatRValue";
CM_ SG_ 3221225472 StrWheelHeatIndSta "##2G## -  - C_StrgWhlHeatedInd";
CM_ SG_ 3221225472 Warn_LftSEA "##2G## -  - CF_ICU_SeaWarn_Lh";
CM_ SG_ 3221225472 Warn_RhtSEA "##2G## -  - CF_ICU_SeaWarn_Rh";
CM_ SG_ 3221225472 Lamp_FootLampOnReq "##2G## -  - C_FootLpOn";
CM_ SG_ 3221225472 Lamp_MoodLampOnReq "##2G## -  - C_MoodLpOn";
CM_ SG_ 3221225472 ICU_PowerAutoCutModSta "##2G## -  - CF_Gway_ICUPowerAutoCutMode";
CM_ SG_ 3221225472 ICU_SoCBattStaMsgReq "##2G## -  - Batt_SoCWarningAlertMsgReq";
CM_ SG_ 3221225472 DrvDrLockIND "Driver door lock indicator on/off signal";
CM_ SG_ 3221225472 Brake_SwSta_ICU "Brake Switch Status ##2G## -  - C_BrakeSw";
CM_ SG_ 3221225472 HSWS_SysWrngSta_ICU "HSWS Status ##2G## -  - C_HSWSSysStat";
CM_ SG_ 3221225472 DATC_Crc1Val "DATC_CyclicRedundancyCheck1Value";
CM_ SG_ 3221225472 DATC_BattChlrVlvSta "Battery chiller valve status";
CM_ SG_ 3221225472 DATC_AcnECompSpdVal "DATC_AirconElectricalCompressorSpeedValue";
CM_ SG_ 3221225472 DATC_AcnCompSlpModCodVal "DATC_AirconCompressorSleepModeCodeValue";
CM_ SG_ 3221225472 DATC_AcnCompWaitCodVal "DATC_AirconCompressorWaitCode";
BA_DEF_ BO_  "GenMsgEVName" STRING ;
BA_DEF_ BU_  "NmAsrCanMsgReducedTime" INT 0 1000;
BA_DEF_  "NmAsrWaitBusSleepTime" INT 0 100000;
BA_DEF_  "NmAsrTimeoutTime" INT 0 100000;
BA_DEF_  "NmAsrRepeatMessageTime" INT 0 100000;
BA_DEF_  "NmAsrMessageCount" INT 1 128;
BA_DEF_  "NmAsrCanMsgCycleTime" INT 0 100;
BA_DEF_  "NmAsrBaseAddress" HEX 0 536870911;
BA_DEF_ BO_  "UsrMsgIDSforwardDeviation" INT 0 100;
BA_DEF_ BO_  "UsrMsgIDSbackwardDeviation" INT 50 1000;
BA_DEF_  "BusType" STRING ;
BA_DEF_  "DBName" STRING ;
BA_DEF_  "Baudrate" INT 50000 1000000;
BA_DEF_  "BRS" INT 0 1;
BA_DEF_  "GenEnvVarEndingDsp" STRING ;
BA_DEF_  "GenEnvVarEndingSnd" STRING ;
BA_DEF_  "GenEnvVarPrefix" STRING ;
BA_DEF_  "GenNWMApBusSleep" STRING ;
BA_DEF_  "GenNWMApCanNormal" STRING ;
BA_DEF_  "GenNWMApCanOff" STRING ;
BA_DEF_  "GenNWMApCanOn" STRING ;
BA_DEF_  "GenNWMApCanSleep" STRING ;
BA_DEF_  "GenNWMApCanWakeUp" STRING ;
BA_DEF_  "GenNWMGotoMode_Awake" STRING ;
BA_DEF_  "GenNWMGotoMode_BusSleep" STRING ;
BA_DEF_  "GenNWMSleepTime" INT 1375 1650;
BA_DEF_  "GenNWMTalkNM" STRING ;
BA_DEF_  "Manufacturer" STRING ;
BA_DEF_  "NmBaseAddress" HEX 0 2047;
BA_DEF_  "NmMessageCount" INT 0 128;
BA_DEF_  "NmType" STRING ;
BA_DEF_  "SamplePointMax" INT 50 85;
BA_DEF_  "SamplePointMin" INT 55 85;
BA_DEF_  "SyncJumpWidthMax" INT 1 8;
BA_DEF_  "SyncJumpWidthMin" INT 1 4;
BA_DEF_  "VersionDay" INT 1 31;
BA_DEF_  "VersionMonth" INT 1 12;
BA_DEF_  "VersionWeek" INT 1 53;
BA_DEF_  "VersionYear" INT 0 9999;
BA_DEF_ BU_  "NmStationAddress" HEX 0 127;
BA_DEF_ BU_  "NmNode" ENUM  "No","Yes";
BA_DEF_ BU_  "GenNodSleepTime" INT 1375 1650;
BA_DEF_ BU_  "ILUsed" ENUM  "No","Yes";
BA_DEF_ BU_  "NmCAN" INT 1 2;
BA_DEF_ BU_  "NodeLayerModules" STRING ;
BA_DEF_ BU_  "NWM_Knoten" ENUM  "No","Yes";
BA_DEF_ BO_  "GenMsgCycleTime" INT 0 2000;
BA_DEF_ BO_  "GenMsgStartDelayTime" INT 0 2000;
BA_DEF_ BO_  "GenMsgSendType" ENUM  "Cyclic","NoMsgSendType";
BA_DEF_ BO_  "GenMsgCycleTimeFast" INT 0 500;
BA_DEF_ BO_  "GenMsgDelayTime" INT 0 20;
BA_DEF_ BO_  "GenMsgILSupport" ENUM  "No","Yes";
BA_DEF_ BO_  "GenMsgNrOfRepetition" INT 0 3;
BA_DEF_ BO_  "VFrameFormat" ENUM  "StandardCAN","ExtendedCAN","reserved","reserved","reserved","reserved","reserved","reserved","reserved","reserved","reserved","reserved","reserved","reserved","StandardCAN_FD","ExtendedCAN_FD";
BA_DEF_ SG_  "UserSigValidity" ENUM  "B+","ACC","IG","IG1","IG2","IG3","IG1 or IG2","IG1 or IG3","Undef";
BA_DEF_ SG_  "UsrSigPurpose" ENUM  "Undef","FN","DIAG","DIAG(Req)","DIAG(Res)","DIAG(Phy)","DEV","CCP(Req)","CCP(Res)","NM","TP";
BA_DEF_ SG_  "GenSigStartValue" INT 0 1215752192;
BA_DEF_ SG_  "NetworkRequest" ENUM  "Yes","No";
BA_DEF_ SG_  "NetworkRequestHoldingTime" INT 0 65535;
BA_DEF_ SG_  "Description" STRING ;
BA_DEF_ SG_  "Version" STRING ;
BA_DEF_ SG_  "GenSigEnvVarType" ENUM  "Int","Float","Undef";
BA_DEF_ SG_  "GenSigSendType" ENUM  "Cyclic","OnWrite","OnWriteWithRepetition","OnChange","OnChangeWithRepetition","IfActive","IfActiveWithRepetition","NoSigSendType","OnChangeAndIfActive","OnChangeAndIfActiveWithRepetition";
BA_DEF_ SG_  "GwSigLatencyTime" INT 0 65536;
BA_DEF_ SG_  "GwSigMissingSourceType" ENUM  "Undef","OldValue","DefaultValue","InitialValue";
BA_DEF_ SG_  "NWM-WakeupAllowed" ENUM  "<n.a.>";
BA_DEF_ SG_  "RoutingFactor" INT 1 1215752192;
BA_DEF_  "Datarate" INT 2000000 8000000;
BA_DEF_REL_ BU_SG_REL_  "GenSigTimeoutTime" INT 0 7000;
BA_DEF_DEF_  "GenMsgEVName" "@Signame";
BA_DEF_DEF_  "NmAsrCanMsgReducedTime" 1000;
BA_DEF_DEF_  "NmAsrWaitBusSleepTime" 1500;
BA_DEF_DEF_  "NmAsrTimeoutTime" 1000;
BA_DEF_DEF_  "NmAsrRepeatMessageTime" 1200;
BA_DEF_DEF_  "NmAsrMessageCount" 128;
BA_DEF_DEF_  "NmAsrCanMsgCycleTime" 100;
BA_DEF_DEF_  "NmAsrBaseAddress" 1280;
BA_DEF_DEF_  "UsrMsgIDSforwardDeviation" 10;
BA_DEF_DEF_  "UsrMsgIDSbackwardDeviation" 100;
BA_DEF_DEF_  "BusType" "CAN FD";
BA_DEF_DEF_  "DBName" "";
BA_DEF_DEF_  "Baudrate" 500000;
BA_DEF_DEF_  "BRS" 1;
BA_DEF_DEF_  "GenEnvVarEndingDsp" "Dsp_";
BA_DEF_DEF_  "GenEnvVarEndingSnd" "_";
BA_DEF_DEF_  "GenEnvVarPrefix" "Env";
BA_DEF_DEF_  "GenNWMApBusSleep" "AppNmCanBusSleep()";
BA_DEF_DEF_  "GenNWMApCanNormal" "AppNmCanNormal()";
BA_DEF_DEF_  "GenNWMApCanOff" "ApplCanOffline()";
BA_DEF_DEF_  "GenNWMApCanOn" "ApplCanOnline()";
BA_DEF_DEF_  "GenNWMApCanSleep" "ApplNmCanSleep()";
BA_DEF_DEF_  "GenNWMApCanWakeUp" "ApplCanWakeUp()";
BA_DEF_DEF_  "GenNWMGotoMode_Awake" "GotoMode_Awake()";
BA_DEF_DEF_  "GenNWMGotoMode_BusSleep" "GotoMode_BusSleep()";
BA_DEF_DEF_  "GenNWMSleepTime" 1500;
BA_DEF_DEF_  "GenNWMTalkNM" "TalkNM()";
BA_DEF_DEF_  "Manufacturer" "HMC";
BA_DEF_DEF_  "NmBaseAddress" 1280;
BA_DEF_DEF_  "NmMessageCount" 128;
BA_DEF_DEF_  "NmType" "AsrNm";
BA_DEF_DEF_  "SamplePointMax" 80;
BA_DEF_DEF_  "SamplePointMin" 80;
BA_DEF_DEF_  "SyncJumpWidthMax" 3;
BA_DEF_DEF_  "SyncJumpWidthMin" 2;
BA_DEF_DEF_  "VersionDay" 1;
BA_DEF_DEF_  "VersionMonth" 1;
BA_DEF_DEF_  "VersionWeek" 1;
BA_DEF_DEF_  "VersionYear" 0;
BA_DEF_DEF_  "NmStationAddress" 0;
BA_DEF_DEF_  "NmNode" "No";
BA_DEF_DEF_  "GenNodSleepTime" 1500;
BA_DEF_DEF_  "ILUsed" "Yes";
BA_DEF_DEF_  "NmCAN" 1;
BA_DEF_DEF_  "NodeLayerModules" "AsrNM33.DLL,CANoeILNLVector.DLL";
BA_DEF_DEF_  "NWM_Knoten" "Yes";
BA_DEF_DEF_  "GenMsgCycleTime" 200;
BA_DEF_DEF_  "GenMsgStartDelayTime" 0;
BA_DEF_DEF_  "GenMsgSendType" "NoMsgSendType";
BA_DEF_DEF_  "GenMsgCycleTimeFast" 40;
BA_DEF_DEF_  "GenMsgDelayTime" 20;
BA_DEF_DEF_  "GenMsgILSupport" "Yes";
BA_DEF_DEF_  "GenMsgNrOfRepetition" 3;
BA_DEF_DEF_  "VFrameFormat" "StandardCAN";
BA_DEF_DEF_  "UserSigValidity" "IG";
BA_DEF_DEF_  "UsrSigPurpose" "FN";
BA_DEF_DEF_  "GenSigStartValue" 0;
BA_DEF_DEF_  "NetworkRequest" "No";
BA_DEF_DEF_  "NetworkRequestHoldingTime" 0;
BA_DEF_DEF_  "Description" "";
BA_DEF_DEF_  "Version" "";
BA_DEF_DEF_  "GenSigEnvVarType" "Undef";
BA_DEF_DEF_  "GenSigSendType" "NoSigSendType";
BA_DEF_DEF_  "GwSigLatencyTime" 40;
BA_DEF_DEF_  "GwSigMissingSourceType" "Undef";
BA_DEF_DEF_  "NWM-WakeupAllowed" "<n.a.>";
BA_DEF_DEF_  "RoutingFactor" 1;
BA_DEF_DEF_  "Datarate" 2000000;
BA_DEF_DEF_REL_ "GenSigTimeoutTime" 500;
BA_ "VersionWeek" 13;
BA_ "VersionYear" 2020;
BA_ "VersionMonth" 3;
BA_ "VersionDay" 26;
BA_ "DBName" "CANFD";
BA_ "NmNode" BU_ CGW 1;
BA_ "NmStationAddress" BU_ CGW 22;
BA_ "Version" SG_ 3221225472 ABS_ESC_Crc1Val "18.12.05";
BA_ "RoutingFactor" SG_ 3221225472 ABS_ESC_Crc1Val 5;
BA_ "UserSigValidity" SG_ 3221225472 ABS_ESC_Crc1Val 3;
BA_ "GenSigStartValue" SG_ 3221225472 ABS_ESC_Crc1Val 65535;
BA_ "Description" SG_ 3221225472 ABS_ESC_Crc1Val "The data area for CRC calculation is based on the data length (DLC) of the message DB.

The CRC shall be calculated over the entire data block (excluding the CRC bytes) including the user data, alive counter and Data ID

 

- CRC Polynomial (0x1021) , In";
BA_ "Version" SG_ 3221225472 ABS_ESC_AlvCnt1Val "18.12.05";
BA_ "RoutingFactor" SG_ 3221225472 ABS_ESC_AlvCnt1Val 5;
BA_ "UserSigValidity" SG_ 3221225472 ABS_ESC_AlvCnt1Val 3;
BA_ "Description" SG_ 3221225472 ABS_ESC_AlvCnt1Val "For the first transmission request for a data element the counter shall be initialized with 0 and shall be incremented by 1 for every subsequent send request. 

When the counter reaches the maximum value(0xFF), then it shall restart with 0 for the next s";
BA_ "Version" SG_ 3221225472 ABS_WrngLmpSta "19.07.02";
BA_ "RoutingFactor" SG_ 3221225472 ABS_WrngLmpSta 5;
BA_ "UserSigValidity" SG_ 3221225472 ABS_WrngLmpSta 3;
BA_ "Description" SG_ 3221225472 ABS_WrngLmpSta "The signal indicates the status of the ��ABS Warning lamp��";
BA_ "Version" SG_ 3221225472 ABS_DfctvSta "19.07.02";
BA_ "RoutingFactor" SG_ 3221225472 ABS_DfctvSta 5;
BA_ "UserSigValidity" SG_ 3221225472 ABS_DfctvSta 3;
BA_ "Description" SG_ 3221225472 ABS_DfctvSta "Information regarding the ABS 'defective' indication.";
BA_ "Version" SG_ 3221225472 ABS_ActvSta "19.07.02";
BA_ "RoutingFactor" SG_ 3221225472 ABS_ActvSta 5;
BA_ "UserSigValidity" SG_ 3221225472 ABS_ActvSta 3;
BA_ "Description" SG_ 3221225472 ABS_ActvSta "ABS controller provides an information on ABS Active signal.



ABS_ACT signal is 1 during the ABS control and if it is not ABS control phase this value is 0.";
BA_ "Version" SG_ 3221225472 ABS_DiagSta "19.07.02";
BA_ "RoutingFactor" SG_ 3221225472 ABS_DiagSta 5;
BA_ "UserSigValidity" SG_ 3221225472 ABS_DiagSta 3;
BA_ "Description" SG_ 3221225472 ABS_DiagSta "Information regarding the ABS/TCS/ESC ��diagnostic mode�� indication.";
BA_ "Version" SG_ 3221225472 EBD_WrngLmpSta "19.07.02";
BA_ "RoutingFactor" SG_ 3221225472 EBD_WrngLmpSta 5;
BA_ "UserSigValidity" SG_ 3221225472 EBD_WrngLmpSta 3;
BA_ "Description" SG_ 3221225472 EBD_WrngLmpSta "The signal indicates the status of the ��EBD Warning lamp��";
BA_ "Version" SG_ 3221225472 EBD_DfctvSta "19.07.02";
BA_ "RoutingFactor" SG_ 3221225472 EBD_DfctvSta 5;
BA_ "UserSigValidity" SG_ 3221225472 EBD_DfctvSta 3;
BA_ "Description" SG_ 3221225472 EBD_DfctvSta "Information regarding the EBD  'defective' indication.";
BA_ "Version" SG_ 3221225472 ESC_BrkLtActSta "19.07.02";
BA_ "RoutingFactor" SG_ 3221225472 ESC_BrkLtActSta 5;
BA_ "UserSigValidity" SG_ 3221225472 ESC_BrkLtActSta 0;
BA_ "Description" SG_ 3221225472 ESC_BrkLtActSta "Flag from TCS which activates the illumination of the brake lights during automatic braking";
BA_ "Version" SG_ 3221225472 ESS_Sta "19.07.02";
BA_ "RoutingFactor" SG_ 3221225472 ESS_Sta 5;
BA_ "UserSigValidity" SG_ 3221225472 ESS_Sta 3;
BA_ "Description" SG_ 3221225472 ESS_Sta "Information on ESS system active/inactive/fail from ABS/ESC.";
BA_ "Version" SG_ 3221225472 ECS_Crc1Val "18.11.08";
BA_ "RoutingFactor" SG_ 3221225472 ECS_Crc1Val 2;
BA_ "UserSigValidity" SG_ 3221225472 ECS_Crc1Val 3;
BA_ "GenSigStartValue" SG_ 3221225472 ECS_Crc1Val 65535;
BA_ "Description" SG_ 3221225472 ECS_Crc1Val "The data area for CRC calculation is based on the data length (DLC) of the message DB.

The CRC shall be calculated over the entire data block (excluding the CRC bytes) including the user data, alive counter and Data ID

 

- CRC Polynomial (0x1021) , In";
BA_ "Version" SG_ 3221225472 ECS_AlvCnt1Val "18.11.08";
BA_ "RoutingFactor" SG_ 3221225472 ECS_AlvCnt1Val 2;
BA_ "UserSigValidity" SG_ 3221225472 ECS_AlvCnt1Val 3;
BA_ "Description" SG_ 3221225472 ECS_AlvCnt1Val "For the first transmission request for a data element the counter shall be initialized with 0 and shall be incremented by 1 for every subsequent send request. 

When the counter reaches the maximum value(0xFF), then it shall restart with 0 for the next s";
BA_ "Version" SG_ 3221225472 ECS_WrngLmpSta "17.12.00";
BA_ "RoutingFactor" SG_ 3221225472 ECS_WrngLmpSta 2;
BA_ "UserSigValidity" SG_ 3221225472 ECS_WrngLmpSta 3;
BA_ "Description" SG_ 3221225472 ECS_WrngLmpSta "The signal indicates the status of the ��ECS warning lamp��";
BA_ "Version" SG_ 3221225472 ECS_DfctvSta "17.12.00";
BA_ "RoutingFactor" SG_ 3221225472 ECS_DfctvSta 2;
BA_ "UserSigValidity" SG_ 3221225472 ECS_DfctvSta 3;
BA_ "Description" SG_ 3221225472 ECS_DfctvSta "Information regarding the ECS ��defective�� indication";
BA_ "Version" SG_ 3221225472 ECS_DmpModSta "17.12.00";
BA_ "RoutingFactor" SG_ 3221225472 ECS_DmpModSta 2;
BA_ "UserSigValidity" SG_ 3221225472 ECS_DmpModSta 3;
BA_ "Description" SG_ 3221225472 ECS_DmpModSta "The actual damping mode of an ECS system";
BA_ "Version" SG_ 3221225472 ECS_DmpModReq "17.12.00";
BA_ "RoutingFactor" SG_ 3221225472 ECS_DmpModReq 2;
BA_ "UserSigValidity" SG_ 3221225472 ECS_DmpModReq 3;
BA_ "Description" SG_ 3221225472 ECS_DmpModReq "Requested damping mode set by ECS manual switch";
BA_ "Version" SG_ 3221225472 FR_CMR_Crc1Val "18.11.08";
BA_ "RoutingFactor" SG_ 3221225472 FR_CMR_Crc1Val 5;
BA_ "UserSigValidity" SG_ 3221225472 FR_CMR_Crc1Val 3;
BA_ "GenSigStartValue" SG_ 3221225472 FR_CMR_Crc1Val 65535;
BA_ "Description" SG_ 3221225472 FR_CMR_Crc1Val "The data area for CRC calculation is based on the data length (DLC) of the message DB.

The CRC shall be calculated over the entire data block (excluding the CRC bytes) including the user data, alive counter and Data ID

 

- CRC Polynomial (0x1021) , In";
BA_ "Version" SG_ 3221225472 FR_CMR_AlvCnt1Val "18.11.08";
BA_ "RoutingFactor" SG_ 3221225472 FR_CMR_AlvCnt1Val 5;
BA_ "UserSigValidity" SG_ 3221225472 FR_CMR_AlvCnt1Val 3;
BA_ "Description" SG_ 3221225472 FR_CMR_AlvCnt1Val "For the first transmission request for a data element the counter shall be initialized with 0 and shall be incremented by 1 for every subsequent send request. 

When the counter reaches the maximum value(0xFF), then it shall restart with 0 for the next s";
BA_ "Version" SG_ 3221225472 HBA_SysOptSta "17.12.02";
BA_ "RoutingFactor" SG_ 3221225472 HBA_SysOptSta 5;
BA_ "UserSigValidity" SG_ 3221225472 HBA_SysOptSta 3;
BA_ "Description" SG_ 3221225472 HBA_SysOptSta "HBA System Option Information to Lamp Controller";
BA_ "Version" SG_ 3221225472 HBA_SysSta "17.12.02";
BA_ "RoutingFactor" SG_ 3221225472 HBA_SysSta 5;
BA_ "UserSigValidity" SG_ 3221225472 HBA_SysSta 3;
BA_ "Description" SG_ 3221225472 HBA_SysSta "This signal indicates the status of High Beam Assist system.";
BA_ "Version" SG_ 3221225472 HBA_IndLmpReq "17.12.02";
BA_ "RoutingFactor" SG_ 3221225472 HBA_IndLmpReq 5;
BA_ "UserSigValidity" SG_ 3221225472 HBA_IndLmpReq 3;
BA_ "Description" SG_ 3221225472 HBA_IndLmpReq "HBA System Indicator Lamp Status";
BA_ "Version" SG_ 3221225472 FCA_Equip_MFC "18.02.03";
BA_ "RoutingFactor" SG_ 3221225472 FCA_Equip_MFC 5;
BA_ "UserSigValidity" SG_ 3221225472 FCA_Equip_MFC 3;
BA_ "Description" SG_ 3221225472 FCA_Equip_MFC "FCA Sensor Type";
BA_ "Version" SG_ 3221225472 HBA_OptUsmSta "18.04.00";
BA_ "RoutingFactor" SG_ 3221225472 HBA_OptUsmSta 5;
BA_ "UserSigValidity" SG_ 3221225472 HBA_OptUsmSta 3;
BA_ "Description" SG_ 3221225472 HBA_OptUsmSta "HBA Option USM Status";
BA_ "Version" SG_ 3221225472 DAW_LVDA_PUDis "18.07.01";
BA_ "RoutingFactor" SG_ 3221225472 DAW_LVDA_PUDis 5;
BA_ "UserSigValidity" SG_ 3221225472 DAW_LVDA_PUDis 3;
BA_ "Description" SG_ 3221225472 DAW_LVDA_PUDis "Message for displaying LVDA(Leading Vehicle Departure Alert) Warning";
BA_ "Version" SG_ 3221225472 DAW_LVDA_OptUsmSta "19.02.05";
BA_ "RoutingFactor" SG_ 3221225472 DAW_LVDA_OptUsmSta 5;
BA_ "UserSigValidity" SG_ 3221225472 DAW_LVDA_OptUsmSta 3;
BA_ "Description" SG_ 3221225472 DAW_LVDA_OptUsmSta "LVDA USM state";
BA_ "Version" SG_ 3221225472 DAW_OptUsmSta "18.07.01";
BA_ "RoutingFactor" SG_ 3221225472 DAW_OptUsmSta 5;
BA_ "UserSigValidity" SG_ 3221225472 DAW_OptUsmSta 3;
BA_ "Description" SG_ 3221225472 DAW_OptUsmSta "This signal represents the lastest DAW ON/OFF value of USM.";
BA_ "Version" SG_ 3221225472 DAW_SysSta "18.07.01";
BA_ "RoutingFactor" SG_ 3221225472 DAW_SysSta 5;
BA_ "UserSigValidity" SG_ 3221225472 DAW_SysSta 3;
BA_ "Description" SG_ 3221225472 DAW_SysSta "This signal represents Attention Assist System Status or Attention Level.";
BA_ "Version" SG_ 3221225472 DAW_WrnMsgSta "19.03.06";
BA_ "RoutingFactor" SG_ 3221225472 DAW_WrnMsgSta 5;
BA_ "UserSigValidity" SG_ 3221225472 DAW_WrnMsgSta 3;
BA_ "Description" SG_ 3221225472 DAW_WrnMsgSta "0x1 value requests DAW Rest recommend warning message popup at CLU.

0x2 value requests HDA/LFA Hands-Off call at TMS.";
BA_ "Version" SG_ 3221225472 DAW_TimeRstReq "18.07.01";
BA_ "RoutingFactor" SG_ 3221225472 DAW_TimeRstReq 5;
BA_ "UserSigValidity" SG_ 3221225472 DAW_TimeRstReq 3;
BA_ "Description" SG_ 3221225472 DAW_TimeRstReq "This signal requests CLU 'Last Break Time' Reset.

DAW send '0x1' when detecting driver's rest.";
BA_ "Version" SG_ 3221225472 DAW_SnstvtyModRetVal "18.07.01";
BA_ "RoutingFactor" SG_ 3221225472 DAW_SnstvtyModRetVal 5;
BA_ "UserSigValidity" SG_ 3221225472 DAW_SnstvtyModRetVal 3;
BA_ "Description" SG_ 3221225472 DAW_SnstvtyModRetVal "This signal represents the feedback value of the current ADAS warning timing.";
BA_ "Version" SG_ 3221225472 FR_CMR_FCAEquipSta "18.11.06";
BA_ "RoutingFactor" SG_ 3221225472 FR_CMR_FCAEquipSta 5;
BA_ "UserSigValidity" SG_ 3221225472 FR_CMR_FCAEquipSta 3;
BA_ "Description" SG_ 3221225472 FR_CMR_FCAEquipSta "FCA sensor type and coding information.";
BA_ "Version" SG_ 3221225472 FR_CMR_MDPSCtrlSta "18.11.06";
BA_ "RoutingFactor" SG_ 3221225472 FR_CMR_MDPSCtrlSta 5;
BA_ "UserSigValidity" SG_ 3221225472 FR_CMR_MDPSCtrlSta 3;
BA_ "Description" SG_ 3221225472 FR_CMR_MDPSCtrlSta "This signal indicates steering control status by MDPS";
BA_ "Version" SG_ 3221225472 FR_CMR_FailInfoSta "18.12.08";
BA_ "RoutingFactor" SG_ 3221225472 FR_CMR_FailInfoSta 5;
BA_ "UserSigValidity" SG_ 3221225472 FR_CMR_FailInfoSta 3;
BA_ "Description" SG_ 3221225472 FR_CMR_FailInfoSta "This signal indicates abnormal state of the front camera. The abnormal state does not include ADAS function failure like SCC failure and FCA failure.";
BA_ "Version" SG_ 3221225472 FR_CMR_CodingSta "18.11.06";
BA_ "RoutingFactor" SG_ 3221225472 FR_CMR_CodingSta 5;
BA_ "UserSigValidity" SG_ 3221225472 FR_CMR_CodingSta 3;
BA_ "Description" SG_ 3221225472 FR_CMR_CodingSta "This signal indicates coding state of the front camera.";
BA_ "Version" SG_ 3221225472 FR_CMR_ACANMonSta "18.11.06";
BA_ "RoutingFactor" SG_ 3221225472 FR_CMR_ACANMonSta 5;
BA_ "UserSigValidity" SG_ 3221225472 FR_CMR_ACANMonSta 3;
BA_ "Description" SG_ 3221225472 FR_CMR_ACANMonSta "This signal indicates result of A-CANFD network monitoring in the front camera";
BA_ "Version" SG_ 3221225472 PRVECS_CodedSta "19.06.00";
BA_ "RoutingFactor" SG_ 3221225472 PRVECS_CodedSta 5;
BA_ "UserSigValidity" SG_ 3221225472 PRVECS_CodedSta 3;
BA_ "Version" SG_ 3221225472 CCP_ECS_RESP_9_Byte0 "19.03.06";
BA_ "NetworkRequestHoldingTime" SG_ 3221225472 CCP_ECS_RESP_9_Byte0 5000;
BA_ "NetworkRequest" SG_ 3221225472 CCP_ECS_RESP_9_Byte0 0;
BA_ "UserSigValidity" SG_ 3221225472 CCP_ECS_RESP_9_Byte0 0;
BA_ "GenSigSendType" SG_ 3221225472 CCP_ECS_RESP_9_Byte0 2;
BA_ "UsrSigPurpose" SG_ 3221225472 CCP_ECS_RESP_9_Byte0 6;
BA_ "Version" SG_ 3221225472 CCP_ECS_RESP_9_Byte2 "19.03.06";
BA_ "NetworkRequestHoldingTime" SG_ 3221225472 CCP_ECS_RESP_9_Byte2 5000;
BA_ "NetworkRequest" SG_ 3221225472 CCP_ECS_RESP_9_Byte2 0;
BA_ "UserSigValidity" SG_ 3221225472 CCP_ECS_RESP_9_Byte2 0;
BA_ "GenSigSendType" SG_ 3221225472 CCP_ECS_RESP_9_Byte2 2;
BA_ "UsrSigPurpose" SG_ 3221225472 CCP_ECS_RESP_9_Byte2 6;
BA_ "Version" SG_ 3221225472 CCP_ECS_RESP_9_Byte3 "19.03.06";
BA_ "NetworkRequestHoldingTime" SG_ 3221225472 CCP_ECS_RESP_9_Byte3 5000;
BA_ "NetworkRequest" SG_ 3221225472 CCP_ECS_RESP_9_Byte3 0;
BA_ "UserSigValidity" SG_ 3221225472 CCP_ECS_RESP_9_Byte3 0;
BA_ "GenSigSendType" SG_ 3221225472 CCP_ECS_RESP_9_Byte3 2;
BA_ "UsrSigPurpose" SG_ 3221225472 CCP_ECS_RESP_9_Byte3 6;
BA_ "Version" SG_ 3221225472 CCP_ECS_RESP_9_Byte4 "19.03.06";
BA_ "NetworkRequestHoldingTime" SG_ 3221225472 CCP_ECS_RESP_9_Byte4 5000;
BA_ "NetworkRequest" SG_ 3221225472 CCP_ECS_RESP_9_Byte4 0;
BA_ "UserSigValidity" SG_ 3221225472 CCP_ECS_RESP_9_Byte4 0;
BA_ "GenSigSendType" SG_ 3221225472 CCP_ECS_RESP_9_Byte4 2;
BA_ "UsrSigPurpose" SG_ 3221225472 CCP_ECS_RESP_9_Byte4 6;
BA_ "Version" SG_ 3221225472 CCP_ECS_RESP_9_Byte5 "19.03.06";
BA_ "NetworkRequestHoldingTime" SG_ 3221225472 CCP_ECS_RESP_9_Byte5 5000;
BA_ "NetworkRequest" SG_ 3221225472 CCP_ECS_RESP_9_Byte5 0;
BA_ "UserSigValidity" SG_ 3221225472 CCP_ECS_RESP_9_Byte5 0;
BA_ "GenSigSendType" SG_ 3221225472 CCP_ECS_RESP_9_Byte5 2;
BA_ "UsrSigPurpose" SG_ 3221225472 CCP_ECS_RESP_9_Byte5 6;
BA_ "Version" SG_ 3221225472 CCP_ECS_RESP_9_Byte6 "19.03.06";
BA_ "NetworkRequestHoldingTime" SG_ 3221225472 CCP_ECS_RESP_9_Byte6 5000;
BA_ "NetworkRequest" SG_ 3221225472 CCP_ECS_RESP_9_Byte6 0;
BA_ "UserSigValidity" SG_ 3221225472 CCP_ECS_RESP_9_Byte6 0;
BA_ "GenSigSendType" SG_ 3221225472 CCP_ECS_RESP_9_Byte6 2;
BA_ "UsrSigPurpose" SG_ 3221225472 CCP_ECS_RESP_9_Byte6 6;
BA_ "Version" SG_ 3221225472 CCP_ECS_RESP_9_Byte7 "19.03.06";
BA_ "NetworkRequestHoldingTime" SG_ 3221225472 CCP_ECS_RESP_9_Byte7 5000;
BA_ "NetworkRequest" SG_ 3221225472 CCP_ECS_RESP_9_Byte7 0;
BA_ "UserSigValidity" SG_ 3221225472 CCP_ECS_RESP_9_Byte7 0;
BA_ "GenSigSendType" SG_ 3221225472 CCP_ECS_RESP_9_Byte7 2;
BA_ "UsrSigPurpose" SG_ 3221225472 CCP_ECS_RESP_9_Byte7 6;
BA_ "Version" SG_ 3221225472 CCP_ECS_RESP_9_Byte1 "19.03.06";
BA_ "NetworkRequestHoldingTime" SG_ 3221225472 CCP_ECS_RESP_9_Byte1 5000;
BA_ "NetworkRequest" SG_ 3221225472 CCP_ECS_RESP_9_Byte1 0;
BA_ "UserSigValidity" SG_ 3221225472 CCP_ECS_RESP_9_Byte1 0;
BA_ "GenSigSendType" SG_ 3221225472 CCP_ECS_RESP_9_Byte1 2;
BA_ "UsrSigPurpose" SG_ 3221225472 CCP_ECS_RESP_9_Byte1 6;
BA_ "Version" SG_ 3221225472 CCP_ECS_RESP_8_Byte0 "19.03.06";
BA_ "NetworkRequestHoldingTime" SG_ 3221225472 CCP_ECS_RESP_8_Byte0 5000;
BA_ "NetworkRequest" SG_ 3221225472 CCP_ECS_RESP_8_Byte0 0;
BA_ "UserSigValidity" SG_ 3221225472 CCP_ECS_RESP_8_Byte0 0;
BA_ "GenSigSendType" SG_ 3221225472 CCP_ECS_RESP_8_Byte0 2;
BA_ "UsrSigPurpose" SG_ 3221225472 CCP_ECS_RESP_8_Byte0 6;
BA_ "Version" SG_ 3221225472 CCP_ECS_RESP_8_Byte2 "19.03.06";
BA_ "NetworkRequestHoldingTime" SG_ 3221225472 CCP_ECS_RESP_8_Byte2 5000;
BA_ "NetworkRequest" SG_ 3221225472 CCP_ECS_RESP_8_Byte2 0;
BA_ "UserSigValidity" SG_ 3221225472 CCP_ECS_RESP_8_Byte2 0;
BA_ "GenSigSendType" SG_ 3221225472 CCP_ECS_RESP_8_Byte2 2;
BA_ "UsrSigPurpose" SG_ 3221225472 CCP_ECS_RESP_8_Byte2 6;
BA_ "Version" SG_ 3221225472 CCP_ECS_RESP_8_Byte3 "19.03.06";
BA_ "NetworkRequestHoldingTime" SG_ 3221225472 CCP_ECS_RESP_8_Byte3 5000;
BA_ "NetworkRequest" SG_ 3221225472 CCP_ECS_RESP_8_Byte3 0;
BA_ "UserSigValidity" SG_ 3221225472 CCP_ECS_RESP_8_Byte3 0;
BA_ "GenSigSendType" SG_ 3221225472 CCP_ECS_RESP_8_Byte3 2;
BA_ "UsrSigPurpose" SG_ 3221225472 CCP_ECS_RESP_8_Byte3 6;
BA_ "Version" SG_ 3221225472 CCP_ECS_RESP_8_Byte4 "19.03.06";
BA_ "NetworkRequestHoldingTime" SG_ 3221225472 CCP_ECS_RESP_8_Byte4 5000;
BA_ "NetworkRequest" SG_ 3221225472 CCP_ECS_RESP_8_Byte4 0;
BA_ "UserSigValidity" SG_ 3221225472 CCP_ECS_RESP_8_Byte4 0;
BA_ "GenSigSendType" SG_ 3221225472 CCP_ECS_RESP_8_Byte4 2;
BA_ "UsrSigPurpose" SG_ 3221225472 CCP_ECS_RESP_8_Byte4 6;
BA_ "Version" SG_ 3221225472 CCP_ECS_RESP_8_Byte5 "19.03.06";
BA_ "NetworkRequestHoldingTime" SG_ 3221225472 CCP_ECS_RESP_8_Byte5 5000;
BA_ "NetworkRequest" SG_ 3221225472 CCP_ECS_RESP_8_Byte5 0;
BA_ "UserSigValidity" SG_ 3221225472 CCP_ECS_RESP_8_Byte5 0;
BA_ "GenSigSendType" SG_ 3221225472 CCP_ECS_RESP_8_Byte5 2;
BA_ "UsrSigPurpose" SG_ 3221225472 CCP_ECS_RESP_8_Byte5 6;
BA_ "Version" SG_ 3221225472 CCP_ECS_RESP_8_Byte6 "19.03.06";
BA_ "NetworkRequestHoldingTime" SG_ 3221225472 CCP_ECS_RESP_8_Byte6 5000;
BA_ "NetworkRequest" SG_ 3221225472 CCP_ECS_RESP_8_Byte6 0;
BA_ "UserSigValidity" SG_ 3221225472 CCP_ECS_RESP_8_Byte6 0;
BA_ "GenSigSendType" SG_ 3221225472 CCP_ECS_RESP_8_Byte6 2;
BA_ "UsrSigPurpose" SG_ 3221225472 CCP_ECS_RESP_8_Byte6 6;
BA_ "Version" SG_ 3221225472 CCP_ECS_RESP_8_Byte7 "19.03.06";
BA_ "NetworkRequestHoldingTime" SG_ 3221225472 CCP_ECS_RESP_8_Byte7 5000;
BA_ "NetworkRequest" SG_ 3221225472 CCP_ECS_RESP_8_Byte7 0;
BA_ "UserSigValidity" SG_ 3221225472 CCP_ECS_RESP_8_Byte7 0;
BA_ "GenSigSendType" SG_ 3221225472 CCP_ECS_RESP_8_Byte7 2;
BA_ "UsrSigPurpose" SG_ 3221225472 CCP_ECS_RESP_8_Byte7 6;
BA_ "Version" SG_ 3221225472 CCP_ECS_RESP_8_Byte1 "19.03.06";
BA_ "NetworkRequestHoldingTime" SG_ 3221225472 CCP_ECS_RESP_8_Byte1 5000;
BA_ "NetworkRequest" SG_ 3221225472 CCP_ECS_RESP_8_Byte1 0;
BA_ "UserSigValidity" SG_ 3221225472 CCP_ECS_RESP_8_Byte1 0;
BA_ "GenSigSendType" SG_ 3221225472 CCP_ECS_RESP_8_Byte1 2;
BA_ "UsrSigPurpose" SG_ 3221225472 CCP_ECS_RESP_8_Byte1 6;
BA_ "Version" SG_ 3221225472 MCU_Crc1Val "18.11.08";
BA_ "RoutingFactor" SG_ 3221225472 MCU_Crc1Val 5;
BA_ "UserSigValidity" SG_ 3221225472 MCU_Crc1Val 7;
BA_ "GenSigStartValue" SG_ 3221225472 MCU_Crc1Val 65535;
BA_ "Description" SG_ 3221225472 MCU_Crc1Val "The data area for CRC calculation is based on the data length (DLC) of the message DB.

The CRC shall be calculated over the entire data block (excluding the CRC bytes) including the user data, alive counter and Data ID

 

- CRC Polynomial (0x1021) , In";
BA_ "Version" SG_ 3221225472 MCU_Mg1TempVal "19.04.04";
BA_ "RoutingFactor" SG_ 3221225472 MCU_Mg1TempVal 5;
BA_ "UserSigValidity" SG_ 3221225472 MCU_Mg1TempVal 7;
BA_ "Description" SG_ 3221225472 MCU_Mg1TempVal "HEV : MG1 - Motor, HSCAN -  CR_Mcu_MotTemp_C

EV : MG1 - Main Axle, HSCAN - CR_Mcu_Mg1Temp_C";
BA_ "Version" SG_ 3221225472 MCU_Mg1IgbtJnctnTempVal "19.04.04";
BA_ "RoutingFactor" SG_ 3221225472 MCU_Mg1IgbtJnctnTempVal 5;
BA_ "UserSigValidity" SG_ 3221225472 MCU_Mg1IgbtJnctnTempVal 7;
BA_ "Description" SG_ 3221225472 MCU_Mg1IgbtJnctnTempVal "HEV : MG1 - Motor, HSCAN -  CR_Mcu_IgbtTemp_C

EV : MG1 - Main Axle, HSCAN - CR_Mcu_Mg1IgbtTemp_C";
BA_ "Version" SG_ 3221225472 MCU_Mg1HtsnkTempVal "19.04.04";
BA_ "RoutingFactor" SG_ 3221225472 MCU_Mg1HtsnkTempVal 5;
BA_ "UserSigValidity" SG_ 3221225472 MCU_Mg1HtsnkTempVal 7;
BA_ "Description" SG_ 3221225472 MCU_Mg1HtsnkTempVal "HEV : MG1 - Motor, HSCAN -  CR_Mcu_HeatsinkTemp_C

EV : MG1 - Main Axle, HSCAN - CR_Mcu_HeatSinkTemp_C";
BA_ "Version" SG_ 3221225472 MCU_Mg1InvtInVoltVal "19.04.04";
BA_ "RoutingFactor" SG_ 3221225472 MCU_Mg1InvtInVoltVal 5;
BA_ "UserSigValidity" SG_ 3221225472 MCU_Mg1InvtInVoltVal 7;
BA_ "Description" SG_ 3221225472 MCU_Mg1InvtInVoltVal "HEV : MG1 - Motor, HSCAN -  CR_Mcu_InvIptVol_V

EV : MG1 - Main Axle, HSCAN - CR_Mcu_IptVol_V";
BA_ "Version" SG_ 3221225472 MCU_AlvCnt1Val "18.11.08";
BA_ "RoutingFactor" SG_ 3221225472 MCU_AlvCnt1Val 5;
BA_ "UserSigValidity" SG_ 3221225472 MCU_AlvCnt1Val 7;
BA_ "Description" SG_ 3221225472 MCU_AlvCnt1Val "For the first transmission request for a data element the counter shall be initialized with 0 and shall be incremented by 1 for every subsequent send request. 

When the counter reaches the maximum value(0xFF), then it shall restart with 0 for the next s";
BA_ "Version" SG_ 3221225472 MCU_Mg1MainRlyCutOffReq "19.04.04";
BA_ "RoutingFactor" SG_ 3221225472 MCU_Mg1MainRlyCutOffReq 5;
BA_ "UserSigValidity" SG_ 3221225472 MCU_Mg1MainRlyCutOffReq 7;
BA_ "Description" SG_ 3221225472 MCU_Mg1MainRlyCutOffReq "HEV : MG1 - Motor, HSCAN -  CF_Mcu_RelayOffReq

EV : MG1 - Main Axle, HSCAN - CF_Mcu_Mg1RlyOffReq";
BA_ "Version" SG_ 3221225472 MCU_Mg1MainRlyCutOffDelayReq "19.04.04";
BA_ "RoutingFactor" SG_ 3221225472 MCU_Mg1MainRlyCutOffDelayReq 5;
BA_ "UserSigValidity" SG_ 3221225472 MCU_Mg1MainRlyCutOffDelayReq 7;
BA_ "Description" SG_ 3221225472 MCU_Mg1MainRlyCutOffDelayReq "HEV : MG1 - Motor, HSCAN -  CF_Mcu_RlyOffReqDelayed

EV : X";
BA_ "Version" SG_ 3221225472 MCU_Mg1PwmOnSta "19.04.04";
BA_ "RoutingFactor" SG_ 3221225472 MCU_Mg1PwmOnSta 5;
BA_ "UserSigValidity" SG_ 3221225472 MCU_Mg1PwmOnSta 7;
BA_ "Description" SG_ 3221225472 MCU_Mg1PwmOnSta "HEV : MG1 - Motor, HSCAN -  CF_Mcu_MotPwmOn

EV : MG1 - Main Axle, HSCAN - CF_Mcu_MotPwmOn";
BA_ "Version" SG_ 3221225472 MCU_Mg1HiVoltIntlkReq "19.04.04";
BA_ "RoutingFactor" SG_ 3221225472 MCU_Mg1HiVoltIntlkReq 5;
BA_ "UserSigValidity" SG_ 3221225472 MCU_Mg1HiVoltIntlkReq 7;
BA_ "Description" SG_ 3221225472 MCU_Mg1HiVoltIntlkReq "HEV : MG1 - Motor, HSCAN -  CF_Mcu_HvIntlockReq

EV : MG1 - Main Axle, HSCAN - CF_Mcu_HvIntlockReq";
BA_ "Version" SG_ 3221225472 MCU_Mg1MilOnReq "19.04.04";
BA_ "RoutingFactor" SG_ 3221225472 MCU_Mg1MilOnReq 5;
BA_ "UserSigValidity" SG_ 3221225472 MCU_Mg1MilOnReq 7;
BA_ "Description" SG_ 3221225472 MCU_Mg1MilOnReq "HEV : MG1 - Motor, HSCAN -  CF_Mcu_MILReq

EV : X";
BA_ "Version" SG_ 3221225472 MCU_Mg1SrvLmpOnReq "19.04.04";
BA_ "RoutingFactor" SG_ 3221225472 MCU_Mg1SrvLmpOnReq 5;
BA_ "UserSigValidity" SG_ 3221225472 MCU_Mg1SrvLmpOnReq 7;
BA_ "Description" SG_ 3221225472 MCU_Mg1SrvLmpOnReq "HEV : MG1 - Motor, HSCAN -  CF_Mcu_ServiceLamp

EV : MG1 - Main Axle, HSCAN - CF_Mcu_Mg1SvcLmp";
BA_ "Version" SG_ 3221225472 MCU_Mg1AnkJrkActvSta "19.04.04";
BA_ "RoutingFactor" SG_ 3221225472 MCU_Mg1AnkJrkActvSta 5;
BA_ "UserSigValidity" SG_ 3221225472 MCU_Mg1AnkJrkActvSta 7;
BA_ "Description" SG_ 3221225472 MCU_Mg1AnkJrkActvSta "HEV : MG1 - Motor, HSCAN - CF_Mcu_AjActivate

EV : MG1 - Main Axle, HSCAN - CF_Mcu_Mg1AjActivate";
BA_ "Version" SG_ 3221225472 MCU_Mg1ActnTestModSta "19.04.04";
BA_ "RoutingFactor" SG_ 3221225472 MCU_Mg1ActnTestModSta 5;
BA_ "UserSigValidity" SG_ 3221225472 MCU_Mg1ActnTestModSta 7;
BA_ "Description" SG_ 3221225472 MCU_Mg1ActnTestModSta "HEV : MG1 - Motor, HSCAN -  CF_Mcu_ActTest

EV : MG1 - Main Axle, HSCAN - CF_Mcu_Mg1ActTest";
BA_ "Version" SG_ 3221225472 MCU_Mg1PwmRetryStatus "19.04.04";
BA_ "RoutingFactor" SG_ 3221225472 MCU_Mg1PwmRetryStatus 5;
BA_ "UserSigValidity" SG_ 3221225472 MCU_Mg1PwmRetryStatus 7;
BA_ "Description" SG_ 3221225472 MCU_Mg1PwmRetryStatus "Inverter PWM Retry Status Before Fault Confrimed

HEV : MG1 - Motor, HSCAN -  CF_Mcu_MotPwmRetryOn

EV : MG1 - Main Axle, HSCAN - X";
BA_ "Version" SG_ 3221225472 MCU_Mg1TrqCmdStat "19.04.04";
BA_ "RoutingFactor" SG_ 3221225472 MCU_Mg1TrqCmdStat 5;
BA_ "UserSigValidity" SG_ 3221225472 MCU_Mg1TrqCmdStat 7;
BA_ "Description" SG_ 3221225472 MCU_Mg1TrqCmdStat "Motor torque command status that indicates which torque command is currently used.

HEV : MG1 - Motor, HSCAN - CF_Mcu_MotTqCmdStat

EV : MG1 - Main Axle, HSCAN - X";
BA_ "Version" SG_ 3221225472 MCU_Mg1RsvrCalibReq "19.04.04";
BA_ "RoutingFactor" SG_ 3221225472 MCU_Mg1RsvrCalibReq 5;
BA_ "UserSigValidity" SG_ 3221225472 MCU_Mg1RsvrCalibReq 7;
BA_ "Description" SG_ 3221225472 MCU_Mg1RsvrCalibReq "HEV : MG1 - Motor, HSCAN -  CF_Mcu_RsvCalReq

EV : MG1 - Main Axle, HSCAN - CF_Mcu_Mg1RsvCalReq";
BA_ "Version" SG_ 3221225472 MCU_Mg1RsvrCalibProcSta "19.04.04";
BA_ "RoutingFactor" SG_ 3221225472 MCU_Mg1RsvrCalibProcSta 5;
BA_ "UserSigValidity" SG_ 3221225472 MCU_Mg1RsvrCalibProcSta 7;
BA_ "Description" SG_ 3221225472 MCU_Mg1RsvrCalibProcSta "HEV : MG1 - Motor, HSCAN -  CF_Mcu_RsvCalNeeded

EV : MG1 - Main Axle, HSCAN - CF_Mcu_Mg1RsvCalNeeded";
BA_ "Version" SG_ 3221225472 MCU_Mg1RsvrCalibSta "19.04.04";
BA_ "RoutingFactor" SG_ 3221225472 MCU_Mg1RsvrCalibSta 5;
BA_ "UserSigValidity" SG_ 3221225472 MCU_Mg1RsvrCalibSta 7;
BA_ "Description" SG_ 3221225472 MCU_Mg1RsvrCalibSta "HEV : MG1 - Motor, HSCAN -  CF_Mcu_RsvCalStatus

EV : MG1 - Main Axle, HSCAN - CF_Mcu_Mg1RsvCalStat";
BA_ "Version" SG_ 3221225472 MCU_Mg1EstTqVal "19.04.04";
BA_ "RoutingFactor" SG_ 3221225472 MCU_Mg1EstTqVal 5;
BA_ "UserSigValidity" SG_ 3221225472 MCU_Mg1EstTqVal 7;
BA_ "Description" SG_ 3221225472 MCU_Mg1EstTqVal "HEV : MG1 - Motor, HSCAN -  X

EV : MG1 - Main Axle, HSCAN - X";
BA_ "Version" SG_ 3221225472 MCU_Mg1RadPwmDtyReq "19.04.04";
BA_ "RoutingFactor" SG_ 3221225472 MCU_Mg1RadPwmDtyReq 5;
BA_ "UserSigValidity" SG_ 3221225472 MCU_Mg1RadPwmDtyReq 7;
BA_ "Description" SG_ 3221225472 MCU_Mg1RadPwmDtyReq "HEV : MG1 - Motor, HSCAN -  CR_Mcu_RadPwm

EV : MG1 - Main Axle, HSCAN - CR_Mcu_RadFanPwm_Duty";
BA_ "Version" SG_ 3221225472 MCU_Mg1ActlRadFanRotatSpdRpmVal "19.04.04";
BA_ "RoutingFactor" SG_ 3221225472 MCU_Mg1ActlRadFanRotatSpdRpmVal 5;
BA_ "UserSigValidity" SG_ 3221225472 MCU_Mg1ActlRadFanRotatSpdRpmVal 7;
BA_ "Description" SG_ 3221225472 MCU_Mg1ActlRadFanRotatSpdRpmVal "HEV : MG1 - Motor, HSCAN -  X

EV : MG1 - Main Axle, HSCAN - X";
BA_ "Version" SG_ 3221225472 MCU_Mg1EstTqBfrAjVal "19.04.04";
BA_ "RoutingFactor" SG_ 3221225472 MCU_Mg1EstTqBfrAjVal 5;
BA_ "UserSigValidity" SG_ 3221225472 MCU_Mg1EstTqBfrAjVal 7;
BA_ "Description" SG_ 3221225472 MCU_Mg1EstTqBfrAjVal "HEV : MG1 - Motor, HSCAN - X

EV : MG1 - Main Axle, HSCAN - X";
BA_ "Version" SG_ 3221225472 MCU_Mg1TqUppLimMtrngVal "19.04.04";
BA_ "RoutingFactor" SG_ 3221225472 MCU_Mg1TqUppLimMtrngVal 5;
BA_ "UserSigValidity" SG_ 3221225472 MCU_Mg1TqUppLimMtrngVal 7;
BA_ "Description" SG_ 3221225472 MCU_Mg1TqUppLimMtrngVal "HEV : MG1 - Motor, HSCAN -  X

EV : MG1 - Main Axle, HSCAN - X";
BA_ "Version" SG_ 3221225472 MCU_Mg1ActlRotatSpdRpmVal "19.04.04";
BA_ "RoutingFactor" SG_ 3221225472 MCU_Mg1ActlRotatSpdRpmVal 5;
BA_ "UserSigValidity" SG_ 3221225472 MCU_Mg1ActlRotatSpdRpmVal 7;
BA_ "Description" SG_ 3221225472 MCU_Mg1ActlRotatSpdRpmVal "HEV : MG1 - Motor, HSCAN - CR_Mcu_MotActRotSpd_rpm

EV : MG1 - Main Axle, HSCAN- CR_Mcu_MotActRotSpd_rpm";
BA_ "Version" SG_ 3221225472 MCU_Mg1TqUppLimGenVal "19.04.04";
BA_ "RoutingFactor" SG_ 3221225472 MCU_Mg1TqUppLimGenVal 5;
BA_ "UserSigValidity" SG_ 3221225472 MCU_Mg1TqUppLimGenVal 7;
BA_ "Description" SG_ 3221225472 MCU_Mg1TqUppLimGenVal "HEV : MG1 - Motor, HSCAN -  X

EV : MG1 - Main Axle, HSCAN - X";
BA_ "Version" SG_ 3221225472 MCU_Mg1InvtCtrlRdySta "19.04.04";
BA_ "RoutingFactor" SG_ 3221225472 MCU_Mg1InvtCtrlRdySta 5;
BA_ "UserSigValidity" SG_ 3221225472 MCU_Mg1InvtCtrlRdySta 7;
BA_ "Description" SG_ 3221225472 MCU_Mg1InvtCtrlRdySta "HEV : MG1 - Motor, HSCAN -  CF_Mcu_InvRdy

EV : MG1 - Main Axle, HSCAN - CF_Mcu_Mg1Rdy";
BA_ "Version" SG_ 3221225472 MCU_Mg1CtrlablSta "19.04.04";
BA_ "RoutingFactor" SG_ 3221225472 MCU_Mg1CtrlablSta 5;
BA_ "UserSigValidity" SG_ 3221225472 MCU_Mg1CtrlablSta 7;
BA_ "Description" SG_ 3221225472 MCU_Mg1CtrlablSta "HEV : MG1 - Motor, HSCAN -  CF_Mcu_InvCtrable

EV : MG1 - Main Axle, HSCAN - CF_Mcu_Mg1Ctrl";
BA_ "Version" SG_ 3221225472 MCU_Mg1WrngSta "19.04.04";
BA_ "RoutingFactor" SG_ 3221225472 MCU_Mg1WrngSta 5;
BA_ "UserSigValidity" SG_ 3221225472 MCU_Mg1WrngSta 7;
BA_ "Description" SG_ 3221225472 MCU_Mg1WrngSta "HEV : MG1 - Motor, HSCAN -  CF_Mcu_Wrn

EV : MG1 - Main Axle, HSCAN - CF_Mcu_Mg1Wrm";
BA_ "Version" SG_ 3221225472 MCU_Mg1FltSta "19.04.04";
BA_ "RoutingFactor" SG_ 3221225472 MCU_Mg1FltSta 5;
BA_ "UserSigValidity" SG_ 3221225472 MCU_Mg1FltSta 7;
BA_ "Description" SG_ 3221225472 MCU_Mg1FltSta "HEV : MG1 - Motor, HSCAN -  CF_Mcu_Flt

EV : MG1 - Main Axle, HSCAN - CF_Mcu_Mg1Flt";
BA_ "Version" SG_ 3221225472 MCU_Mg1DeratingFctrPcVal "19.04.04";
BA_ "RoutingFactor" SG_ 3221225472 MCU_Mg1DeratingFctrPcVal 5;
BA_ "UserSigValidity" SG_ 3221225472 MCU_Mg1DeratingFctrPcVal 7;
BA_ "Description" SG_ 3221225472 MCU_Mg1DeratingFctrPcVal "HEV : MG1 - Motor, HSCAN -  CR_Mcu_MotDeFact_Pc

EV : MG1 - Main Axle, HSCAN - CR_Mcu_MotDeFact_Pc";
BA_ "Version" SG_ 3221225472 MCU_Mg1InvtTempVal "19.04.04";
BA_ "RoutingFactor" SG_ 3221225472 MCU_Mg1InvtTempVal 5;
BA_ "UserSigValidity" SG_ 3221225472 MCU_Mg1InvtTempVal 7;
BA_ "Description" SG_ 3221225472 MCU_Mg1InvtTempVal "HEV : MG1 - Motor, HSCAN -  CR_Mcu_InvTemp_C

EV : MG1 - Main Axle, HSCAN - CR_Mcu_Mg1InvTemp_C";
BA_ "Version" SG_ 3221225472 CCP_ECS_RESP_3_Byte0 "19.03.06";
BA_ "NetworkRequestHoldingTime" SG_ 3221225472 CCP_ECS_RESP_3_Byte0 5000;
BA_ "NetworkRequest" SG_ 3221225472 CCP_ECS_RESP_3_Byte0 0;
BA_ "UserSigValidity" SG_ 3221225472 CCP_ECS_RESP_3_Byte0 0;
BA_ "GenSigSendType" SG_ 3221225472 CCP_ECS_RESP_3_Byte0 2;
BA_ "UsrSigPurpose" SG_ 3221225472 CCP_ECS_RESP_3_Byte0 6;
BA_ "Version" SG_ 3221225472 CCP_ECS_RESP_3_Byte2 "19.03.06";
BA_ "NetworkRequestHoldingTime" SG_ 3221225472 CCP_ECS_RESP_3_Byte2 5000;
BA_ "NetworkRequest" SG_ 3221225472 CCP_ECS_RESP_3_Byte2 0;
BA_ "UserSigValidity" SG_ 3221225472 CCP_ECS_RESP_3_Byte2 0;
BA_ "GenSigSendType" SG_ 3221225472 CCP_ECS_RESP_3_Byte2 2;
BA_ "UsrSigPurpose" SG_ 3221225472 CCP_ECS_RESP_3_Byte2 6;
BA_ "Version" SG_ 3221225472 CCP_ECS_RESP_3_Byte3 "19.03.06";
BA_ "NetworkRequestHoldingTime" SG_ 3221225472 CCP_ECS_RESP_3_Byte3 5000;
BA_ "NetworkRequest" SG_ 3221225472 CCP_ECS_RESP_3_Byte3 0;
BA_ "UserSigValidity" SG_ 3221225472 CCP_ECS_RESP_3_Byte3 0;
BA_ "GenSigSendType" SG_ 3221225472 CCP_ECS_RESP_3_Byte3 2;
BA_ "UsrSigPurpose" SG_ 3221225472 CCP_ECS_RESP_3_Byte3 6;
BA_ "Version" SG_ 3221225472 CCP_ECS_RESP_3_Byte4 "19.03.06";
BA_ "NetworkRequestHoldingTime" SG_ 3221225472 CCP_ECS_RESP_3_Byte4 5000;
BA_ "NetworkRequest" SG_ 3221225472 CCP_ECS_RESP_3_Byte4 0;
BA_ "UserSigValidity" SG_ 3221225472 CCP_ECS_RESP_3_Byte4 0;
BA_ "GenSigSendType" SG_ 3221225472 CCP_ECS_RESP_3_Byte4 2;
BA_ "UsrSigPurpose" SG_ 3221225472 CCP_ECS_RESP_3_Byte4 6;
BA_ "Version" SG_ 3221225472 CCP_ECS_RESP_3_Byte5 "19.03.06";
BA_ "NetworkRequestHoldingTime" SG_ 3221225472 CCP_ECS_RESP_3_Byte5 5000;
BA_ "NetworkRequest" SG_ 3221225472 CCP_ECS_RESP_3_Byte5 0;
BA_ "UserSigValidity" SG_ 3221225472 CCP_ECS_RESP_3_Byte5 0;
BA_ "GenSigSendType" SG_ 3221225472 CCP_ECS_RESP_3_Byte5 2;
BA_ "UsrSigPurpose" SG_ 3221225472 CCP_ECS_RESP_3_Byte5 6;
BA_ "Version" SG_ 3221225472 CCP_ECS_RESP_3_Byte6 "19.03.06";
BA_ "NetworkRequestHoldingTime" SG_ 3221225472 CCP_ECS_RESP_3_Byte6 5000;
BA_ "NetworkRequest" SG_ 3221225472 CCP_ECS_RESP_3_Byte6 0;
BA_ "UserSigValidity" SG_ 3221225472 CCP_ECS_RESP_3_Byte6 0;
BA_ "GenSigSendType" SG_ 3221225472 CCP_ECS_RESP_3_Byte6 2;
BA_ "UsrSigPurpose" SG_ 3221225472 CCP_ECS_RESP_3_Byte6 6;
BA_ "Version" SG_ 3221225472 CCP_ECS_RESP_3_Byte7 "19.03.06";
BA_ "NetworkRequestHoldingTime" SG_ 3221225472 CCP_ECS_RESP_3_Byte7 5000;
BA_ "NetworkRequest" SG_ 3221225472 CCP_ECS_RESP_3_Byte7 0;
BA_ "UserSigValidity" SG_ 3221225472 CCP_ECS_RESP_3_Byte7 0;
BA_ "GenSigSendType" SG_ 3221225472 CCP_ECS_RESP_3_Byte7 2;
BA_ "UsrSigPurpose" SG_ 3221225472 CCP_ECS_RESP_3_Byte7 6;
BA_ "Version" SG_ 3221225472 CCP_ECS_RESP_3_Byte1 "19.03.06";
BA_ "NetworkRequestHoldingTime" SG_ 3221225472 CCP_ECS_RESP_3_Byte1 5000;
BA_ "NetworkRequest" SG_ 3221225472 CCP_ECS_RESP_3_Byte1 0;
BA_ "UserSigValidity" SG_ 3221225472 CCP_ECS_RESP_3_Byte1 0;
BA_ "GenSigSendType" SG_ 3221225472 CCP_ECS_RESP_3_Byte1 2;
BA_ "UsrSigPurpose" SG_ 3221225472 CCP_ECS_RESP_3_Byte1 6;
BA_ "Version" SG_ 3221225472 CCP_ECS_RESP_2_Byte0 "19.03.06";
BA_ "NetworkRequestHoldingTime" SG_ 3221225472 CCP_ECS_RESP_2_Byte0 5000;
BA_ "NetworkRequest" SG_ 3221225472 CCP_ECS_RESP_2_Byte0 0;
BA_ "UserSigValidity" SG_ 3221225472 CCP_ECS_RESP_2_Byte0 0;
BA_ "GenSigSendType" SG_ 3221225472 CCP_ECS_RESP_2_Byte0 2;
BA_ "UsrSigPurpose" SG_ 3221225472 CCP_ECS_RESP_2_Byte0 6;
BA_ "Version" SG_ 3221225472 CCP_ECS_RESP_2_Byte2 "19.03.06";
BA_ "NetworkRequestHoldingTime" SG_ 3221225472 CCP_ECS_RESP_2_Byte2 5000;
BA_ "NetworkRequest" SG_ 3221225472 CCP_ECS_RESP_2_Byte2 0;
BA_ "UserSigValidity" SG_ 3221225472 CCP_ECS_RESP_2_Byte2 0;
BA_ "GenSigSendType" SG_ 3221225472 CCP_ECS_RESP_2_Byte2 2;
BA_ "UsrSigPurpose" SG_ 3221225472 CCP_ECS_RESP_2_Byte2 6;
BA_ "Version" SG_ 3221225472 CCP_ECS_RESP_2_Byte3 "19.03.06";
BA_ "NetworkRequestHoldingTime" SG_ 3221225472 CCP_ECS_RESP_2_Byte3 5000;
BA_ "NetworkRequest" SG_ 3221225472 CCP_ECS_RESP_2_Byte3 0;
BA_ "UserSigValidity" SG_ 3221225472 CCP_ECS_RESP_2_Byte3 0;
BA_ "GenSigSendType" SG_ 3221225472 CCP_ECS_RESP_2_Byte3 2;
BA_ "UsrSigPurpose" SG_ 3221225472 CCP_ECS_RESP_2_Byte3 6;
BA_ "Version" SG_ 3221225472 CCP_ECS_RESP_2_Byte4 "19.03.06";
BA_ "NetworkRequestHoldingTime" SG_ 3221225472 CCP_ECS_RESP_2_Byte4 5000;
BA_ "NetworkRequest" SG_ 3221225472 CCP_ECS_RESP_2_Byte4 0;
BA_ "UserSigValidity" SG_ 3221225472 CCP_ECS_RESP_2_Byte4 0;
BA_ "GenSigSendType" SG_ 3221225472 CCP_ECS_RESP_2_Byte4 2;
BA_ "UsrSigPurpose" SG_ 3221225472 CCP_ECS_RESP_2_Byte4 6;
BA_ "Version" SG_ 3221225472 CCP_ECS_RESP_2_Byte5 "19.03.06";
BA_ "NetworkRequestHoldingTime" SG_ 3221225472 CCP_ECS_RESP_2_Byte5 5000;
BA_ "NetworkRequest" SG_ 3221225472 CCP_ECS_RESP_2_Byte5 0;
BA_ "UserSigValidity" SG_ 3221225472 CCP_ECS_RESP_2_Byte5 0;
BA_ "GenSigSendType" SG_ 3221225472 CCP_ECS_RESP_2_Byte5 2;
BA_ "UsrSigPurpose" SG_ 3221225472 CCP_ECS_RESP_2_Byte5 6;
BA_ "Version" SG_ 3221225472 CCP_ECS_RESP_2_Byte6 "19.03.06";
BA_ "NetworkRequestHoldingTime" SG_ 3221225472 CCP_ECS_RESP_2_Byte6 5000;
BA_ "NetworkRequest" SG_ 3221225472 CCP_ECS_RESP_2_Byte6 0;
BA_ "UserSigValidity" SG_ 3221225472 CCP_ECS_RESP_2_Byte6 0;
BA_ "GenSigSendType" SG_ 3221225472 CCP_ECS_RESP_2_Byte6 2;
BA_ "UsrSigPurpose" SG_ 3221225472 CCP_ECS_RESP_2_Byte6 6;
BA_ "Version" SG_ 3221225472 CCP_ECS_RESP_2_Byte7 "19.03.06";
BA_ "NetworkRequestHoldingTime" SG_ 3221225472 CCP_ECS_RESP_2_Byte7 5000;
BA_ "NetworkRequest" SG_ 3221225472 CCP_ECS_RESP_2_Byte7 0;
BA_ "UserSigValidity" SG_ 3221225472 CCP_ECS_RESP_2_Byte7 0;
BA_ "GenSigSendType" SG_ 3221225472 CCP_ECS_RESP_2_Byte7 2;
BA_ "UsrSigPurpose" SG_ 3221225472 CCP_ECS_RESP_2_Byte7 6;
BA_ "Version" SG_ 3221225472 CCP_ECS_RESP_2_Byte1 "19.03.06";
BA_ "NetworkRequestHoldingTime" SG_ 3221225472 CCP_ECS_RESP_2_Byte1 5000;
BA_ "NetworkRequest" SG_ 3221225472 CCP_ECS_RESP_2_Byte1 0;
BA_ "UserSigValidity" SG_ 3221225472 CCP_ECS_RESP_2_Byte1 0;
BA_ "GenSigSendType" SG_ 3221225472 CCP_ECS_RESP_2_Byte1 2;
BA_ "UsrSigPurpose" SG_ 3221225472 CCP_ECS_RESP_2_Byte1 6;
BA_ "Version" SG_ 3221225472 CCP_ECS_RESP_1_Byte0 "19.03.06";
BA_ "NetworkRequestHoldingTime" SG_ 3221225472 CCP_ECS_RESP_1_Byte0 5000;
BA_ "NetworkRequest" SG_ 3221225472 CCP_ECS_RESP_1_Byte0 0;
BA_ "UserSigValidity" SG_ 3221225472 CCP_ECS_RESP_1_Byte0 0;
BA_ "GenSigSendType" SG_ 3221225472 CCP_ECS_RESP_1_Byte0 2;
BA_ "UsrSigPurpose" SG_ 3221225472 CCP_ECS_RESP_1_Byte0 6;
BA_ "Version" SG_ 3221225472 CCP_ECS_RESP_1_Byte2 "19.03.06";
BA_ "NetworkRequestHoldingTime" SG_ 3221225472 CCP_ECS_RESP_1_Byte2 5000;
BA_ "NetworkRequest" SG_ 3221225472 CCP_ECS_RESP_1_Byte2 0;
BA_ "UserSigValidity" SG_ 3221225472 CCP_ECS_RESP_1_Byte2 0;
BA_ "GenSigSendType" SG_ 3221225472 CCP_ECS_RESP_1_Byte2 2;
BA_ "UsrSigPurpose" SG_ 3221225472 CCP_ECS_RESP_1_Byte2 6;
BA_ "Version" SG_ 3221225472 CCP_ECS_RESP_1_Byte3 "19.03.06";
BA_ "NetworkRequestHoldingTime" SG_ 3221225472 CCP_ECS_RESP_1_Byte3 5000;
BA_ "NetworkRequest" SG_ 3221225472 CCP_ECS_RESP_1_Byte3 0;
BA_ "UserSigValidity" SG_ 3221225472 CCP_ECS_RESP_1_Byte3 0;
BA_ "GenSigSendType" SG_ 3221225472 CCP_ECS_RESP_1_Byte3 2;
BA_ "UsrSigPurpose" SG_ 3221225472 CCP_ECS_RESP_1_Byte3 6;
BA_ "Version" SG_ 3221225472 CCP_ECS_RESP_1_Byte4 "19.03.06";
BA_ "NetworkRequestHoldingTime" SG_ 3221225472 CCP_ECS_RESP_1_Byte4 5000;
BA_ "NetworkRequest" SG_ 3221225472 CCP_ECS_RESP_1_Byte4 0;
BA_ "UserSigValidity" SG_ 3221225472 CCP_ECS_RESP_1_Byte4 0;
BA_ "GenSigSendType" SG_ 3221225472 CCP_ECS_RESP_1_Byte4 2;
BA_ "UsrSigPurpose" SG_ 3221225472 CCP_ECS_RESP_1_Byte4 6;
BA_ "Version" SG_ 3221225472 CCP_ECS_RESP_1_Byte5 "19.03.06";
BA_ "NetworkRequestHoldingTime" SG_ 3221225472 CCP_ECS_RESP_1_Byte5 5000;
BA_ "NetworkRequest" SG_ 3221225472 CCP_ECS_RESP_1_Byte5 0;
BA_ "UserSigValidity" SG_ 3221225472 CCP_ECS_RESP_1_Byte5 0;
BA_ "GenSigSendType" SG_ 3221225472 CCP_ECS_RESP_1_Byte5 2;
BA_ "UsrSigPurpose" SG_ 3221225472 CCP_ECS_RESP_1_Byte5 6;
BA_ "Version" SG_ 3221225472 CCP_ECS_RESP_1_Byte6 "19.03.06";
BA_ "NetworkRequestHoldingTime" SG_ 3221225472 CCP_ECS_RESP_1_Byte6 5000;
BA_ "NetworkRequest" SG_ 3221225472 CCP_ECS_RESP_1_Byte6 0;
BA_ "UserSigValidity" SG_ 3221225472 CCP_ECS_RESP_1_Byte6 0;
BA_ "GenSigSendType" SG_ 3221225472 CCP_ECS_RESP_1_Byte6 2;
BA_ "UsrSigPurpose" SG_ 3221225472 CCP_ECS_RESP_1_Byte6 6;
BA_ "Version" SG_ 3221225472 CCP_ECS_RESP_1_Byte7 "19.03.06";
BA_ "NetworkRequestHoldingTime" SG_ 3221225472 CCP_ECS_RESP_1_Byte7 5000;
BA_ "NetworkRequest" SG_ 3221225472 CCP_ECS_RESP_1_Byte7 0;
BA_ "UserSigValidity" SG_ 3221225472 CCP_ECS_RESP_1_Byte7 0;
BA_ "GenSigSendType" SG_ 3221225472 CCP_ECS_RESP_1_Byte7 2;
BA_ "UsrSigPurpose" SG_ 3221225472 CCP_ECS_RESP_1_Byte7 6;
BA_ "Version" SG_ 3221225472 CCP_ECS_RESP_1_Byte1 "19.03.06";
BA_ "NetworkRequestHoldingTime" SG_ 3221225472 CCP_ECS_RESP_1_Byte1 5000;
BA_ "NetworkRequest" SG_ 3221225472 CCP_ECS_RESP_1_Byte1 0;
BA_ "UserSigValidity" SG_ 3221225472 CCP_ECS_RESP_1_Byte1 0;
BA_ "GenSigSendType" SG_ 3221225472 CCP_ECS_RESP_1_Byte1 2;
BA_ "UsrSigPurpose" SG_ 3221225472 CCP_ECS_RESP_1_Byte1 6;
BA_ "Version" SG_ 3221225472 CCP_ECS_REQ1_Byte0 "18.08.01";
BA_ "NetworkRequestHoldingTime" SG_ 3221225472 CCP_ECS_REQ1_Byte0 5000;
BA_ "NetworkRequest" SG_ 3221225472 CCP_ECS_REQ1_Byte0 0;
BA_ "UserSigValidity" SG_ 3221225472 CCP_ECS_REQ1_Byte0 0;
BA_ "GenSigSendType" SG_ 3221225472 CCP_ECS_REQ1_Byte0 2;
BA_ "UsrSigPurpose" SG_ 3221225472 CCP_ECS_REQ1_Byte0 6;
BA_ "Version" SG_ 3221225472 CCP_ECS_REQ1_Byte2 "18.08.01";
BA_ "NetworkRequestHoldingTime" SG_ 3221225472 CCP_ECS_REQ1_Byte2 5000;
BA_ "NetworkRequest" SG_ 3221225472 CCP_ECS_REQ1_Byte2 0;
BA_ "UserSigValidity" SG_ 3221225472 CCP_ECS_REQ1_Byte2 0;
BA_ "GenSigSendType" SG_ 3221225472 CCP_ECS_REQ1_Byte2 2;
BA_ "UsrSigPurpose" SG_ 3221225472 CCP_ECS_REQ1_Byte2 6;
BA_ "Version" SG_ 3221225472 CCP_ECS_REQ1_Byte3 "18.08.01";
BA_ "NetworkRequestHoldingTime" SG_ 3221225472 CCP_ECS_REQ1_Byte3 5000;
BA_ "NetworkRequest" SG_ 3221225472 CCP_ECS_REQ1_Byte3 0;
BA_ "UserSigValidity" SG_ 3221225472 CCP_ECS_REQ1_Byte3 0;
BA_ "GenSigSendType" SG_ 3221225472 CCP_ECS_REQ1_Byte3 2;
BA_ "UsrSigPurpose" SG_ 3221225472 CCP_ECS_REQ1_Byte3 6;
BA_ "Version" SG_ 3221225472 CCP_ECS_REQ1_Byte4 "18.08.01";
BA_ "NetworkRequestHoldingTime" SG_ 3221225472 CCP_ECS_REQ1_Byte4 5000;
BA_ "NetworkRequest" SG_ 3221225472 CCP_ECS_REQ1_Byte4 0;
BA_ "UserSigValidity" SG_ 3221225472 CCP_ECS_REQ1_Byte4 0;
BA_ "GenSigSendType" SG_ 3221225472 CCP_ECS_REQ1_Byte4 2;
BA_ "UsrSigPurpose" SG_ 3221225472 CCP_ECS_REQ1_Byte4 6;
BA_ "Version" SG_ 3221225472 CCP_ECS_REQ1_Byte5 "18.08.01";
BA_ "NetworkRequestHoldingTime" SG_ 3221225472 CCP_ECS_REQ1_Byte5 5000;
BA_ "NetworkRequest" SG_ 3221225472 CCP_ECS_REQ1_Byte5 0;
BA_ "UserSigValidity" SG_ 3221225472 CCP_ECS_REQ1_Byte5 0;
BA_ "GenSigSendType" SG_ 3221225472 CCP_ECS_REQ1_Byte5 2;
BA_ "UsrSigPurpose" SG_ 3221225472 CCP_ECS_REQ1_Byte5 6;
BA_ "Version" SG_ 3221225472 CCP_ECS_REQ1_Byte6 "18.08.01";
BA_ "NetworkRequestHoldingTime" SG_ 3221225472 CCP_ECS_REQ1_Byte6 5000;
BA_ "NetworkRequest" SG_ 3221225472 CCP_ECS_REQ1_Byte6 0;
BA_ "UserSigValidity" SG_ 3221225472 CCP_ECS_REQ1_Byte6 0;
BA_ "GenSigSendType" SG_ 3221225472 CCP_ECS_REQ1_Byte6 2;
BA_ "UsrSigPurpose" SG_ 3221225472 CCP_ECS_REQ1_Byte6 6;
BA_ "Version" SG_ 3221225472 CCP_ECS_REQ1_Byte7 "18.08.01";
BA_ "NetworkRequestHoldingTime" SG_ 3221225472 CCP_ECS_REQ1_Byte7 5000;
BA_ "NetworkRequest" SG_ 3221225472 CCP_ECS_REQ1_Byte7 0;
BA_ "UserSigValidity" SG_ 3221225472 CCP_ECS_REQ1_Byte7 0;
BA_ "GenSigSendType" SG_ 3221225472 CCP_ECS_REQ1_Byte7 2;
BA_ "UsrSigPurpose" SG_ 3221225472 CCP_ECS_REQ1_Byte7 6;
BA_ "Version" SG_ 3221225472 CCP_ECS_REQ1_Byte1 "18.08.01";
BA_ "NetworkRequestHoldingTime" SG_ 3221225472 CCP_ECS_REQ1_Byte1 5000;
BA_ "NetworkRequest" SG_ 3221225472 CCP_ECS_REQ1_Byte1 0;
BA_ "UserSigValidity" SG_ 3221225472 CCP_ECS_REQ1_Byte1 0;
BA_ "GenSigSendType" SG_ 3221225472 CCP_ECS_REQ1_Byte1 2;
BA_ "UsrSigPurpose" SG_ 3221225472 CCP_ECS_REQ1_Byte1 6;
BA_ "Version" SG_ 3221225472 CCP_ECS_RESP_7_Byte0 "19.03.06";
BA_ "NetworkRequestHoldingTime" SG_ 3221225472 CCP_ECS_RESP_7_Byte0 5000;
BA_ "NetworkRequest" SG_ 3221225472 CCP_ECS_RESP_7_Byte0 0;
BA_ "UserSigValidity" SG_ 3221225472 CCP_ECS_RESP_7_Byte0 0;
BA_ "GenSigSendType" SG_ 3221225472 CCP_ECS_RESP_7_Byte0 2;
BA_ "UsrSigPurpose" SG_ 3221225472 CCP_ECS_RESP_7_Byte0 6;
BA_ "Version" SG_ 3221225472 CCP_ECS_RESP_7_Byte2 "19.03.06";
BA_ "NetworkRequestHoldingTime" SG_ 3221225472 CCP_ECS_RESP_7_Byte2 5000;
BA_ "NetworkRequest" SG_ 3221225472 CCP_ECS_RESP_7_Byte2 0;
BA_ "UserSigValidity" SG_ 3221225472 CCP_ECS_RESP_7_Byte2 0;
BA_ "GenSigSendType" SG_ 3221225472 CCP_ECS_RESP_7_Byte2 2;
BA_ "UsrSigPurpose" SG_ 3221225472 CCP_ECS_RESP_7_Byte2 6;
BA_ "Version" SG_ 3221225472 CCP_ECS_RESP_7_Byte3 "19.03.06";
BA_ "NetworkRequestHoldingTime" SG_ 3221225472 CCP_ECS_RESP_7_Byte3 5000;
BA_ "NetworkRequest" SG_ 3221225472 CCP_ECS_RESP_7_Byte3 0;
BA_ "UserSigValidity" SG_ 3221225472 CCP_ECS_RESP_7_Byte3 0;
BA_ "GenSigSendType" SG_ 3221225472 CCP_ECS_RESP_7_Byte3 2;
BA_ "UsrSigPurpose" SG_ 3221225472 CCP_ECS_RESP_7_Byte3 6;
BA_ "Version" SG_ 3221225472 CCP_ECS_RESP_7_Byte4 "19.03.06";
BA_ "NetworkRequestHoldingTime" SG_ 3221225472 CCP_ECS_RESP_7_Byte4 5000;
BA_ "NetworkRequest" SG_ 3221225472 CCP_ECS_RESP_7_Byte4 0;
BA_ "UserSigValidity" SG_ 3221225472 CCP_ECS_RESP_7_Byte4 0;
BA_ "GenSigSendType" SG_ 3221225472 CCP_ECS_RESP_7_Byte4 2;
BA_ "UsrSigPurpose" SG_ 3221225472 CCP_ECS_RESP_7_Byte4 6;
BA_ "Version" SG_ 3221225472 CCP_ECS_RESP_7_Byte5 "19.03.06";
BA_ "NetworkRequestHoldingTime" SG_ 3221225472 CCP_ECS_RESP_7_Byte5 5000;
BA_ "NetworkRequest" SG_ 3221225472 CCP_ECS_RESP_7_Byte5 0;
BA_ "UserSigValidity" SG_ 3221225472 CCP_ECS_RESP_7_Byte5 0;
BA_ "GenSigSendType" SG_ 3221225472 CCP_ECS_RESP_7_Byte5 2;
BA_ "UsrSigPurpose" SG_ 3221225472 CCP_ECS_RESP_7_Byte5 6;
BA_ "Version" SG_ 3221225472 CCP_ECS_RESP_7_Byte6 "19.03.06";
BA_ "NetworkRequestHoldingTime" SG_ 3221225472 CCP_ECS_RESP_7_Byte6 5000;
BA_ "NetworkRequest" SG_ 3221225472 CCP_ECS_RESP_7_Byte6 0;
BA_ "UserSigValidity" SG_ 3221225472 CCP_ECS_RESP_7_Byte6 0;
BA_ "GenSigSendType" SG_ 3221225472 CCP_ECS_RESP_7_Byte6 2;
BA_ "UsrSigPurpose" SG_ 3221225472 CCP_ECS_RESP_7_Byte6 6;
BA_ "Version" SG_ 3221225472 CCP_ECS_RESP_7_Byte7 "19.03.06";
BA_ "NetworkRequestHoldingTime" SG_ 3221225472 CCP_ECS_RESP_7_Byte7 5000;
BA_ "NetworkRequest" SG_ 3221225472 CCP_ECS_RESP_7_Byte7 0;
BA_ "UserSigValidity" SG_ 3221225472 CCP_ECS_RESP_7_Byte7 0;
BA_ "GenSigSendType" SG_ 3221225472 CCP_ECS_RESP_7_Byte7 2;
BA_ "UsrSigPurpose" SG_ 3221225472 CCP_ECS_RESP_7_Byte7 6;
BA_ "Version" SG_ 3221225472 CCP_ECS_RESP_7_Byte1 "19.03.06";
BA_ "NetworkRequestHoldingTime" SG_ 3221225472 CCP_ECS_RESP_7_Byte1 5000;
BA_ "NetworkRequest" SG_ 3221225472 CCP_ECS_RESP_7_Byte1 0;
BA_ "UserSigValidity" SG_ 3221225472 CCP_ECS_RESP_7_Byte1 0;
BA_ "GenSigSendType" SG_ 3221225472 CCP_ECS_RESP_7_Byte1 2;
BA_ "UsrSigPurpose" SG_ 3221225472 CCP_ECS_RESP_7_Byte1 6;
BA_ "Version" SG_ 3221225472 CCP_ECS_RESP_6_Byte0 "19.03.06";
BA_ "NetworkRequestHoldingTime" SG_ 3221225472 CCP_ECS_RESP_6_Byte0 5000;
BA_ "NetworkRequest" SG_ 3221225472 CCP_ECS_RESP_6_Byte0 0;
BA_ "UserSigValidity" SG_ 3221225472 CCP_ECS_RESP_6_Byte0 0;
BA_ "GenSigSendType" SG_ 3221225472 CCP_ECS_RESP_6_Byte0 2;
BA_ "UsrSigPurpose" SG_ 3221225472 CCP_ECS_RESP_6_Byte0 6;
BA_ "Version" SG_ 3221225472 CCP_ECS_RESP_6_Byte2 "19.03.06";
BA_ "NetworkRequestHoldingTime" SG_ 3221225472 CCP_ECS_RESP_6_Byte2 5000;
BA_ "NetworkRequest" SG_ 3221225472 CCP_ECS_RESP_6_Byte2 0;
BA_ "UserSigValidity" SG_ 3221225472 CCP_ECS_RESP_6_Byte2 0;
BA_ "GenSigSendType" SG_ 3221225472 CCP_ECS_RESP_6_Byte2 2;
BA_ "UsrSigPurpose" SG_ 3221225472 CCP_ECS_RESP_6_Byte2 6;
BA_ "Version" SG_ 3221225472 CCP_ECS_RESP_6_Byte3 "19.03.06";
BA_ "NetworkRequestHoldingTime" SG_ 3221225472 CCP_ECS_RESP_6_Byte3 5000;
BA_ "NetworkRequest" SG_ 3221225472 CCP_ECS_RESP_6_Byte3 0;
BA_ "UserSigValidity" SG_ 3221225472 CCP_ECS_RESP_6_Byte3 0;
BA_ "GenSigSendType" SG_ 3221225472 CCP_ECS_RESP_6_Byte3 2;
BA_ "UsrSigPurpose" SG_ 3221225472 CCP_ECS_RESP_6_Byte3 6;
BA_ "Version" SG_ 3221225472 CCP_ECS_RESP_6_Byte4 "19.03.06";
BA_ "NetworkRequestHoldingTime" SG_ 3221225472 CCP_ECS_RESP_6_Byte4 5000;
BA_ "NetworkRequest" SG_ 3221225472 CCP_ECS_RESP_6_Byte4 0;
BA_ "UserSigValidity" SG_ 3221225472 CCP_ECS_RESP_6_Byte4 0;
BA_ "GenSigSendType" SG_ 3221225472 CCP_ECS_RESP_6_Byte4 2;
BA_ "UsrSigPurpose" SG_ 3221225472 CCP_ECS_RESP_6_Byte4 6;
BA_ "Version" SG_ 3221225472 CCP_ECS_RESP_6_Byte5 "19.03.06";
BA_ "NetworkRequestHoldingTime" SG_ 3221225472 CCP_ECS_RESP_6_Byte5 5000;
BA_ "NetworkRequest" SG_ 3221225472 CCP_ECS_RESP_6_Byte5 0;
BA_ "UserSigValidity" SG_ 3221225472 CCP_ECS_RESP_6_Byte5 0;
BA_ "GenSigSendType" SG_ 3221225472 CCP_ECS_RESP_6_Byte5 2;
BA_ "UsrSigPurpose" SG_ 3221225472 CCP_ECS_RESP_6_Byte5 6;
BA_ "Version" SG_ 3221225472 CCP_ECS_RESP_6_Byte6 "19.03.06";
BA_ "NetworkRequestHoldingTime" SG_ 3221225472 CCP_ECS_RESP_6_Byte6 5000;
BA_ "NetworkRequest" SG_ 3221225472 CCP_ECS_RESP_6_Byte6 0;
BA_ "UserSigValidity" SG_ 3221225472 CCP_ECS_RESP_6_Byte6 0;
BA_ "GenSigSendType" SG_ 3221225472 CCP_ECS_RESP_6_Byte6 2;
BA_ "UsrSigPurpose" SG_ 3221225472 CCP_ECS_RESP_6_Byte6 6;
BA_ "Version" SG_ 3221225472 CCP_ECS_RESP_6_Byte7 "19.03.06";
BA_ "NetworkRequestHoldingTime" SG_ 3221225472 CCP_ECS_RESP_6_Byte7 5000;
BA_ "NetworkRequest" SG_ 3221225472 CCP_ECS_RESP_6_Byte7 0;
BA_ "UserSigValidity" SG_ 3221225472 CCP_ECS_RESP_6_Byte7 0;
BA_ "GenSigSendType" SG_ 3221225472 CCP_ECS_RESP_6_Byte7 2;
BA_ "UsrSigPurpose" SG_ 3221225472 CCP_ECS_RESP_6_Byte7 6;
BA_ "Version" SG_ 3221225472 CCP_ECS_RESP_6_Byte1 "19.03.06";
BA_ "NetworkRequestHoldingTime" SG_ 3221225472 CCP_ECS_RESP_6_Byte1 5000;
BA_ "NetworkRequest" SG_ 3221225472 CCP_ECS_RESP_6_Byte1 0;
BA_ "UserSigValidity" SG_ 3221225472 CCP_ECS_RESP_6_Byte1 0;
BA_ "GenSigSendType" SG_ 3221225472 CCP_ECS_RESP_6_Byte1 2;
BA_ "UsrSigPurpose" SG_ 3221225472 CCP_ECS_RESP_6_Byte1 6;
BA_ "Version" SG_ 3221225472 CCP_ECS_RESP_5_Byte0 "19.03.06";
BA_ "NetworkRequestHoldingTime" SG_ 3221225472 CCP_ECS_RESP_5_Byte0 5000;
BA_ "NetworkRequest" SG_ 3221225472 CCP_ECS_RESP_5_Byte0 0;
BA_ "UserSigValidity" SG_ 3221225472 CCP_ECS_RESP_5_Byte0 0;
BA_ "GenSigSendType" SG_ 3221225472 CCP_ECS_RESP_5_Byte0 2;
BA_ "UsrSigPurpose" SG_ 3221225472 CCP_ECS_RESP_5_Byte0 6;
BA_ "Version" SG_ 3221225472 CCP_ECS_RESP_5_Byte2 "19.03.06";
BA_ "NetworkRequestHoldingTime" SG_ 3221225472 CCP_ECS_RESP_5_Byte2 5000;
BA_ "NetworkRequest" SG_ 3221225472 CCP_ECS_RESP_5_Byte2 0;
BA_ "UserSigValidity" SG_ 3221225472 CCP_ECS_RESP_5_Byte2 0;
BA_ "GenSigSendType" SG_ 3221225472 CCP_ECS_RESP_5_Byte2 2;
BA_ "UsrSigPurpose" SG_ 3221225472 CCP_ECS_RESP_5_Byte2 6;
BA_ "Version" SG_ 3221225472 CCP_ECS_RESP_5_Byte3 "19.03.06";
BA_ "NetworkRequestHoldingTime" SG_ 3221225472 CCP_ECS_RESP_5_Byte3 5000;
BA_ "NetworkRequest" SG_ 3221225472 CCP_ECS_RESP_5_Byte3 0;
BA_ "UserSigValidity" SG_ 3221225472 CCP_ECS_RESP_5_Byte3 0;
BA_ "GenSigSendType" SG_ 3221225472 CCP_ECS_RESP_5_Byte3 2;
BA_ "UsrSigPurpose" SG_ 3221225472 CCP_ECS_RESP_5_Byte3 6;
BA_ "Version" SG_ 3221225472 CCP_ECS_RESP_5_Byte4 "19.03.06";
BA_ "NetworkRequestHoldingTime" SG_ 3221225472 CCP_ECS_RESP_5_Byte4 5000;
BA_ "NetworkRequest" SG_ 3221225472 CCP_ECS_RESP_5_Byte4 0;
BA_ "UserSigValidity" SG_ 3221225472 CCP_ECS_RESP_5_Byte4 0;
BA_ "GenSigSendType" SG_ 3221225472 CCP_ECS_RESP_5_Byte4 2;
BA_ "UsrSigPurpose" SG_ 3221225472 CCP_ECS_RESP_5_Byte4 6;
BA_ "Version" SG_ 3221225472 CCP_ECS_RESP_5_Byte5 "19.03.06";
BA_ "NetworkRequestHoldingTime" SG_ 3221225472 CCP_ECS_RESP_5_Byte5 5000;
BA_ "NetworkRequest" SG_ 3221225472 CCP_ECS_RESP_5_Byte5 0;
BA_ "UserSigValidity" SG_ 3221225472 CCP_ECS_RESP_5_Byte5 0;
BA_ "GenSigSendType" SG_ 3221225472 CCP_ECS_RESP_5_Byte5 2;
BA_ "UsrSigPurpose" SG_ 3221225472 CCP_ECS_RESP_5_Byte5 6;
BA_ "Version" SG_ 3221225472 CCP_ECS_RESP_5_Byte6 "19.03.06";
BA_ "NetworkRequestHoldingTime" SG_ 3221225472 CCP_ECS_RESP_5_Byte6 5000;
BA_ "NetworkRequest" SG_ 3221225472 CCP_ECS_RESP_5_Byte6 0;
BA_ "UserSigValidity" SG_ 3221225472 CCP_ECS_RESP_5_Byte6 0;
BA_ "GenSigSendType" SG_ 3221225472 CCP_ECS_RESP_5_Byte6 2;
BA_ "UsrSigPurpose" SG_ 3221225472 CCP_ECS_RESP_5_Byte6 6;
BA_ "Version" SG_ 3221225472 CCP_ECS_RESP_5_Byte7 "19.03.06";
BA_ "NetworkRequestHoldingTime" SG_ 3221225472 CCP_ECS_RESP_5_Byte7 5000;
BA_ "NetworkRequest" SG_ 3221225472 CCP_ECS_RESP_5_Byte7 0;
BA_ "UserSigValidity" SG_ 3221225472 CCP_ECS_RESP_5_Byte7 0;
BA_ "GenSigSendType" SG_ 3221225472 CCP_ECS_RESP_5_Byte7 2;
BA_ "UsrSigPurpose" SG_ 3221225472 CCP_ECS_RESP_5_Byte7 6;
BA_ "Version" SG_ 3221225472 CCP_ECS_RESP_5_Byte1 "19.03.06";
BA_ "NetworkRequestHoldingTime" SG_ 3221225472 CCP_ECS_RESP_5_Byte1 5000;
BA_ "NetworkRequest" SG_ 3221225472 CCP_ECS_RESP_5_Byte1 0;
BA_ "UserSigValidity" SG_ 3221225472 CCP_ECS_RESP_5_Byte1 0;
BA_ "GenSigSendType" SG_ 3221225472 CCP_ECS_RESP_5_Byte1 2;
BA_ "UsrSigPurpose" SG_ 3221225472 CCP_ECS_RESP_5_Byte1 6;
BA_ "Version" SG_ 3221225472 CCP_ECS_RESP_4_Byte0 "19.03.06";
BA_ "NetworkRequestHoldingTime" SG_ 3221225472 CCP_ECS_RESP_4_Byte0 5000;
BA_ "NetworkRequest" SG_ 3221225472 CCP_ECS_RESP_4_Byte0 0;
BA_ "UserSigValidity" SG_ 3221225472 CCP_ECS_RESP_4_Byte0 0;
BA_ "GenSigSendType" SG_ 3221225472 CCP_ECS_RESP_4_Byte0 2;
BA_ "UsrSigPurpose" SG_ 3221225472 CCP_ECS_RESP_4_Byte0 6;
BA_ "Version" SG_ 3221225472 CCP_ECS_RESP_4_Byte2 "19.03.06";
BA_ "NetworkRequestHoldingTime" SG_ 3221225472 CCP_ECS_RESP_4_Byte2 5000;
BA_ "NetworkRequest" SG_ 3221225472 CCP_ECS_RESP_4_Byte2 0;
BA_ "UserSigValidity" SG_ 3221225472 CCP_ECS_RESP_4_Byte2 0;
BA_ "GenSigSendType" SG_ 3221225472 CCP_ECS_RESP_4_Byte2 2;
BA_ "UsrSigPurpose" SG_ 3221225472 CCP_ECS_RESP_4_Byte2 6;
BA_ "Version" SG_ 3221225472 CCP_ECS_RESP_4_Byte3 "19.03.06";
BA_ "NetworkRequestHoldingTime" SG_ 3221225472 CCP_ECS_RESP_4_Byte3 5000;
BA_ "NetworkRequest" SG_ 3221225472 CCP_ECS_RESP_4_Byte3 0;
BA_ "UserSigValidity" SG_ 3221225472 CCP_ECS_RESP_4_Byte3 0;
BA_ "GenSigSendType" SG_ 3221225472 CCP_ECS_RESP_4_Byte3 2;
BA_ "UsrSigPurpose" SG_ 3221225472 CCP_ECS_RESP_4_Byte3 6;
BA_ "Version" SG_ 3221225472 CCP_ECS_RESP_4_Byte4 "19.03.06";
BA_ "NetworkRequestHoldingTime" SG_ 3221225472 CCP_ECS_RESP_4_Byte4 5000;
BA_ "NetworkRequest" SG_ 3221225472 CCP_ECS_RESP_4_Byte4 0;
BA_ "UserSigValidity" SG_ 3221225472 CCP_ECS_RESP_4_Byte4 0;
BA_ "GenSigSendType" SG_ 3221225472 CCP_ECS_RESP_4_Byte4 2;
BA_ "UsrSigPurpose" SG_ 3221225472 CCP_ECS_RESP_4_Byte4 6;
BA_ "Version" SG_ 3221225472 CCP_ECS_RESP_4_Byte5 "19.03.06";
BA_ "NetworkRequestHoldingTime" SG_ 3221225472 CCP_ECS_RESP_4_Byte5 5000;
BA_ "NetworkRequest" SG_ 3221225472 CCP_ECS_RESP_4_Byte5 0;
BA_ "UserSigValidity" SG_ 3221225472 CCP_ECS_RESP_4_Byte5 0;
BA_ "GenSigSendType" SG_ 3221225472 CCP_ECS_RESP_4_Byte5 2;
BA_ "UsrSigPurpose" SG_ 3221225472 CCP_ECS_RESP_4_Byte5 6;
BA_ "Version" SG_ 3221225472 CCP_ECS_RESP_4_Byte6 "19.03.06";
BA_ "NetworkRequestHoldingTime" SG_ 3221225472 CCP_ECS_RESP_4_Byte6 5000;
BA_ "NetworkRequest" SG_ 3221225472 CCP_ECS_RESP_4_Byte6 0;
BA_ "UserSigValidity" SG_ 3221225472 CCP_ECS_RESP_4_Byte6 0;
BA_ "GenSigSendType" SG_ 3221225472 CCP_ECS_RESP_4_Byte6 2;
BA_ "UsrSigPurpose" SG_ 3221225472 CCP_ECS_RESP_4_Byte6 6;
BA_ "Version" SG_ 3221225472 CCP_ECS_RESP_4_Byte7 "19.03.06";
BA_ "NetworkRequestHoldingTime" SG_ 3221225472 CCP_ECS_RESP_4_Byte7 5000;
BA_ "NetworkRequest" SG_ 3221225472 CCP_ECS_RESP_4_Byte7 0;
BA_ "UserSigValidity" SG_ 3221225472 CCP_ECS_RESP_4_Byte7 0;
BA_ "GenSigSendType" SG_ 3221225472 CCP_ECS_RESP_4_Byte7 2;
BA_ "UsrSigPurpose" SG_ 3221225472 CCP_ECS_RESP_4_Byte7 6;
BA_ "Version" SG_ 3221225472 CCP_ECS_RESP_4_Byte1 "19.03.06";
BA_ "NetworkRequestHoldingTime" SG_ 3221225472 CCP_ECS_RESP_4_Byte1 5000;
BA_ "NetworkRequest" SG_ 3221225472 CCP_ECS_RESP_4_Byte1 0;
BA_ "UserSigValidity" SG_ 3221225472 CCP_ECS_RESP_4_Byte1 0;
BA_ "GenSigSendType" SG_ 3221225472 CCP_ECS_RESP_4_Byte1 2;
BA_ "UsrSigPurpose" SG_ 3221225472 CCP_ECS_RESP_4_Byte1 6;
BA_ "Version" SG_ 3221225472 ICSC_Crc2Val "18.11.08";
BA_ "RoutingFactor" SG_ 3221225472 ICSC_Crc2Val 2;
BA_ "UserSigValidity" SG_ 3221225472 ICSC_Crc2Val 3;
BA_ "GenSigStartValue" SG_ 3221225472 ICSC_Crc2Val 65535;
BA_ "Description" SG_ 3221225472 ICSC_Crc2Val "The data area for CRC calculation is based on the data length (DLC) of the message DB.

The CRC shall be calculated over the entire data block (excluding the CRC bytes) including the user data, alive counter and Data ID

 

- CRC Polynomial (0x1021) , In";
BA_ "Version" SG_ 3221225472 DMIC_IndBrkModSta "18.08.05";
BA_ "RoutingFactor" SG_ 3221225472 DMIC_IndBrkModSta 2;
BA_ "UserSigValidity" SG_ 3221225472 DMIC_IndBrkModSta 3;
BA_ "Description" SG_ 3221225472 DMIC_IndBrkModSta "This signal is for feedback about individual mode setting on AVN.";
BA_ "Version" SG_ 3221225472 DMIC_DrvModTyp "17.12.00";
BA_ "RoutingFactor" SG_ 3221225472 DMIC_DrvModTyp 2;
BA_ "UserSigValidity" SG_ 3221225472 DMIC_DrvModTyp 3;
BA_ "Description" SG_ 3221225472 DMIC_DrvModTyp "This signal indicates drive mode type.";
BA_ "Version" SG_ 3221225472 DMIC_EngFltSta "17.12.00";
BA_ "RoutingFactor" SG_ 3221225472 DMIC_EngFltSta 2;
BA_ "UserSigValidity" SG_ 3221225472 DMIC_EngFltSta 3;
BA_ "Description" SG_ 3221225472 DMIC_EngFltSta "This signal indicates fault status of individual systems.";
BA_ "Version" SG_ 3221225472 DMIC_MdpsFltSta "17.12.00";
BA_ "RoutingFactor" SG_ 3221225472 DMIC_MdpsFltSta 2;
BA_ "UserSigValidity" SG_ 3221225472 DMIC_MdpsFltSta 3;
BA_ "Description" SG_ 3221225472 DMIC_MdpsFltSta "This signal indicates fault status of individual systems.";
BA_ "Version" SG_ 3221225472 DMIC_EcsFltSta "17.12.00";
BA_ "RoutingFactor" SG_ 3221225472 DMIC_EcsFltSta 2;
BA_ "UserSigValidity" SG_ 3221225472 DMIC_EcsFltSta 3;
BA_ "Description" SG_ 3221225472 DMIC_EcsFltSta "This signal indicates fault status of individual systems.";
BA_ "Version" SG_ 3221225472 DMIC_AwdFltSta "17.12.00";
BA_ "RoutingFactor" SG_ 3221225472 DMIC_AwdFltSta 2;
BA_ "UserSigValidity" SG_ 3221225472 DMIC_AwdFltSta 3;
BA_ "Description" SG_ 3221225472 DMIC_AwdFltSta "This signal indicates fault status of individual systems.";
BA_ "Version" SG_ 3221225472 ICSC_AlvCnt2Val "18.11.08";
BA_ "RoutingFactor" SG_ 3221225472 ICSC_AlvCnt2Val 2;
BA_ "UserSigValidity" SG_ 3221225472 ICSC_AlvCnt2Val 3;
BA_ "Description" SG_ 3221225472 ICSC_AlvCnt2Val "For the first transmission request for a data element the counter shall be initialized with 0 and shall be incremented by 1 for every subsequent send request. 

When the counter reaches the maximum value(0xFF), then it shall restart with 0 for the next s";
BA_ "Version" SG_ 3221225472 DMIC_BrkFltSta "18.08.05";
BA_ "RoutingFactor" SG_ 3221225472 DMIC_BrkFltSta 2;
BA_ "UserSigValidity" SG_ 3221225472 DMIC_BrkFltSta 3;
BA_ "Description" SG_ 3221225472 DMIC_BrkFltSta "This signal indicates fault status of individual systems.";
BA_ "Version" SG_ 3221225472 DMIC_DrvModSta "17.12.00";
BA_ "RoutingFactor" SG_ 3221225472 DMIC_DrvModSta 2;
BA_ "UserSigValidity" SG_ 3221225472 DMIC_DrvModSta 3;
BA_ "Description" SG_ 3221225472 DMIC_DrvModSta "This signal is feedback state of driving mode for Cluster/AVN

This message is for DMIC(Driving Mode Integrated Control)";
BA_ "Version" SG_ 3221225472 DMIC_SmtShftModSta "17.12.00";
BA_ "RoutingFactor" SG_ 3221225472 DMIC_SmtShftModSta 2;
BA_ "UserSigValidity" SG_ 3221225472 DMIC_SmtShftModSta 3;
BA_ "Description" SG_ 3221225472 DMIC_SmtShftModSta "This signal is a smart shift mode flag.";
BA_ "Version" SG_ 3221225472 DMIC_EngModSta "17.12.00";
BA_ "RoutingFactor" SG_ 3221225472 DMIC_EngModSta 2;
BA_ "UserSigValidity" SG_ 3221225472 DMIC_EngModSta 3;
BA_ "Description" SG_ 3221225472 DMIC_EngModSta "This Signal is the request on mode transition for Controlling the Driving Mode.";
BA_ "Version" SG_ 3221225472 DMIC_IndEngModSta "17.12.00";
BA_ "RoutingFactor" SG_ 3221225472 DMIC_IndEngModSta 2;
BA_ "UserSigValidity" SG_ 3221225472 DMIC_IndEngModSta 3;
BA_ "Description" SG_ 3221225472 DMIC_IndEngModSta "This signal is for feedback about individual mode setting on AVN.";
BA_ "Version" SG_ 3221225472 DMIC_MdpsModSta "17.12.00";
BA_ "RoutingFactor" SG_ 3221225472 DMIC_MdpsModSta 2;
BA_ "UserSigValidity" SG_ 3221225472 DMIC_MdpsModSta 3;
BA_ "Description" SG_ 3221225472 DMIC_MdpsModSta "This Signal is the request on mode transition for Controlling the Driving Mode.";
BA_ "Version" SG_ 3221225472 DMIC_IndMdpsModSta "17.12.00";
BA_ "RoutingFactor" SG_ 3221225472 DMIC_IndMdpsModSta 2;
BA_ "UserSigValidity" SG_ 3221225472 DMIC_IndMdpsModSta 3;
BA_ "Description" SG_ 3221225472 DMIC_IndMdpsModSta "This signal is for feedback about individual mode setting on AVN.";
BA_ "Version" SG_ 3221225472 DMIC_EcsModSta "17.12.00";
BA_ "RoutingFactor" SG_ 3221225472 DMIC_EcsModSta 2;
BA_ "UserSigValidity" SG_ 3221225472 DMIC_EcsModSta 3;
BA_ "Description" SG_ 3221225472 DMIC_EcsModSta "This Signal is the request on mode transition for Controlling the Driving Mode.";
BA_ "Version" SG_ 3221225472 DMIC_IndEcsModSta "17.12.00";
BA_ "RoutingFactor" SG_ 3221225472 DMIC_IndEcsModSta 2;
BA_ "UserSigValidity" SG_ 3221225472 DMIC_IndEcsModSta 3;
BA_ "Description" SG_ 3221225472 DMIC_IndEcsModSta "This signal is for feedback about individual mode setting on AVN.";
BA_ "Version" SG_ 3221225472 DMIC_AwdModSta "17.12.00";
BA_ "RoutingFactor" SG_ 3221225472 DMIC_AwdModSta 2;
BA_ "UserSigValidity" SG_ 3221225472 DMIC_AwdModSta 3;
BA_ "Description" SG_ 3221225472 DMIC_AwdModSta "This Signal is the request on mode transition for Controlling the Driving Mode.";
BA_ "Version" SG_ 3221225472 DMIC_IndAwdModSta "17.12.00";
BA_ "RoutingFactor" SG_ 3221225472 DMIC_IndAwdModSta 2;
BA_ "UserSigValidity" SG_ 3221225472 DMIC_IndAwdModSta 3;
BA_ "Description" SG_ 3221225472 DMIC_IndAwdModSta "This signal is for feedback about individual mode setting on AVN.";
BA_ "Version" SG_ 3221225472 FR_CMR_Crc5Val "18.11.08";
BA_ "UserSigValidity" SG_ 3221225472 FR_CMR_Crc5Val 3;
BA_ "GenSigSendType" SG_ 3221225472 FR_CMR_Crc5Val 2;
BA_ "Description" SG_ 3221225472 FR_CMR_Crc5Val "The data area for CRC calculation is based on the data length (DLC) of the message DB.

The CRC shall be calculated over the entire data block (excluding the CRC bytes) including the user data, alive counter and Data ID

 

- CRC Polynomial (0x1021) , In";
BA_ "Version" SG_ 3221225472 Info_RdProfSts "17.12.03";
BA_ "UserSigValidity" SG_ 3221225472 Info_RdProfSts 3;
BA_ "GenSigSendType" SG_ 3221225472 Info_RdProfSts 2;
BA_ "Description" SG_ 3221225472 Info_RdProfSts "System status checker";
BA_ "Version" SG_ 3221225472 FR_CMR_AlvCnt5Val "18.11.08";
BA_ "UserSigValidity" SG_ 3221225472 FR_CMR_AlvCnt5Val 3;
BA_ "GenSigSendType" SG_ 3221225472 FR_CMR_AlvCnt5Val 2;
BA_ "Description" SG_ 3221225472 FR_CMR_AlvCnt5Val "For the first transmission request for a data element the counter shall be initialized with 0 and shall be incremented by 1 for every subsequent send request. 

When the counter reaches the maximum value(0xFF), then it shall restart with 0 for the next s";
BA_ "Version" SG_ 3221225472 Info_DistL "17.12.03";
BA_ "UserSigValidity" SG_ 3221225472 Info_DistL 3;
BA_ "GenSigSendType" SG_ 3221225472 Info_DistL 2;
BA_ "Description" SG_ 3221225472 Info_DistL "Distance left to the shape on road surface (Left Side)";
BA_ "Version" SG_ 3221225472 Info_HeightL "17.12.03";
BA_ "UserSigValidity" SG_ 3221225472 Info_HeightL 3;
BA_ "GenSigSendType" SG_ 3221225472 Info_HeightL 2;
BA_ "Description" SG_ 3221225472 Info_HeightL "Height of the shape on road surface (Left Side)";
BA_ "Version" SG_ 3221225472 Info_LengthL "17.12.03";
BA_ "UserSigValidity" SG_ 3221225472 Info_LengthL 3;
BA_ "GenSigSendType" SG_ 3221225472 Info_LengthL 2;
BA_ "Description" SG_ 3221225472 Info_LengthL "Length of the shape on road surface (Left Side)";
BA_ "Version" SG_ 3221225472 Info_TypeL "17.12.03";
BA_ "UserSigValidity" SG_ 3221225472 Info_TypeL 3;
BA_ "GenSigSendType" SG_ 3221225472 Info_TypeL 2;
BA_ "Description" SG_ 3221225472 Info_TypeL "Type of the shape on road surface (Left Side)";
BA_ "Version" SG_ 3221225472 Info_ConfL "17.12.03";
BA_ "UserSigValidity" SG_ 3221225472 Info_ConfL 3;
BA_ "GenSigSendType" SG_ 3221225472 Info_ConfL 2;
BA_ "Description" SG_ 3221225472 Info_ConfL "Reliability of the shape on road surface (Left side)";
BA_ "Version" SG_ 3221225472 Info_CyclicCounterL "17.12.03";
BA_ "UserSigValidity" SG_ 3221225472 Info_CyclicCounterL 3;
BA_ "GenSigSendType" SG_ 3221225472 Info_CyclicCounterL 2;
BA_ "Description" SG_ 3221225472 Info_CyclicCounterL "Check counter for recognition of the shape (Left Side)";
BA_ "Version" SG_ 3221225472 Info_VariL "17.12.03";
BA_ "UserSigValidity" SG_ 3221225472 Info_VariL 3;
BA_ "GenSigSendType" SG_ 3221225472 Info_VariL 2;
BA_ "Description" SG_ 3221225472 Info_VariL "Variance level of the shape information (Left Side)";
BA_ "Version" SG_ 3221225472 Info_DistR "17.12.03";
BA_ "UserSigValidity" SG_ 3221225472 Info_DistR 3;
BA_ "GenSigSendType" SG_ 3221225472 Info_DistR 2;
BA_ "Description" SG_ 3221225472 Info_DistR "Distance left to the shape on road surface (Right Side)";
BA_ "Version" SG_ 3221225472 Info_HeightR "17.12.03";
BA_ "UserSigValidity" SG_ 3221225472 Info_HeightR 3;
BA_ "GenSigSendType" SG_ 3221225472 Info_HeightR 2;
BA_ "Description" SG_ 3221225472 Info_HeightR "Height of the shape on road surface (Right Side)";
BA_ "Version" SG_ 3221225472 Info_LengthR "17.12.03";
BA_ "UserSigValidity" SG_ 3221225472 Info_LengthR 3;
BA_ "GenSigSendType" SG_ 3221225472 Info_LengthR 2;
BA_ "Description" SG_ 3221225472 Info_LengthR "Length of the shape on road surface (Right Side)";
BA_ "Version" SG_ 3221225472 Info_TypeR "17.12.03";
BA_ "UserSigValidity" SG_ 3221225472 Info_TypeR 3;
BA_ "GenSigSendType" SG_ 3221225472 Info_TypeR 2;
BA_ "Description" SG_ 3221225472 Info_TypeR "Type of the shape on road surface (Right Side)";
BA_ "Version" SG_ 3221225472 Info_ConfR "17.12.03";
BA_ "UserSigValidity" SG_ 3221225472 Info_ConfR 3;
BA_ "GenSigSendType" SG_ 3221225472 Info_ConfR 2;
BA_ "Description" SG_ 3221225472 Info_ConfR "Reliability of the shape on road surface (Right Side)";
BA_ "Version" SG_ 3221225472 Info_CyclicCounterR "17.12.03";
BA_ "UserSigValidity" SG_ 3221225472 Info_CyclicCounterR 3;
BA_ "GenSigSendType" SG_ 3221225472 Info_CyclicCounterR 2;
BA_ "Description" SG_ 3221225472 Info_CyclicCounterR "Check counter for recognition of the shape (Right Side)";
BA_ "Version" SG_ 3221225472 Info_VariR "17.12.03";
BA_ "UserSigValidity" SG_ 3221225472 Info_VariR 3;
BA_ "GenSigSendType" SG_ 3221225472 Info_VariR 2;
BA_ "Description" SG_ 3221225472 Info_VariR "Variance level of the shape information (Right Side)";
BA_ "Version" SG_ 3221225472 SAS_GST_Byte0 "18.01.08";
BA_ "NetworkRequestHoldingTime" SG_ 3221225472 SAS_GST_Byte0 5000;
BA_ "NetworkRequest" SG_ 3221225472 SAS_GST_Byte0 0;
BA_ "UserSigValidity" SG_ 3221225472 SAS_GST_Byte0 0;
BA_ "GenSigSendType" SG_ 3221225472 SAS_GST_Byte0 2;
BA_ "UsrSigPurpose" SG_ 3221225472 SAS_GST_Byte0 2;
BA_ "Version" SG_ 3221225472 SAS_GST_Byte2 "18.01.08";
BA_ "NetworkRequestHoldingTime" SG_ 3221225472 SAS_GST_Byte2 5000;
BA_ "NetworkRequest" SG_ 3221225472 SAS_GST_Byte2 0;
BA_ "UserSigValidity" SG_ 3221225472 SAS_GST_Byte2 0;
BA_ "GenSigSendType" SG_ 3221225472 SAS_GST_Byte2 2;
BA_ "UsrSigPurpose" SG_ 3221225472 SAS_GST_Byte2 2;
BA_ "Version" SG_ 3221225472 SAS_GST_Byte3 "18.01.08";
BA_ "NetworkRequestHoldingTime" SG_ 3221225472 SAS_GST_Byte3 5000;
BA_ "NetworkRequest" SG_ 3221225472 SAS_GST_Byte3 0;
BA_ "UserSigValidity" SG_ 3221225472 SAS_GST_Byte3 0;
BA_ "GenSigSendType" SG_ 3221225472 SAS_GST_Byte3 2;
BA_ "UsrSigPurpose" SG_ 3221225472 SAS_GST_Byte3 2;
BA_ "Version" SG_ 3221225472 SAS_GST_Byte4 "18.01.08";
BA_ "NetworkRequestHoldingTime" SG_ 3221225472 SAS_GST_Byte4 5000;
BA_ "NetworkRequest" SG_ 3221225472 SAS_GST_Byte4 0;
BA_ "UserSigValidity" SG_ 3221225472 SAS_GST_Byte4 0;
BA_ "GenSigSendType" SG_ 3221225472 SAS_GST_Byte4 2;
BA_ "UsrSigPurpose" SG_ 3221225472 SAS_GST_Byte4 2;
BA_ "Version" SG_ 3221225472 SAS_GST_Byte5 "18.01.08";
BA_ "NetworkRequestHoldingTime" SG_ 3221225472 SAS_GST_Byte5 5000;
BA_ "NetworkRequest" SG_ 3221225472 SAS_GST_Byte5 0;
BA_ "UserSigValidity" SG_ 3221225472 SAS_GST_Byte5 0;
BA_ "GenSigSendType" SG_ 3221225472 SAS_GST_Byte5 2;
BA_ "UsrSigPurpose" SG_ 3221225472 SAS_GST_Byte5 2;
BA_ "Version" SG_ 3221225472 SAS_GST_Byte6 "18.01.08";
BA_ "NetworkRequestHoldingTime" SG_ 3221225472 SAS_GST_Byte6 5000;
BA_ "NetworkRequest" SG_ 3221225472 SAS_GST_Byte6 0;
BA_ "UserSigValidity" SG_ 3221225472 SAS_GST_Byte6 0;
BA_ "GenSigSendType" SG_ 3221225472 SAS_GST_Byte6 2;
BA_ "UsrSigPurpose" SG_ 3221225472 SAS_GST_Byte6 2;
BA_ "Version" SG_ 3221225472 SAS_GST_Byte7 "18.01.08";
BA_ "NetworkRequestHoldingTime" SG_ 3221225472 SAS_GST_Byte7 5000;
BA_ "NetworkRequest" SG_ 3221225472 SAS_GST_Byte7 0;
BA_ "UserSigValidity" SG_ 3221225472 SAS_GST_Byte7 0;
BA_ "GenSigSendType" SG_ 3221225472 SAS_GST_Byte7 2;
BA_ "UsrSigPurpose" SG_ 3221225472 SAS_GST_Byte7 2;
BA_ "Version" SG_ 3221225472 SAS_GST_Byte1 "18.01.08";
BA_ "NetworkRequestHoldingTime" SG_ 3221225472 SAS_GST_Byte1 5000;
BA_ "NetworkRequest" SG_ 3221225472 SAS_GST_Byte1 0;
BA_ "UserSigValidity" SG_ 3221225472 SAS_GST_Byte1 0;
BA_ "GenSigSendType" SG_ 3221225472 SAS_GST_Byte1 2;
BA_ "UsrSigPurpose" SG_ 3221225472 SAS_GST_Byte1 2;
BA_ "Version" SG_ 3221225472 GCU_Crc2Val "18.11.08";
BA_ "RoutingFactor" SG_ 3221225472 GCU_Crc2Val 5;
BA_ "UserSigValidity" SG_ 3221225472 GCU_Crc2Val 7;
BA_ "GenSigStartValue" SG_ 3221225472 GCU_Crc2Val 65535;
BA_ "Description" SG_ 3221225472 GCU_Crc2Val "The data area for CRC calculation is based on the data length (DLC) of the message DB.

The CRC shall be calculated over the entire data block (excluding the CRC bytes) including the user data, alive counter and Data ID

 

- CRC Polynomial (0x1021) , In";
BA_ "Version" SG_ 3221225472 MCU_Mg2TempVal "19.04.04";
BA_ "RoutingFactor" SG_ 3221225472 MCU_Mg2TempVal 5;
BA_ "UserSigValidity" SG_ 3221225472 MCU_Mg2TempVal 7;
BA_ "Description" SG_ 3221225472 MCU_Mg2TempVal "HEV : MG2 - HSG, HSCAN -  CR_Gcu_HsgTemp_C

EV : MG2 - Sub Axle, HSCAN - X";
BA_ "Version" SG_ 3221225472 MCU_Mg2IgbtJnctnTempVal "19.04.04";
BA_ "RoutingFactor" SG_ 3221225472 MCU_Mg2IgbtJnctnTempVal 5;
BA_ "UserSigValidity" SG_ 3221225472 MCU_Mg2IgbtJnctnTempVal 7;
BA_ "Description" SG_ 3221225472 MCU_Mg2IgbtJnctnTempVal "HEV : MG2 - HSG, HSCAN - CR_Gcu_IgbtTemp_C

EV : MG2 - Sub Axle, HSCAN - X";
BA_ "Version" SG_ 3221225472 MCU_Mg2HtsnkTempVal "19.04.04";
BA_ "RoutingFactor" SG_ 3221225472 MCU_Mg2HtsnkTempVal 5;
BA_ "UserSigValidity" SG_ 3221225472 MCU_Mg2HtsnkTempVal 7;
BA_ "Description" SG_ 3221225472 MCU_Mg2HtsnkTempVal "HEV : MG2 - HSG, HSCAN -  X

EV : MG2 - Sub Axle, HSCAN - X";
BA_ "Version" SG_ 3221225472 MCU_Mg2InvtInVoltVal "19.04.04";
BA_ "RoutingFactor" SG_ 3221225472 MCU_Mg2InvtInVoltVal 5;
BA_ "UserSigValidity" SG_ 3221225472 MCU_Mg2InvtInVoltVal 7;
BA_ "Description" SG_ 3221225472 MCU_Mg2InvtInVoltVal "HEV : MG2 - HSG, HSCAN -  X

EV : MG2 - Sub Axle, HSCAN - X";
BA_ "Version" SG_ 3221225472 GCU_AlvCnt2Val "18.11.08";
BA_ "RoutingFactor" SG_ 3221225472 GCU_AlvCnt2Val 5;
BA_ "UserSigValidity" SG_ 3221225472 GCU_AlvCnt2Val 7;
BA_ "Description" SG_ 3221225472 GCU_AlvCnt2Val "For the first transmission request for a data element the counter shall be initialized with 0 and shall be incremented by 1 for every subsequent send request. 

When the counter reaches the maximum value(0xFF), then it shall restart with 0 for the next s";
BA_ "Version" SG_ 3221225472 MCU_Mg2MainRlyCutOffReq "19.04.04";
BA_ "RoutingFactor" SG_ 3221225472 MCU_Mg2MainRlyCutOffReq 5;
BA_ "UserSigValidity" SG_ 3221225472 MCU_Mg2MainRlyCutOffReq 7;
BA_ "Description" SG_ 3221225472 MCU_Mg2MainRlyCutOffReq "HEV : MG2 - HSG, HSCAN -  CF_Gcu_RelayOffReq

EV : MG2 - Sub Axle, HSCAN - X";
BA_ "Version" SG_ 3221225472 MCU_Mg2MainRlyCutOffDelayReq "19.04.04";
BA_ "RoutingFactor" SG_ 3221225472 MCU_Mg2MainRlyCutOffDelayReq 5;
BA_ "UserSigValidity" SG_ 3221225472 MCU_Mg2MainRlyCutOffDelayReq 7;
BA_ "Description" SG_ 3221225472 MCU_Mg2MainRlyCutOffDelayReq "HEV : MG2 - HSG, HSCAN -  CF_Gcu_RlyOffReqDelayed

EV : MG2 - Sub Axle, HSCAN - X";
BA_ "Version" SG_ 3221225472 MCU_Mg2PwmOnSta "19.04.04";
BA_ "RoutingFactor" SG_ 3221225472 MCU_Mg2PwmOnSta 5;
BA_ "UserSigValidity" SG_ 3221225472 MCU_Mg2PwmOnSta 7;
BA_ "Description" SG_ 3221225472 MCU_Mg2PwmOnSta "HEV : MG2 - HSG, HSCAN -  CF_Gcu_HsgPwmOn

EV : MG2 - Sub Axle, HSCAN - X";
BA_ "Version" SG_ 3221225472 MCU_Mg2HiVoltIntlkReq "19.04.06";
BA_ "RoutingFactor" SG_ 3221225472 MCU_Mg2HiVoltIntlkReq 5;
BA_ "UserSigValidity" SG_ 3221225472 MCU_Mg2HiVoltIntlkReq 7;
BA_ "Description" SG_ 3221225472 MCU_Mg2HiVoltIntlkReq "HEV : MG2 - HSG, HSCAN -  X

EV : MG2 - Sub Axle, HSCAN - X";
BA_ "Version" SG_ 3221225472 MCU_Mg2MilOnReq "19.04.04";
BA_ "RoutingFactor" SG_ 3221225472 MCU_Mg2MilOnReq 5;
BA_ "UserSigValidity" SG_ 3221225472 MCU_Mg2MilOnReq 7;
BA_ "Description" SG_ 3221225472 MCU_Mg2MilOnReq "HEV : MG2 - HSG, HSCAN -  CF_Gcu_MILReq

EV : MG2 - Sub Axle, HSCAN - X";
BA_ "Version" SG_ 3221225472 MCU_Mg2SrvLmpOnReq "19.04.04";
BA_ "RoutingFactor" SG_ 3221225472 MCU_Mg2SrvLmpOnReq 5;
BA_ "UserSigValidity" SG_ 3221225472 MCU_Mg2SrvLmpOnReq 7;
BA_ "Description" SG_ 3221225472 MCU_Mg2SrvLmpOnReq "HEV : MG2 - HSG, HSCAN -  CF_Gcu_ServiceLamp

EV : MG2 - Sub Axle, HSCAN - X";
BA_ "Version" SG_ 3221225472 MCU_Mg2AnkJrkActvSta "19.04.04";
BA_ "RoutingFactor" SG_ 3221225472 MCU_Mg2AnkJrkActvSta 5;
BA_ "UserSigValidity" SG_ 3221225472 MCU_Mg2AnkJrkActvSta 7;
BA_ "Description" SG_ 3221225472 MCU_Mg2AnkJrkActvSta "HEV : MG2 - HSG, HSCAN -  X

EV : MG2 - Sub Axle, HSCAN - X";
BA_ "Version" SG_ 3221225472 MCU_Mg2ActnTestModSta "19.04.04";
BA_ "RoutingFactor" SG_ 3221225472 MCU_Mg2ActnTestModSta 5;
BA_ "UserSigValidity" SG_ 3221225472 MCU_Mg2ActnTestModSta 7;
BA_ "Description" SG_ 3221225472 MCU_Mg2ActnTestModSta "HEV : MG2 - HSG, HSCAN -  CF_Gcu_ActTest

EV : MG2 - Sub Axle, HSCAN - X";
BA_ "Version" SG_ 3221225472 MCU_Mg2PwmRetryStatus "19.04.04";
BA_ "RoutingFactor" SG_ 3221225472 MCU_Mg2PwmRetryStatus 5;
BA_ "UserSigValidity" SG_ 3221225472 MCU_Mg2PwmRetryStatus 7;
BA_ "Description" SG_ 3221225472 MCU_Mg2PwmRetryStatus "Inverter PWM Retry Status Before Fault Confrimed

HEV : MG2 - HSG, HSCAN -  CF_Gcu_HsgPwmRetryOn

EV : MG2 - Sub Axle, HSCAN - X";
BA_ "Version" SG_ 3221225472 MCU_Mg2TrqCmdStat "19.04.04";
BA_ "RoutingFactor" SG_ 3221225472 MCU_Mg2TrqCmdStat 5;
BA_ "UserSigValidity" SG_ 3221225472 MCU_Mg2TrqCmdStat 7;
BA_ "Description" SG_ 3221225472 MCU_Mg2TrqCmdStat "Hsg torque command status that indicates which torque commad is currently used.

HEV : MG2 - HSG, HSCAN -  X

EV : MG2 - Sub Axle, HSCAN - X";
BA_ "Version" SG_ 3221225472 MCU_Mg2RsvrCalibReq "19.04.04";
BA_ "RoutingFactor" SG_ 3221225472 MCU_Mg2RsvrCalibReq 5;
BA_ "UserSigValidity" SG_ 3221225472 MCU_Mg2RsvrCalibReq 7;
BA_ "Description" SG_ 3221225472 MCU_Mg2RsvrCalibReq "HEV : MG2 - HSG, HSCAN -  CF_Gcu_RsvCalReq

EV : MG2 - Sub Axle, HSCAN - X";
BA_ "Version" SG_ 3221225472 MCU_Mg2RsvrCalibProcSta "19.04.04";
BA_ "RoutingFactor" SG_ 3221225472 MCU_Mg2RsvrCalibProcSta 5;
BA_ "UserSigValidity" SG_ 3221225472 MCU_Mg2RsvrCalibProcSta 7;
BA_ "Description" SG_ 3221225472 MCU_Mg2RsvrCalibProcSta "HEV : MG2 - HSG, HSCAN -  CF_Gcu_RsvCalNeeded

EV : MG2 - Sub Axle, HSCAN - X";
BA_ "Version" SG_ 3221225472 MCU_Mg2RsvrCalibSta "19.04.04";
BA_ "RoutingFactor" SG_ 3221225472 MCU_Mg2RsvrCalibSta 5;
BA_ "UserSigValidity" SG_ 3221225472 MCU_Mg2RsvrCalibSta 7;
BA_ "Description" SG_ 3221225472 MCU_Mg2RsvrCalibSta "HEV : MG2 - HSG, HSCAN -  CF_Gcu_RsvCalStatus

EV : MG2 - Sub Axle, HSCAN - X";
BA_ "Version" SG_ 3221225472 MCU_Mg2EstTqVal "19.04.04";
BA_ "RoutingFactor" SG_ 3221225472 MCU_Mg2EstTqVal 5;
BA_ "UserSigValidity" SG_ 3221225472 MCU_Mg2EstTqVal 7;
BA_ "Description" SG_ 3221225472 MCU_Mg2EstTqVal "HEV : MG2 - HSG, HSCAN -  X

EV : MG2 - Sub Axle, HSCAN - X";
BA_ "Version" SG_ 3221225472 MCU_Mg2RadPwmDtyReq "19.04.04";
BA_ "RoutingFactor" SG_ 3221225472 MCU_Mg2RadPwmDtyReq 5;
BA_ "UserSigValidity" SG_ 3221225472 MCU_Mg2RadPwmDtyReq 7;
BA_ "Description" SG_ 3221225472 MCU_Mg2RadPwmDtyReq "HEV : MG2 - HSG, HSCAN -  X

EV : MG2 - Sub Axle, HSCAN - X";
BA_ "Version" SG_ 3221225472 MCU_Mg2EstBfrAjVal "19.04.04";
BA_ "RoutingFactor" SG_ 3221225472 MCU_Mg2EstBfrAjVal 5;
BA_ "UserSigValidity" SG_ 3221225472 MCU_Mg2EstBfrAjVal 7;
BA_ "Description" SG_ 3221225472 MCU_Mg2EstBfrAjVal "HEV : MG2 - HSG, HSCAN -  X

EV : MG2 - Sub Axle, HSCAN - X";
BA_ "Version" SG_ 3221225472 MCU_Mg2TqUppLimMtrngVal "19.04.04";
BA_ "RoutingFactor" SG_ 3221225472 MCU_Mg2TqUppLimMtrngVal 5;
BA_ "UserSigValidity" SG_ 3221225472 MCU_Mg2TqUppLimMtrngVal 7;
BA_ "Description" SG_ 3221225472 MCU_Mg2TqUppLimMtrngVal "HEV : MG2 - HSG, HSCAN -  X

EV : MG2 - Sub Axle, HSCAN - X";
BA_ "Version" SG_ 3221225472 MCU_Mg2ActlRotatSpdRpmVal "19.04.04";
BA_ "RoutingFactor" SG_ 3221225472 MCU_Mg2ActlRotatSpdRpmVal 5;
BA_ "UserSigValidity" SG_ 3221225472 MCU_Mg2ActlRotatSpdRpmVal 7;
BA_ "Description" SG_ 3221225472 MCU_Mg2ActlRotatSpdRpmVal "HEV : MG2 - HSG, HSCAN -  CR_Gcu_HsgActRotSpd_rpm

EV : MG2 - Sub Axle, HSCAN - X";
BA_ "Version" SG_ 3221225472 MCU_Mg2TqUppLimGenVal "19.04.04";
BA_ "RoutingFactor" SG_ 3221225472 MCU_Mg2TqUppLimGenVal 5;
BA_ "UserSigValidity" SG_ 3221225472 MCU_Mg2TqUppLimGenVal 7;
BA_ "Description" SG_ 3221225472 MCU_Mg2TqUppLimGenVal "HEV : MG2 - HSG, HSCAN -  X

EV : MG2 - Sub Axle, HSCAN - X";
BA_ "Version" SG_ 3221225472 MCU_Mg2InvtRdySta "19.04.04";
BA_ "RoutingFactor" SG_ 3221225472 MCU_Mg2InvtRdySta 5;
BA_ "UserSigValidity" SG_ 3221225472 MCU_Mg2InvtRdySta 7;
BA_ "Description" SG_ 3221225472 MCU_Mg2InvtRdySta "HEV : MG2 - HSG, HSCAN -  CF_Gcu_InvRdy

EV : MG2 - Sub Axle, HSCAN - X";
BA_ "Version" SG_ 3221225472 MCU_Mg2CtrlablSta "19.04.04";
BA_ "RoutingFactor" SG_ 3221225472 MCU_Mg2CtrlablSta 5;
BA_ "UserSigValidity" SG_ 3221225472 MCU_Mg2CtrlablSta 7;
BA_ "Description" SG_ 3221225472 MCU_Mg2CtrlablSta "HEV : MG2 - HSG, HSCAN -  CF_Gcu_InvCtrable

EV : MG2 - Sub Axle, HSCAN - X";
BA_ "Version" SG_ 3221225472 MCU_Mg2WrngSta "19.04.04";
BA_ "RoutingFactor" SG_ 3221225472 MCU_Mg2WrngSta 5;
BA_ "UserSigValidity" SG_ 3221225472 MCU_Mg2WrngSta 7;
BA_ "Description" SG_ 3221225472 MCU_Mg2WrngSta "HEV : MG2 - HSG, HSCAN -  CF_Gcu_Wrn

EV : MG2 - Sub Axle, HSCAN - X";
BA_ "Version" SG_ 3221225472 MCU_Mg2FltSta "19.04.04";
BA_ "RoutingFactor" SG_ 3221225472 MCU_Mg2FltSta 5;
BA_ "UserSigValidity" SG_ 3221225472 MCU_Mg2FltSta 7;
BA_ "Description" SG_ 3221225472 MCU_Mg2FltSta "HEV : MG2 - HSG, HSCAN -  CF_Gcu_Flt

EV : MG2 - Sub Axle, HSCAN - X";
BA_ "Version" SG_ 3221225472 MCU_Mg2DeratingFctrPcVal "19.04.04";
BA_ "RoutingFactor" SG_ 3221225472 MCU_Mg2DeratingFctrPcVal 5;
BA_ "UserSigValidity" SG_ 3221225472 MCU_Mg2DeratingFctrPcVal 7;
BA_ "Description" SG_ 3221225472 MCU_Mg2DeratingFctrPcVal "HEV : MG2 - HSG, HSCAN -  CR_Gcu_HsgDeFact_Pc

EV : MG2 - Sub Axle, HSCAN - X";
BA_ "Version" SG_ 3221225472 MCU_Mg2InvtTempVal "19.04.04";
BA_ "RoutingFactor" SG_ 3221225472 MCU_Mg2InvtTempVal 5;
BA_ "UserSigValidity" SG_ 3221225472 MCU_Mg2InvtTempVal 7;
BA_ "Description" SG_ 3221225472 MCU_Mg2InvtTempVal "HEV : MG2 - HSG, HSCAN -  CR_Gcu_InvTemp_C

EV : MG2 - Sub Axle, HSCAN - X";
BA_ "Version" SG_ 3221225472 GST_SAS_Byte0 "18.01.08";
BA_ "NetworkRequestHoldingTime" SG_ 3221225472 GST_SAS_Byte0 5000;
BA_ "NetworkRequest" SG_ 3221225472 GST_SAS_Byte0 0;
BA_ "UserSigValidity" SG_ 3221225472 GST_SAS_Byte0 0;
BA_ "GenSigSendType" SG_ 3221225472 GST_SAS_Byte0 2;
BA_ "UsrSigPurpose" SG_ 3221225472 GST_SAS_Byte0 2;
BA_ "Version" SG_ 3221225472 GST_SAS_Byte2 "18.01.08";
BA_ "NetworkRequestHoldingTime" SG_ 3221225472 GST_SAS_Byte2 5000;
BA_ "NetworkRequest" SG_ 3221225472 GST_SAS_Byte2 0;
BA_ "UserSigValidity" SG_ 3221225472 GST_SAS_Byte2 0;
BA_ "GenSigSendType" SG_ 3221225472 GST_SAS_Byte2 2;
BA_ "UsrSigPurpose" SG_ 3221225472 GST_SAS_Byte2 2;
BA_ "Version" SG_ 3221225472 GST_SAS_Byte3 "18.01.08";
BA_ "NetworkRequestHoldingTime" SG_ 3221225472 GST_SAS_Byte3 5000;
BA_ "NetworkRequest" SG_ 3221225472 GST_SAS_Byte3 0;
BA_ "UserSigValidity" SG_ 3221225472 GST_SAS_Byte3 0;
BA_ "GenSigSendType" SG_ 3221225472 GST_SAS_Byte3 2;
BA_ "UsrSigPurpose" SG_ 3221225472 GST_SAS_Byte3 2;
BA_ "Version" SG_ 3221225472 GST_SAS_Byte4 "18.01.08";
BA_ "NetworkRequestHoldingTime" SG_ 3221225472 GST_SAS_Byte4 5000;
BA_ "NetworkRequest" SG_ 3221225472 GST_SAS_Byte4 0;
BA_ "UserSigValidity" SG_ 3221225472 GST_SAS_Byte4 0;
BA_ "GenSigSendType" SG_ 3221225472 GST_SAS_Byte4 2;
BA_ "UsrSigPurpose" SG_ 3221225472 GST_SAS_Byte4 2;
BA_ "Version" SG_ 3221225472 GST_SAS_Byte5 "18.01.08";
BA_ "NetworkRequestHoldingTime" SG_ 3221225472 GST_SAS_Byte5 5000;
BA_ "NetworkRequest" SG_ 3221225472 GST_SAS_Byte5 0;
BA_ "UserSigValidity" SG_ 3221225472 GST_SAS_Byte5 0;
BA_ "GenSigSendType" SG_ 3221225472 GST_SAS_Byte5 2;
BA_ "UsrSigPurpose" SG_ 3221225472 GST_SAS_Byte5 2;
BA_ "Version" SG_ 3221225472 GST_SAS_Byte6 "18.01.08";
BA_ "NetworkRequestHoldingTime" SG_ 3221225472 GST_SAS_Byte6 5000;
BA_ "NetworkRequest" SG_ 3221225472 GST_SAS_Byte6 0;
BA_ "UserSigValidity" SG_ 3221225472 GST_SAS_Byte6 0;
BA_ "GenSigSendType" SG_ 3221225472 GST_SAS_Byte6 2;
BA_ "UsrSigPurpose" SG_ 3221225472 GST_SAS_Byte6 2;
BA_ "Version" SG_ 3221225472 GST_SAS_Byte7 "18.01.08";
BA_ "NetworkRequestHoldingTime" SG_ 3221225472 GST_SAS_Byte7 5000;
BA_ "NetworkRequest" SG_ 3221225472 GST_SAS_Byte7 0;
BA_ "UserSigValidity" SG_ 3221225472 GST_SAS_Byte7 0;
BA_ "GenSigSendType" SG_ 3221225472 GST_SAS_Byte7 2;
BA_ "UsrSigPurpose" SG_ 3221225472 GST_SAS_Byte7 2;
BA_ "Version" SG_ 3221225472 GST_SAS_Byte1 "18.01.08";
BA_ "NetworkRequestHoldingTime" SG_ 3221225472 GST_SAS_Byte1 5000;
BA_ "NetworkRequest" SG_ 3221225472 GST_SAS_Byte1 0;
BA_ "UserSigValidity" SG_ 3221225472 GST_SAS_Byte1 0;
BA_ "GenSigSendType" SG_ 3221225472 GST_SAS_Byte1 2;
BA_ "UsrSigPurpose" SG_ 3221225472 GST_SAS_Byte1 2;
BA_ "Version" SG_ 3221225472 ADAS_CMD_Crc30Val "18.11.08";
BA_ "RoutingFactor" SG_ 3221225472 ADAS_CMD_Crc30Val 5;
BA_ "UserSigValidity" SG_ 3221225472 ADAS_CMD_Crc30Val 3;
BA_ "GenSigStartValue" SG_ 3221225472 ADAS_CMD_Crc30Val 65535;
BA_ "Description" SG_ 3221225472 ADAS_CMD_Crc30Val "The data area for CRC calculation is based on the data length (DLC) of the message DB.

The CRC shall be calculated over the entire data block (excluding the CRC bytes) including the user data, alive counter and Data ID

 

- CRC Polynomial (0x1021) , In";
BA_ "Version" SG_ 3221225472 FCA_ESA_CtrlSta "18.10.00";
BA_ "RoutingFactor" SG_ 3221225472 FCA_ESA_CtrlSta 5;
BA_ "UserSigValidity" SG_ 3221225472 FCA_ESA_CtrlSta 3;
BA_ "Description" SG_ 3221225472 FCA_ESA_CtrlSta "FCA w/ ESA Control Status for ECS Control";
BA_ "Version" SG_ 3221225472 ADAS_Damping_Gain "18.12.01";
BA_ "RoutingFactor" SG_ 3221225472 ADAS_Damping_Gain 5;
BA_ "UserSigValidity" SG_ 3221225472 ADAS_Damping_Gain 3;
BA_ "GenSigStartValue" SG_ 3221225472 ADAS_Damping_Gain 100;
BA_ "Description" SG_ 3221225472 ADAS_Damping_Gain "ADAS Damping Gain for MDPS";
BA_ "Version" SG_ 3221225472 ADAS_CMD_AlvCnt30Val "18.11.08";
BA_ "RoutingFactor" SG_ 3221225472 ADAS_CMD_AlvCnt30Val 5;
BA_ "UserSigValidity" SG_ 3221225472 ADAS_CMD_AlvCnt30Val 3;
BA_ "Description" SG_ 3221225472 ADAS_CMD_AlvCnt30Val "For the first transmission request for a data element the counter shall be initialized with 0 and shall be incremented by 1 for every subsequent send request. 

When the counter reaches the maximum value(0xFF), then it shall restart with 0 for the next s";
BA_ "Version" SG_ 3221225472 LKA_OptUsmSta "17.12.02";
BA_ "RoutingFactor" SG_ 3221225472 LKA_OptUsmSta 5;
BA_ "UserSigValidity" SG_ 3221225472 LKA_OptUsmSta 3;
BA_ "Version" SG_ 3221225472 LKA_RcgSta "18.10.12";
BA_ "RoutingFactor" SG_ 3221225472 LKA_RcgSta 5;
BA_ "UserSigValidity" SG_ 3221225472 LKA_RcgSta 3;
BA_ "Version" SG_ 3221225472 LKA_LHLnWrnSta "18.02.03";
BA_ "RoutingFactor" SG_ 3221225472 LKA_LHLnWrnSta 5;
BA_ "UserSigValidity" SG_ 3221225472 LKA_LHLnWrnSta 3;
BA_ "Version" SG_ 3221225472 LKA_RHLnWrnSta "18.02.03";
BA_ "RoutingFactor" SG_ 3221225472 LKA_RHLnWrnSta 5;
BA_ "UserSigValidity" SG_ 3221225472 LKA_RHLnWrnSta 3;
BA_ "Version" SG_ 3221225472 LKA_HndsoffSnd "17.12.02";
BA_ "RoutingFactor" SG_ 3221225472 LKA_HndsoffSnd 5;
BA_ "UserSigValidity" SG_ 3221225472 LKA_HndsoffSnd 3;
BA_ "Version" SG_ 3221225472 LKA_SysIndReq "17.12.02";
BA_ "RoutingFactor" SG_ 3221225472 LKA_SysIndReq 5;
BA_ "UserSigValidity" SG_ 3221225472 LKA_SysIndReq 3;
BA_ "Version" SG_ 3221225472 ADAS_StrTqReqVal "18.10.00";
BA_ "RoutingFactor" SG_ 3221225472 ADAS_StrTqReqVal 5;
BA_ "UserSigValidity" SG_ 3221225472 ADAS_StrTqReqVal 3;
BA_ "GenSigStartValue" SG_ 3221225472 ADAS_StrTqReqVal 1024;
BA_ "Description" SG_ 3221225472 ADAS_StrTqReqVal "This is the driver torque overlay demand value. A negative value represents a torque that would accelerate the steering wheel in a clockwise direction. This signal is always zero whilst the TOI is inactive.";
BA_ "Version" SG_ 3221225472 ADAS_ActToiSta "18.12.07";
BA_ "RoutingFactor" SG_ 3221225472 ADAS_ActToiSta 5;
BA_ "UserSigValidity" SG_ 3221225472 ADAS_ActToiSta 3;
BA_ "Description" SG_ 3221225472 ADAS_ActToiSta "This is a flag that is set to 1 when requesting the steering to activate the torque overlay interface (TOI).  This must be done before an attempt is made to request non-zero steering torque overlay.";
BA_ "Version" SG_ 3221225472 ADAS_ToiFltSta "18.12.07";
BA_ "RoutingFactor" SG_ 3221225472 ADAS_ToiFltSta 5;
BA_ "UserSigValidity" SG_ 3221225472 ADAS_ToiFltSta 3;
BA_ "Description" SG_ 3221225472 ADAS_ToiFltSta "This fault flag is set when a fault in the LKA system has been detected by the LKA ECU such that LKA can no longer function. CAN failures, internal video ECU failures, hard-wired component (e.g. master switch) failures and other system logic failures are";
BA_ "Version" SG_ 3221225472 BCA_Rear_WrnSta "18.10.09";
BA_ "RoutingFactor" SG_ 3221225472 BCA_Rear_WrnSta 5;
BA_ "UserSigValidity" SG_ 3221225472 BCA_Rear_WrnSta 3;
BA_ "Description" SG_ 3221225472 BCA_Rear_WrnSta "This signal indicates BCA-Rear warning for display and sound.";
BA_ "Version" SG_ 3221225472 LKA_SysWrn "18.10.09";
BA_ "RoutingFactor" SG_ 3221225472 LKA_SysWrn 5;
BA_ "UserSigValidity" SG_ 3221225472 LKA_SysWrn 3;
BA_ "Description" SG_ 3221225472 LKA_SysWrn "A signal that provides additional information on the operation of the LKA system for the HMI to display to the driver. This includes additional fault information, reasons for unavailability of the system and additional warnings like the hands-off warning";
BA_ "Version" SG_ 3221225472 FCA_LO_WrnSta "17.11.00";
BA_ "RoutingFactor" SG_ 3221225472 FCA_LO_WrnSta 5;
BA_ "UserSigValidity" SG_ 3221225472 FCA_LO_WrnSta 3;
BA_ "Description" SG_ 3221225472 FCA_LO_WrnSta "This signal indicates FCA-LO warning for display and sound.";
BA_ "Version" SG_ 3221225472 FCA_LS_WrnSta "17.11.00";
BA_ "RoutingFactor" SG_ 3221225472 FCA_LS_WrnSta 5;
BA_ "UserSigValidity" SG_ 3221225472 FCA_LS_WrnSta 3;
BA_ "Description" SG_ 3221225472 FCA_LS_WrnSta "This signal indicates FCA-LS warning for display and sound.";
BA_ "Version" SG_ 3221225472 LKA_UsmMod "18.01.08";
BA_ "RoutingFactor" SG_ 3221225472 LKA_UsmMod 5;
BA_ "UserSigValidity" SG_ 3221225472 LKA_UsmMod 3;
BA_ "Description" SG_ 3221225472 LKA_UsmMod "This signal indicates LKA USM Mode";
BA_ "Version" SG_ 3221225472 Info_PedtrnDst "19.01.04";
BA_ "RoutingFactor" SG_ 3221225472 Info_PedtrnDst 5;
BA_ "UserSigValidity" SG_ 3221225472 Info_PedtrnDst 3;
BA_ "Description" SG_ 3221225472 Info_PedtrnDst "Distance of the nearest pedestrian";
BA_ "Version" SG_ 3221225472 FCA_ESA_WrnSta "18.08.06";
BA_ "RoutingFactor" SG_ 3221225472 FCA_ESA_WrnSta 5;
BA_ "UserSigValidity" SG_ 3221225472 FCA_ESA_WrnSta 3;
BA_ "Description" SG_ 3221225472 FCA_ESA_WrnSta "FCA w/ ESA HMI";
BA_ "Version" SG_ 3221225472 RWS_CCP_RESP1_Byte0 "18.08.01";
BA_ "NetworkRequestHoldingTime" SG_ 3221225472 RWS_CCP_RESP1_Byte0 5000;
BA_ "NetworkRequest" SG_ 3221225472 RWS_CCP_RESP1_Byte0 0;
BA_ "UserSigValidity" SG_ 3221225472 RWS_CCP_RESP1_Byte0 0;
BA_ "GenSigSendType" SG_ 3221225472 RWS_CCP_RESP1_Byte0 2;
BA_ "UsrSigPurpose" SG_ 3221225472 RWS_CCP_RESP1_Byte0 6;
BA_ "Version" SG_ 3221225472 RWS_CCP_RESP1_Byte2 "18.08.01";
BA_ "NetworkRequestHoldingTime" SG_ 3221225472 RWS_CCP_RESP1_Byte2 5000;
BA_ "NetworkRequest" SG_ 3221225472 RWS_CCP_RESP1_Byte2 0;
BA_ "UserSigValidity" SG_ 3221225472 RWS_CCP_RESP1_Byte2 0;
BA_ "GenSigSendType" SG_ 3221225472 RWS_CCP_RESP1_Byte2 2;
BA_ "UsrSigPurpose" SG_ 3221225472 RWS_CCP_RESP1_Byte2 6;
BA_ "Version" SG_ 3221225472 RWS_CCP_RESP1_Byte3 "18.08.01";
BA_ "NetworkRequestHoldingTime" SG_ 3221225472 RWS_CCP_RESP1_Byte3 5000;
BA_ "NetworkRequest" SG_ 3221225472 RWS_CCP_RESP1_Byte3 0;
BA_ "UserSigValidity" SG_ 3221225472 RWS_CCP_RESP1_Byte3 0;
BA_ "GenSigSendType" SG_ 3221225472 RWS_CCP_RESP1_Byte3 2;
BA_ "UsrSigPurpose" SG_ 3221225472 RWS_CCP_RESP1_Byte3 6;
BA_ "Version" SG_ 3221225472 RWS_CCP_RESP1_Byte4 "18.08.01";
BA_ "NetworkRequestHoldingTime" SG_ 3221225472 RWS_CCP_RESP1_Byte4 5000;
BA_ "NetworkRequest" SG_ 3221225472 RWS_CCP_RESP1_Byte4 0;
BA_ "UserSigValidity" SG_ 3221225472 RWS_CCP_RESP1_Byte4 0;
BA_ "GenSigSendType" SG_ 3221225472 RWS_CCP_RESP1_Byte4 2;
BA_ "UsrSigPurpose" SG_ 3221225472 RWS_CCP_RESP1_Byte4 6;
BA_ "Version" SG_ 3221225472 RWS_CCP_RESP1_Byte5 "18.08.01";
BA_ "NetworkRequestHoldingTime" SG_ 3221225472 RWS_CCP_RESP1_Byte5 5000;
BA_ "NetworkRequest" SG_ 3221225472 RWS_CCP_RESP1_Byte5 0;
BA_ "UserSigValidity" SG_ 3221225472 RWS_CCP_RESP1_Byte5 0;
BA_ "GenSigSendType" SG_ 3221225472 RWS_CCP_RESP1_Byte5 2;
BA_ "UsrSigPurpose" SG_ 3221225472 RWS_CCP_RESP1_Byte5 6;
BA_ "Version" SG_ 3221225472 RWS_CCP_RESP1_Byte6 "18.08.01";
BA_ "NetworkRequestHoldingTime" SG_ 3221225472 RWS_CCP_RESP1_Byte6 5000;
BA_ "NetworkRequest" SG_ 3221225472 RWS_CCP_RESP1_Byte6 0;
BA_ "UserSigValidity" SG_ 3221225472 RWS_CCP_RESP1_Byte6 0;
BA_ "GenSigSendType" SG_ 3221225472 RWS_CCP_RESP1_Byte6 2;
BA_ "UsrSigPurpose" SG_ 3221225472 RWS_CCP_RESP1_Byte6 6;
BA_ "Version" SG_ 3221225472 RWS_CCP_RESP1_Byte7 "18.08.01";
BA_ "NetworkRequestHoldingTime" SG_ 3221225472 RWS_CCP_RESP1_Byte7 5000;
BA_ "NetworkRequest" SG_ 3221225472 RWS_CCP_RESP1_Byte7 0;
BA_ "UserSigValidity" SG_ 3221225472 RWS_CCP_RESP1_Byte7 0;
BA_ "GenSigSendType" SG_ 3221225472 RWS_CCP_RESP1_Byte7 2;
BA_ "UsrSigPurpose" SG_ 3221225472 RWS_CCP_RESP1_Byte7 6;
BA_ "Version" SG_ 3221225472 RWS_CCP_RESP1_Byte1 "18.08.01";
BA_ "NetworkRequestHoldingTime" SG_ 3221225472 RWS_CCP_RESP1_Byte1 5000;
BA_ "NetworkRequest" SG_ 3221225472 RWS_CCP_RESP1_Byte1 0;
BA_ "UserSigValidity" SG_ 3221225472 RWS_CCP_RESP1_Byte1 0;
BA_ "GenSigSendType" SG_ 3221225472 RWS_CCP_RESP1_Byte1 2;
BA_ "UsrSigPurpose" SG_ 3221225472 RWS_CCP_RESP1_Byte1 6;
BA_ "Version" SG_ 3221225472 RWS_CCP_REQ1_Byte0 "18.08.01";
BA_ "NetworkRequestHoldingTime" SG_ 3221225472 RWS_CCP_REQ1_Byte0 5000;
BA_ "NetworkRequest" SG_ 3221225472 RWS_CCP_REQ1_Byte0 0;
BA_ "UserSigValidity" SG_ 3221225472 RWS_CCP_REQ1_Byte0 0;
BA_ "GenSigSendType" SG_ 3221225472 RWS_CCP_REQ1_Byte0 2;
BA_ "UsrSigPurpose" SG_ 3221225472 RWS_CCP_REQ1_Byte0 6;
BA_ "Version" SG_ 3221225472 RWS_CCP_REQ1_Byte2 "18.08.01";
BA_ "NetworkRequestHoldingTime" SG_ 3221225472 RWS_CCP_REQ1_Byte2 5000;
BA_ "NetworkRequest" SG_ 3221225472 RWS_CCP_REQ1_Byte2 0;
BA_ "UserSigValidity" SG_ 3221225472 RWS_CCP_REQ1_Byte2 0;
BA_ "GenSigSendType" SG_ 3221225472 RWS_CCP_REQ1_Byte2 2;
BA_ "UsrSigPurpose" SG_ 3221225472 RWS_CCP_REQ1_Byte2 6;
BA_ "Version" SG_ 3221225472 RWS_CCP_REQ1_Byte3 "18.08.01";
BA_ "NetworkRequestHoldingTime" SG_ 3221225472 RWS_CCP_REQ1_Byte3 5000;
BA_ "NetworkRequest" SG_ 3221225472 RWS_CCP_REQ1_Byte3 0;
BA_ "UserSigValidity" SG_ 3221225472 RWS_CCP_REQ1_Byte3 0;
BA_ "GenSigSendType" SG_ 3221225472 RWS_CCP_REQ1_Byte3 2;
BA_ "UsrSigPurpose" SG_ 3221225472 RWS_CCP_REQ1_Byte3 6;
BA_ "Version" SG_ 3221225472 RWS_CCP_REQ1_Byte4 "18.08.01";
BA_ "NetworkRequestHoldingTime" SG_ 3221225472 RWS_CCP_REQ1_Byte4 5000;
BA_ "NetworkRequest" SG_ 3221225472 RWS_CCP_REQ1_Byte4 0;
BA_ "UserSigValidity" SG_ 3221225472 RWS_CCP_REQ1_Byte4 0;
BA_ "GenSigSendType" SG_ 3221225472 RWS_CCP_REQ1_Byte4 2;
BA_ "UsrSigPurpose" SG_ 3221225472 RWS_CCP_REQ1_Byte4 6;
BA_ "Version" SG_ 3221225472 RWS_CCP_REQ1_Byte5 "18.08.01";
BA_ "NetworkRequestHoldingTime" SG_ 3221225472 RWS_CCP_REQ1_Byte5 5000;
BA_ "NetworkRequest" SG_ 3221225472 RWS_CCP_REQ1_Byte5 0;
BA_ "UserSigValidity" SG_ 3221225472 RWS_CCP_REQ1_Byte5 0;
BA_ "GenSigSendType" SG_ 3221225472 RWS_CCP_REQ1_Byte5 2;
BA_ "UsrSigPurpose" SG_ 3221225472 RWS_CCP_REQ1_Byte5 6;
BA_ "Version" SG_ 3221225472 RWS_CCP_REQ1_Byte6 "18.08.01";
BA_ "NetworkRequestHoldingTime" SG_ 3221225472 RWS_CCP_REQ1_Byte6 5000;
BA_ "NetworkRequest" SG_ 3221225472 RWS_CCP_REQ1_Byte6 0;
BA_ "UserSigValidity" SG_ 3221225472 RWS_CCP_REQ1_Byte6 0;
BA_ "GenSigSendType" SG_ 3221225472 RWS_CCP_REQ1_Byte6 2;
BA_ "UsrSigPurpose" SG_ 3221225472 RWS_CCP_REQ1_Byte6 6;
BA_ "Version" SG_ 3221225472 RWS_CCP_REQ1_Byte7 "18.08.01";
BA_ "NetworkRequestHoldingTime" SG_ 3221225472 RWS_CCP_REQ1_Byte7 5000;
BA_ "NetworkRequest" SG_ 3221225472 RWS_CCP_REQ1_Byte7 0;
BA_ "UserSigValidity" SG_ 3221225472 RWS_CCP_REQ1_Byte7 0;
BA_ "GenSigSendType" SG_ 3221225472 RWS_CCP_REQ1_Byte7 2;
BA_ "UsrSigPurpose" SG_ 3221225472 RWS_CCP_REQ1_Byte7 6;
BA_ "Version" SG_ 3221225472 RWS_CCP_REQ1_Byte1 "18.08.01";
BA_ "NetworkRequestHoldingTime" SG_ 3221225472 RWS_CCP_REQ1_Byte1 5000;
BA_ "NetworkRequest" SG_ 3221225472 RWS_CCP_REQ1_Byte1 0;
BA_ "UserSigValidity" SG_ 3221225472 RWS_CCP_REQ1_Byte1 0;
BA_ "GenSigSendType" SG_ 3221225472 RWS_CCP_REQ1_Byte1 2;
BA_ "UsrSigPurpose" SG_ 3221225472 RWS_CCP_REQ1_Byte1 6;
BA_ "Version" SG_ 3221225472 ICU_Crc12Val "18.11.08";
BA_ "UserSigValidity" SG_ 3221225472 ICU_Crc12Val 0;
BA_ "GenSigStartValue" SG_ 3221225472 ICU_Crc12Val 255;
BA_ "GenSigSendType" SG_ 3221225472 ICU_Crc12Val 4;
BA_ "Description" SG_ 3221225472 ICU_Crc12Val "The data area for CRC calculation is based on the data length (DLC) of the message DB.

The CRC shall be calculated over the entire data block (excluding the CRC bytes) including the user data, alive counter and Data ID 

 

- CRC Polynomial (0x1D) , Ini";
BA_ "Version" SG_ 3221225472 Warn_ChaDrSwRrSta "18.08.12";
BA_ "UserSigValidity" SG_ 3221225472 Warn_ChaDrSwRrSta 7;
BA_ "GenSigSendType" SG_ 3221225472 Warn_ChaDrSwRrSta 4;
BA_ "Description" SG_ 3221225472 Warn_ChaDrSwRrSta "Rear Charging Door Open Switch";
BA_ "Version" SG_ 3221225472 ICU_AlvCnt12Val "18.11.08";
BA_ "UserSigValidity" SG_ 3221225472 ICU_AlvCnt12Val 0;
BA_ "GenSigSendType" SG_ 3221225472 ICU_AlvCnt12Val 4;
BA_ "Description" SG_ 3221225472 ICU_AlvCnt12Val "For the first transmission request for a data element the counter shall be initialized with 0 and shall be incremented by 1

for every subsequent send request. When the counter reaches the maximum value(0xE), then it shall restart with 0 for the next sen";
BA_ "Version" SG_ 3221225472 ICU_IGN3On_RequestState "18.11.06";
BA_ "UserSigValidity" SG_ 3221225472 ICU_IGN3On_RequestState 7;
BA_ "GenSigSendType" SG_ 3221225472 ICU_IGN3On_RequestState 4;
BA_ "Description" SG_ 3221225472 ICU_IGN3On_RequestState "IGN3 Relay Control Request Unit State For EV/ PHEV Vehicle";
BA_ "Version" SG_ 3221225472 Warn_ChaDrSwFrtSta "18.08.12";
BA_ "UserSigValidity" SG_ 3221225472 Warn_ChaDrSwFrtSta 7;
BA_ "GenSigSendType" SG_ 3221225472 Warn_ChaDrSwFrtSta 4;
BA_ "Description" SG_ 3221225472 Warn_ChaDrSwFrtSta "Front Charging Door Open Switch";
BA_ "Version" SG_ 3221225472 YRS_Crc1Val "18.11.08";
BA_ "RoutingFactor" SG_ 3221225472 YRS_Crc1Val 5;
BA_ "UserSigValidity" SG_ 3221225472 YRS_Crc1Val 3;
BA_ "GenSigStartValue" SG_ 3221225472 YRS_Crc1Val 65535;
BA_ "Description" SG_ 3221225472 YRS_Crc1Val "The data area for CRC calculation is based on the data length (DLC) of the message DB.

The CRC shall be calculated over the entire data block (excluding the CRC bytes) including the user data, alive counter and Data ID

 

- CRC Polynomial (0x1021) , In";
BA_ "Version" SG_ 3221225472 YRS_SnsrTempVal "18.02.01";
BA_ "RoutingFactor" SG_ 3221225472 YRS_SnsrTempVal 5;
BA_ "UserSigValidity" SG_ 3221225472 YRS_SnsrTempVal 3;
BA_ "GenSigStartValue" SG_ 3221225472 YRS_SnsrTempVal 68;
BA_ "Description" SG_ 3221225472 YRS_SnsrTempVal "The temperature is measured on sensing element chip in ACU, so it may be different from the display indicator temperature of the vehicle.



Physical range: -68��C = 00h, +60 ��C = 80h, +187��C = FFh



Quantization LSB: 1[��C/digit]



Temperature [��C]";
BA_ "Version" SG_ 3221225472 YRS_ImuSeralNumVal "19.07.06";
BA_ "RoutingFactor" SG_ 3221225472 YRS_ImuSeralNumVal 5;
BA_ "UserSigValidity" SG_ 3221225472 YRS_ImuSeralNumVal 3;
BA_ "Description" SG_ 3221225472 YRS_ImuSeralNumVal "IMU serial number in range of 



0x000000000000 = 0......0xFFFFFFFFFFFF



��Initial value shall be actual value";
BA_ "Version" SG_ 3221225472 YRS_AlvCnt1Val "18.11.08";
BA_ "RoutingFactor" SG_ 3221225472 YRS_AlvCnt1Val 5;
BA_ "UserSigValidity" SG_ 3221225472 YRS_AlvCnt1Val 3;
BA_ "Description" SG_ 3221225472 YRS_AlvCnt1Val "For the first transmission request for a data element the counter shall be initialized with 0 and shall be incremented by 1 for every subsequent send request. 

When the counter reaches the maximum value(0xFF), then it shall restart with 0 for the next s";
BA_ "Version" SG_ 3221225472 YRS_YawSigSta "18.02.01";
BA_ "RoutingFactor" SG_ 3221225472 YRS_YawSigSta 5;
BA_ "UserSigValidity" SG_ 3221225472 YRS_YawSigSta 3;
BA_ "GenSigStartValue" SG_ 3221225472 YRS_YawSigSta 2;
BA_ "Description" SG_ 3221225472 YRS_YawSigSta "This signal indicates failure status of yaw rate signal and yaw rate sensing element.



0000B : No failure 



xxx1B : Yrs_Yr failure



xx1xB : Initialization is running



x1xxB : Reserved



1xxxB : Reserved



This signal represents the physical err";
BA_ "Version" SG_ 3221225472 YRS_LatAccelSigSta "18.02.01";
BA_ "RoutingFactor" SG_ 3221225472 YRS_LatAccelSigSta 5;
BA_ "UserSigValidity" SG_ 3221225472 YRS_LatAccelSigSta 3;
BA_ "GenSigStartValue" SG_ 3221225472 YRS_LatAccelSigSta 2;
BA_ "Description" SG_ 3221225472 YRS_LatAccelSigSta "This signal indicates failure status of lateral acceleration signal and sensing element.



0000B : No failure



xxx1B : Yrs_LatAc failure



xx1xB : Initialization is running



x1xxB : Reserved



1xxxB : Reserved



This signal represents the physica";
BA_ "Version" SG_ 3221225472 YRS_LongAccelSigSta "18.02.01";
BA_ "RoutingFactor" SG_ 3221225472 YRS_LongAccelSigSta 5;
BA_ "UserSigValidity" SG_ 3221225472 YRS_LongAccelSigSta 3;
BA_ "GenSigStartValue" SG_ 3221225472 YRS_LongAccelSigSta 2;
BA_ "Description" SG_ 3221225472 YRS_LongAccelSigSta "This signal indicates failure status of longitudinal acceleration signal and sensing element.



0000B : No failure 



xxx1B : Yrs_LongAc failure



xx1xB : Initialization is running



x1xxB : Reserved



1xxxB : Reserved



This signal represents the ";
BA_ "Version" SG_ 3221225472 YRS_McuVoltSta "18.02.01";
BA_ "RoutingFactor" SG_ 3221225472 YRS_McuVoltSta 5;
BA_ "UserSigValidity" SG_ 3221225472 YRS_McuVoltSta 3;
BA_ "Description" SG_ 3221225472 YRS_McuVoltSta "This signal indicates the failure status of MCU.



0000B : No failure



xxx1B : MCU failure



xx1xB : Under voltage detected



x1xxB : Over voltage detected



1xxxB : Bus off failure



The status information(xxx1B) occurs when MCU error is detected";
BA_ "Version" SG_ 3221225472 YRS_AcuRstSta "18.02.01";
BA_ "RoutingFactor" SG_ 3221225472 YRS_AcuRstSta 5;
BA_ "UserSigValidity" SG_ 3221225472 YRS_AcuRstSta 3;
BA_ "Description" SG_ 3221225472 YRS_AcuRstSta "This signal indicates the status of IMU.



0000B : Normal mode 



xxx1B : IMU Reset mode



xx1xB : Reserved



x1xxB : Reserved



1xxxB : Reserved



If ACU reset is required, ACU will send IMU RESET bit(XXX1B) up to 30 times and perform a reset. If ";
BA_ "Version" SG_ 3221225472 YRS_SnsrTyp "19.07.06";
BA_ "RoutingFactor" SG_ 3221225472 YRS_SnsrTyp 5;
BA_ "UserSigValidity" SG_ 3221225472 YRS_SnsrTyp 3;
BA_ "Description" SG_ 3221225472 YRS_SnsrTyp "This signal indicates supported signals that are correspond to sensor type.



0001B = YRS (yaw rate and lateral acceleration)



0010B = YRS (yaw rate, lateral and longitudinal acceleration)



All other values are reserved

�� Initial value shall be ac";
BA_ "Version" SG_ 3221225472 YRS_YawRtVal "18.02.01";
BA_ "RoutingFactor" SG_ 3221225472 YRS_YawRtVal 5;
BA_ "UserSigValidity" SG_ 3221225472 YRS_YawRtVal 3;
BA_ "GenSigStartValue" SG_ 3221225472 YRS_YawRtVal 32768;
BA_ "Description" SG_ 3221225472 YRS_YawRtVal "This signal indicates Information regarding yaw rate.



physical range : -163.84..163.83 ��/s = 0000H..FFFEh



Conversion : (PH) = ((HEX)-8000H)*0.005[��/s/digit]



                            = (HEX)*0.005[��/s/digit] - 163.84[��/s]



              ";
BA_ "Version" SG_ 3221225472 YRS_LatAccelVal "18.02.01";
BA_ "RoutingFactor" SG_ 3221225472 YRS_LatAccelVal 5;
BA_ "UserSigValidity" SG_ 3221225472 YRS_LatAccelVal 3;
BA_ "GenSigStartValue" SG_ 3221225472 YRS_LatAccelVal 32768;
BA_ "Description" SG_ 3221225472 YRS_LatAccelVal "This signal indicates Information regarding lateral acceleration.



physical range : -4.1768g..4.1765g = 0000H..FFFEh



Conversion : (PH) = ((HEX)-8000H)*0.000127465[g/digit]



                            = (HEX)*0.000127465[g/digit] - 4.17677312[g]

";
BA_ "Version" SG_ 3221225472 YRS_LongAccelVal "18.02.01";
BA_ "RoutingFactor" SG_ 3221225472 YRS_LongAccelVal 5;
BA_ "UserSigValidity" SG_ 3221225472 YRS_LongAccelVal 3;
BA_ "GenSigStartValue" SG_ 3221225472 YRS_LongAccelVal 32768;
BA_ "Description" SG_ 3221225472 YRS_LongAccelVal "This signal indicates information regarding longitudinal acceleration.



physical range : -4.1768g..4.1765g = 0000H..FFFEh



Conversion : (PH) = ((HEX)-8000H)*0.000127465[g/digit]



                            = (HEX)*0.000127465[g/digit] - 4.17677312";
BA_ "Version" SG_ 3221225472 GATEWAY_CrcVal "18.11.08";
BA_ "UserSigValidity" SG_ 3221225472 GATEWAY_CrcVal 0;
BA_ "GenSigStartValue" SG_ 3221225472 GATEWAY_CrcVal 255;
BA_ "Description" SG_ 3221225472 GATEWAY_CrcVal "The data area for CRC calculation is based on the data length (DLC) of the message DB.

The CRC shall be calculated over the entire data block (excluding the CRC bytes) including the user data, alive counter and Data ID 

 

- CRC Polynomial (0x1D) , Ini";
BA_ "Version" SG_ 3221225472 GATEWAY_AlvCntVal "18.11.08";
BA_ "UserSigValidity" SG_ 3221225472 GATEWAY_AlvCntVal 0;
BA_ "Description" SG_ 3221225472 GATEWAY_AlvCntVal "For the first transmission request for a data element the counter shall be initialized with 0 and shall be incremented by 1

for every subsequent send request. When the counter reaches the maximum value(0xE), then it shall restart with 0 for the next sen";
BA_ "Version" SG_ 3221225472 GATEWAY_MM_STS "17.11.00";
BA_ "UserSigValidity" SG_ 3221225472 GATEWAY_MM_STS 0;
BA_ "Version" SG_ 3221225472 GATEWAY_HS_B_STS "17.11.00";
BA_ "UserSigValidity" SG_ 3221225472 GATEWAY_HS_B_STS 0;
BA_ "Version" SG_ 3221225472 GATEWAY_HS_D_STS "19.01.12";
BA_ "UserSigValidity" SG_ 3221225472 GATEWAY_HS_D_STS 0;
BA_ "Version" SG_ 3221225472 GATEWAY_HS_I_STS "17.11.00";
BA_ "UserSigValidity" SG_ 3221225472 GATEWAY_HS_I_STS 0;
BA_ "Version" SG_ 3221225472 GATEWAY_FD_P_STS "17.11.00";
BA_ "UserSigValidity" SG_ 3221225472 GATEWAY_FD_P_STS 0;
BA_ "Version" SG_ 3221225472 GATEWAY_FD_C_STS "17.11.00";
BA_ "UserSigValidity" SG_ 3221225472 GATEWAY_FD_C_STS 0;
BA_ "Version" SG_ 3221225472 GATEWAY_FD_V_STS "17.11.00";
BA_ "UserSigValidity" SG_ 3221225472 GATEWAY_FD_V_STS 0;
BA_ "Version" SG_ 3221225472 GATEWAY_FD_G_STS "17.11.00";
BA_ "UserSigValidity" SG_ 3221225472 GATEWAY_FD_G_STS 0;
BA_ "Version" SG_ 3221225472 GATEWAY_FD_E_STS "17.11.00";
BA_ "UserSigValidity" SG_ 3221225472 GATEWAY_FD_E_STS 0;
BA_ "Version" SG_ 3221225472 ICU_Crc8Val "18.11.08";
BA_ "UserSigValidity" SG_ 3221225472 ICU_Crc8Val 0;
BA_ "GenSigStartValue" SG_ 3221225472 ICU_Crc8Val 255;
BA_ "GenSigSendType" SG_ 3221225472 ICU_Crc8Val 4;
BA_ "Description" SG_ 3221225472 ICU_Crc8Val "The data area for CRC calculation is based on the data length (DLC) of the message DB.

The CRC shall be calculated over the entire data block (excluding the CRC bytes) including the user data, alive counter and Data ID 

 

- CRC Polynomial (0x1D) , Ini";
BA_ "Version" SG_ 3221225472 HeatedSteerWheel_StrWhlHtrSwSta "17.12.00";
BA_ "UserSigValidity" SG_ 3221225472 HeatedSteerWheel_StrWhlHtrSwSta 0;
BA_ "GenSigStartValue" SG_ 3221225472 HeatedSteerWheel_StrWhlHtrSwSta 3;
BA_ "GenSigSendType" SG_ 3221225472 HeatedSteerWheel_StrWhlHtrSwSta 4;
BA_ "Description" SG_ 3221225472 HeatedSteerWheel_StrWhlHtrSwSta "This signal is used to sent information of current state of 

Steering Wheel Heated SW.

0x0:Off/0x1:On/0x2:Reserved/0x3:Invalid";
BA_ "Version" SG_ 3221225472 ICU_AlvCnt8Val "18.11.08";
BA_ "UserSigValidity" SG_ 3221225472 ICU_AlvCnt8Val 0;
BA_ "GenSigSendType" SG_ 3221225472 ICU_AlvCnt8Val 4;
BA_ "Description" SG_ 3221225472 ICU_AlvCnt8Val "For the first transmission request for a data element the counter shall be initialized with 0 and shall be incremented by 1

for every subsequent send request. When the counter reaches the maximum value(0xE), then it shall restart with 0 for the next sen";
BA_ "Version" SG_ 3221225472 DriveTypeOption "17.12.00";
BA_ "NetworkRequestHoldingTime" SG_ 3221225472 DriveTypeOption 5000;
BA_ "NetworkRequest" SG_ 3221225472 DriveTypeOption 0;
BA_ "UserSigValidity" SG_ 3221225472 DriveTypeOption 0;
BA_ "GenSigSendType" SG_ 3221225472 DriveTypeOption 4;
BA_ "Description" SG_ 3221225472 DriveTypeOption "Drive Type Option

This signal is used to determine driver's seat position('Drive Type') about this vehicle.";
BA_ "Version" SG_ 3221225472 Warn_RrLftSBRMATSwSta "17.12.00";
BA_ "NetworkRequestHoldingTime" SG_ 3221225472 Warn_RrLftSBRMATSwSta 5000;
BA_ "NetworkRequest" SG_ 3221225472 Warn_RrLftSBRMATSwSta 0;
BA_ "UserSigValidity" SG_ 3221225472 Warn_RrLftSBRMATSwSta 0;
BA_ "GenSigSendType" SG_ 3221225472 Warn_RrLftSBRMATSwSta 4;
BA_ "Description" SG_ 3221225472 Warn_RrLftSBRMATSwSta "Rear Left Seated State";
BA_ "Version" SG_ 3221225472 Warn_RrRhtSBRMATSwSta "17.12.00";
BA_ "NetworkRequestHoldingTime" SG_ 3221225472 Warn_RrRhtSBRMATSwSta 5000;
BA_ "NetworkRequest" SG_ 3221225472 Warn_RrRhtSBRMATSwSta 0;
BA_ "UserSigValidity" SG_ 3221225472 Warn_RrRhtSBRMATSwSta 0;
BA_ "GenSigSendType" SG_ 3221225472 Warn_RrRhtSBRMATSwSta 4;
BA_ "Description" SG_ 3221225472 Warn_RrRhtSBRMATSwSta "Rear Right Seated State";
BA_ "Version" SG_ 3221225472 StrWheelAutoHeatSta "17.12.00";
BA_ "UserSigValidity" SG_ 3221225472 StrWheelAutoHeatSta 3;
BA_ "GenSigSendType" SG_ 3221225472 StrWheelAutoHeatSta 4;
BA_ "Description" SG_ 3221225472 StrWheelAutoHeatSta "USM Response for Steering Wheel Auto Heat function";
BA_ "Version" SG_ 3221225472 StrWheelHeatIndSta "17.12.00";
BA_ "UserSigValidity" SG_ 3221225472 StrWheelHeatIndSta 3;
BA_ "GenSigSendType" SG_ 3221225472 StrWheelHeatIndSta 4;
BA_ "Description" SG_ 3221225472 StrWheelHeatIndSta "Indicator of StrgWheel heater";
BA_ "Version" SG_ 3221225472 Warn_LftSEA "17.12.00";
BA_ "UserSigValidity" SG_ 3221225472 Warn_LftSEA 0;
BA_ "GenSigSendType" SG_ 3221225472 Warn_LftSEA 4;
BA_ "Description" SG_ 3221225472 Warn_LftSEA "Command for SEA LH Warning Text on cluster";
BA_ "Version" SG_ 3221225472 Warn_RhtSEA "17.12.00";
BA_ "UserSigValidity" SG_ 3221225472 Warn_RhtSEA 0;
BA_ "GenSigSendType" SG_ 3221225472 Warn_RhtSEA 4;
BA_ "Description" SG_ 3221225472 Warn_RhtSEA "Command for SEA RH Warning Text on cluster";
BA_ "Version" SG_ 3221225472 Lamp_FootLampOnReq "17.12.00";
BA_ "NetworkRequestHoldingTime" SG_ 3221225472 Lamp_FootLampOnReq 5000;
BA_ "NetworkRequest" SG_ 3221225472 Lamp_FootLampOnReq 0;
BA_ "UserSigValidity" SG_ 3221225472 Lamp_FootLampOnReq 0;
BA_ "GenSigSendType" SG_ 3221225472 Lamp_FootLampOnReq 4;
BA_ "Description" SG_ 3221225472 Lamp_FootLampOnReq "Foot Lamp Command";
BA_ "Version" SG_ 3221225472 Lamp_MoodLampOnReq "17.12.00";
BA_ "NetworkRequestHoldingTime" SG_ 3221225472 Lamp_MoodLampOnReq 5000;
BA_ "NetworkRequest" SG_ 3221225472 Lamp_MoodLampOnReq 0;
BA_ "UserSigValidity" SG_ 3221225472 Lamp_MoodLampOnReq 0;
BA_ "GenSigSendType" SG_ 3221225472 Lamp_MoodLampOnReq 4;
BA_ "Description" SG_ 3221225472 Lamp_MoodLampOnReq "Mood lamp command";
BA_ "Version" SG_ 3221225472 ICU_PowerAutoCutModSta "17.12.00";
BA_ "UserSigValidity" SG_ 3221225472 ICU_PowerAutoCutModSta 3;
BA_ "GenSigSendType" SG_ 3221225472 ICU_PowerAutoCutModSta 4;
BA_ "Description" SG_ 3221225472 ICU_PowerAutoCutModSta "ICU Delivery Mode State";
BA_ "Version" SG_ 3221225472 ICU_SoCBattStaMsgReq "17.12.00";
BA_ "UserSigValidity" SG_ 3221225472 ICU_SoCBattStaMsgReq 0;
BA_ "GenSigStartValue" SG_ 3221225472 ICU_SoCBattStaMsgReq 3;
BA_ "GenSigSendType" SG_ 3221225472 ICU_SoCBattStaMsgReq 4;
BA_ "Description" SG_ 3221225472 ICU_SoCBattStaMsgReq "Determine if soc level is warning or alert.";
BA_ "Version" SG_ 3221225472 C_ICUPowerAutoCutType "18.08.00";
BA_ "NetworkRequest" SG_ 3221225472 C_ICUPowerAutoCutType 0;
BA_ "UserSigValidity" SG_ 3221225472 C_ICUPowerAutoCutType 0;
BA_ "GenSigSendType" SG_ 3221225472 C_ICUPowerAutoCutType 4;
BA_ "Description" SG_ 3221225472 C_ICUPowerAutoCutType "ICU Power Management Autocut Spec Information";
BA_ "Version" SG_ 3221225472 DrvDrLockIND "17.11.00";
BA_ "UserSigValidity" SG_ 3221225472 DrvDrLockIND 0;
BA_ "GenSigSendType" SG_ 3221225472 DrvDrLockIND 4;
BA_ "Description" SG_ 3221225472 DrvDrLockIND "Driver door lock indicator on/off signal";
BA_ "Version" SG_ 3221225472 Brake_SwSta_ICU "17.12.00";
BA_ "NetworkRequestHoldingTime" SG_ 3221225472 Brake_SwSta_ICU 5000;
BA_ "NetworkRequest" SG_ 3221225472 Brake_SwSta_ICU 0;
BA_ "UserSigValidity" SG_ 3221225472 Brake_SwSta_ICU 0;
BA_ "GenSigSendType" SG_ 3221225472 Brake_SwSta_ICU 4;
BA_ "Description" SG_ 3221225472 Brake_SwSta_ICU "Brake Switch Status";
BA_ "Version" SG_ 3221225472 HSWS_SysWrngSta_ICU "17.12.00";
BA_ "UserSigValidity" SG_ 3221225472 HSWS_SysWrngSta_ICU 4;
BA_ "GenSigSendType" SG_ 3221225472 HSWS_SysWrngSta_ICU 4;
BA_ "Description" SG_ 3221225472 HSWS_SysWrngSta_ICU "0x0 : Normal

0x1 : System Fail

0x2 : Reserved

0x3 : Invalid";
BA_ "Version" SG_ 3221225472 DATC_Crc1Val "18.11.08";
BA_ "RoutingFactor" SG_ 3221225472 DATC_Crc1Val 5;
BA_ "UserSigValidity" SG_ 3221225472 DATC_Crc1Val 7;
BA_ "GenSigStartValue" SG_ 3221225472 DATC_Crc1Val 65535;
BA_ "Description" SG_ 3221225472 DATC_Crc1Val "The data area for CRC calculation is based on the data length (DLC) of the message DB.

The CRC shall be calculated over the entire data block (excluding the CRC bytes) including the user data, alive counter and Data ID

 

- CRC Polynomial (0x1021) , In";
BA_ "Version" SG_ 3221225472 DATC_BattChlrVlvSta "19.07.02";
BA_ "RoutingFactor" SG_ 3221225472 DATC_BattChlrVlvSta 5;
BA_ "UserSigValidity" SG_ 3221225472 DATC_BattChlrVlvSta 3;
BA_ "Description" SG_ 3221225472 DATC_BattChlrVlvSta "Battery chiller valve status";
BA_ "Version" SG_ 3221225472 DATC_AcnECompSpdVal "17.11.00";
BA_ "RoutingFactor" SG_ 3221225472 DATC_AcnECompSpdVal 5;
BA_ "UserSigValidity" SG_ 3221225472 DATC_AcnECompSpdVal 7;
BA_ "Description" SG_ 3221225472 DATC_AcnECompSpdVal "0 ��65534 [rpm] = 0000H �� FFFEH, (PH) = 1*(HEX) [rpm]";
BA_ "Version" SG_ 3221225472 DATC_AcnCompSlpModCodVal "17.11.00";
BA_ "RoutingFactor" SG_ 3221225472 DATC_AcnCompSlpModCodVal 5;
BA_ "UserSigValidity" SG_ 3221225472 DATC_AcnCompSlpModCodVal 7;
BA_ "Description" SG_ 3221225472 DATC_AcnCompSlpModCodVal "(PH) = 1 * (HEX) [-]";
BA_ "Version" SG_ 3221225472 DATC_AcnCompWaitCodVal "17.11.00";
BA_ "RoutingFactor" SG_ 3221225472 DATC_AcnCompWaitCodVal 5;
BA_ "UserSigValidity" SG_ 3221225472 DATC_AcnCompWaitCodVal 7;
BA_ "Description" SG_ 3221225472 DATC_AcnCompWaitCodVal "(PH) = 1 * (HEX) [-]";
VAL_ 3221225472 ABS_WrngLmpSta 0 "ABS Warning lamp OFF" 1 "ABS Warning lamp ON" 2 "Not used" 3 "Error Indicator" ;
VAL_ 3221225472 ABS_DfctvSta 0 "ABS is not defective" 1 "ABS is defective" 2 "Not used" 3 "Error Indicator" ;
VAL_ 3221225472 ABS_ActvSta 0 "ABS control inactive" 1 "ABS control active" 2 "Not used" 3 "Error Indicator" ;
VAL_ 3221225472 ABS_DiagSta 0 "ABS&TCS&ESC is not in diagnostic mode" 1 "ABS&TCS&ESC is in diagnostic mode" 2 "Not used" 3 "Error Indicator" ;
VAL_ 3221225472 EBD_WrngLmpSta 0 "EBD Warning lamp OFF" 1 "EBD Warning lamp ON" 2 "Not used" 3 "Error Indicator" ;
VAL_ 3221225472 EBD_DfctvSta 0 "EBD is not defective" 1 "EBD is defective" 2 "Not used" 3 "Error Indicator" ;
VAL_ 3221225472 ESC_BrkLtActSta 0 "No request" 1 "Activate brake lights" 2 "Not used" 3 "Error Indicator" ;
VAL_ 3221225472 ESS_Sta 0 "ESS control 'inactive' (Normal condition)" 1 "ESS control 'active' (Emergency stop condition)" 2 "ESS system is defective" 3 "ESS extended function active (Hazard lamp blinking)" ;
VAL_ 3221225472 ECS_WrngLmpSta 0 "Off" 1 "On" 2 "Not used" 3 "Error Indicator" ;
VAL_ 3221225472 ECS_DfctvSta 0 "ECS is not defective" 1 "Fault Level:1 (Minor Fault)" 2 "Fault Level:2" 3 "Fault Level:3 (Major Fault)" ;
VAL_ 3221225472 ECS_DmpModSta 0 "Auto" 1 "Soft" 2 "Hard" 3 "Reserved" 4 "Reserved" 5 "Reserved" 6 "Not used" 7 "Error Indicator" ;
VAL_ 3221225472 ECS_DmpModReq 0 "Auto" 1 "Soft" 2 "Hard" 3 "Reserved" 4 "Reserved" 5 "Reserved" 6 "Not used" 7 "Error Indicator" ;
VAL_ 3221225472 HBA_SysOptSta 0 "None HBA Option (Default)" 1 "HBA Option" 2 "Reserved" 3 "Error indicator" ;
VAL_ 3221225472 HBA_SysSta 0 "HBA Disable" 1 "HBA Enable & High Beam Off" 2 "HBA Enable & High Beam On" 3 "Reserved" 4 "Reserved" 5 "Reserved" 6 "Reserved" 7 "System Fail" ;
VAL_ 3221225472 HBA_IndLmpReq 0 "HBA Indicator Lamp Off" 1 "HBA Indicator Lamp On" 2 "Reserved" 3 "Error indicator" ;
VAL_ 3221225472 FCA_Equip_MFC 0 "No Coding" 1 "Sensor Fusion FCA" 2 "Camera only FCA" 3 "No FCA Option" 4 "ADAS_DRV Option" 5 "Reserved" 6 "Not used" 7 "Error indicator" ;
VAL_ 3221225472 HBA_OptUsmSta 0 "None HBA Option (Default)" 1 "HBA Function Off" 2 "HBA Function On" 3 "Invalid (Fail)" ;
VAL_ 3221225472 DAW_LVDA_PUDis 0 "Default" 1 "Display ��Leading vehicle departure alert��" 2 "Reserved" 3 "Error indicator" ;
VAL_ 3221225472 DAW_LVDA_OptUsmSta 0 "No Option (default)" 1 "Off" 2 "On" 3 "Invalid" ;
VAL_ 3221225472 DAW_OptUsmSta 0 "None DAW Option (Default)" 1 "System Off" 2 "System On" 3 "Reserved" 4 "Reserved" 5 "Reserved" 6 "Reserved" 7 "Invalid (Gray)" ;
VAL_ 3221225472 DAW_SysSta 0 "System Off" 1 "Attention Level  1" 2 "Attention Level  2" 3 "Attention Level  3" 4 "Attention Level  4" 5 "Attention Level  5" 6 "Reserved" 7 "Reserved" 8 "Reserved" 9 "Reserved" 10 "Reserved" 11 "Reserved" 12 "Reserved" 13 "Reserved" 14 "System Standby" 15 "System Fail" ;
VAL_ 3221225472 DAW_WrnMsgSta 0 "No Warning" 1 "Rest Recommend Warning" 2 "Hands-Off TMS call request" 3 "Reserved" 4 "Reserved" 5 "Reserved" 6 "Reserved" 7 "Error indicator" ;
VAL_ 3221225472 DAW_TimeRstReq 0 "No signal" 1 "Time reset" 2 "Reserved" 3 "Error indicator" ;
VAL_ 3221225472 DAW_SnstvtyModRetVal 0 "Default" 1 "Late" 2 "Normal" 3 "Reserved" 4 "Reserved" 5 "Reserved" 6 "Reserved" 7 "Invalid" ;
VAL_ 3221225472 FR_CMR_FCAEquipSta 0 "Not applied" 1 "Applied" 2 "Not used" 3 "Error indicator" ;
VAL_ 3221225472 FR_CMR_MDPSCtrlSta 0 "Not applied" 1 "Applied" 2 "Not used" 3 "Error indicator" ;
VAL_ 3221225472 FR_CMR_FailInfoSta 0 "Normal" 1 "Unit failure" 2 "Calibration failure" 3 "Blockage & Temperature" 4 "Coding failure" 5 "Reserved" 6 "Reserved" 7 "Error indicator" ;
VAL_ 3221225472 FR_CMR_CodingSta 0 "Coded" 1 "Not coded" 2 "Reserved" 3 "Error indicator" ;
VAL_ 3221225472 FR_CMR_ACANMonSta 0 "Normal" 1 "A-CANFD Bus-off" 2 "A-CANFD Timeout" 3 "Error indicator" ;
VAL_ 3221225472 PRVECS_CodedSta 0 "Not coded" 1 "Coded" 2 "Reserved" 3 "Error indicator" ;
VAL_ 3221225472 MCU_Mg1MainRlyCutOffReq 0 "-" 1 "Relay Cut-off request by Mg1 MCU" 2 "Not used" 3 "Error Indicator" ;
VAL_ 3221225472 MCU_Mg1MainRlyCutOffDelayReq 0 "-" 1 "Relay Cut-off request by Mg1 MCU" 2 "Not used" 3 "Error Indicator" ;
VAL_ 3221225472 MCU_Mg1HiVoltIntlkReq 0 "Normal" 1 "Detect Interlock Disconnect" 2 "Not used" 3 "Error Indicator" ;
VAL_ 3221225472 MCU_Mg1MilOnReq 0 "MIL Off" 1 "MIL On Request by Mg1 MCU" 2 "Not used" 3 "Error Indicator" ;
VAL_ 3221225472 MCU_Mg1SrvLmpOnReq 0 "Service Lamp Off" 1 "Service Lamp On by Mg1 MCU" 2 "Not used" 3 "Error Indicator" ;
VAL_ 3221225472 MCU_Mg1AnkJrkActvSta 0 "Not Activated" 1 "Activated" 2 "Not used" 3 "Error Indicator" ;
VAL_ 3221225472 MCU_Mg1ActnTestModSta 0 "-" 1 "Actuation Test Mode" 2 "Not used" 3 "Error Indicator" ;
VAL_ 3221225472 MCU_Mg1PwmRetryStatus 0 "OFF" 1 "ON" 2 "Not Used" 3 "Error Indicator" ;
VAL_ 3221225472 MCU_Mg1TrqCmdStat 0 "1msCmd" 1 "10msCmd" 2 "Not Used" 3 "Error Indicator" ;
VAL_ 3221225472 MCU_Mg1RsvrCalibReq 0 "-" 1 "MCU requests collaboration for resolver calibration to HCU(or VCU)" 2 "Not used" 3 "Error Indicator" ;
VAL_ 3221225472 MCU_Mg1RsvrCalibProcSta 0 "Motor HSG resolver is calibrated" 1 "Motor HSG resolver is not calibrated" 2 "Not used" 3 "Error Indicator" ;
VAL_ 3221225472 MCU_Mg1RsvrCalibSta 0 "Complete" 1 "Error" 2 "Running" 3 "Activated" 4 "Ready" ;
VAL_ 3221225472 MCU_Mg1RadPwmDtyReq 255 "Error Indicator" ;
VAL_ 3221225472 MCU_Mg1InvtCtrlRdySta 0 "Mg1 MCU Not Ready" 1 "Mg1 MCU is Alive" 2 "Not used" 3 "Error Indicator" ;
VAL_ 3221225472 MCU_Mg1CtrlablSta 0 "-" 1 "Mg1 MCU is ready to control Mg1" 2 "Not used" 3 "Error Indicator" ;
VAL_ 3221225472 MCU_Mg1WrngSta 0 "No Warning" 1 "Warning" 2 "Not used" 3 "Error Indicator" ;
VAL_ 3221225472 MCU_Mg1FltSta 0 "No Fault" 1 "Fault" 2 "Not used" 3 "Error Indicator" ;
VAL_ 3221225472 DMIC_IndBrkModSta 0 "0FF" 1 "ON" 2 "Comfort(Normal)" 3 "Comfort+(Comfort)" 4 "ECO" 5 "Sport" 6 "Sport+" 7 "Smart" 8 "Not used" 9 "Not used" 10 "Not used" 11 "Not used" 12 "Not used" 13 "Not used" 14 "Not used" 15 "Error Indicator" ;
VAL_ 3221225472 DMIC_DrvModTyp 0 "Drive Mode Case0" 1 "Drive Mode Case1" 2 "Drive Mode Case2" 3 "Drive Mode Case3" 4 "Drive Mode Case4" 5 "Drive Mode Case5" 6 "Drive Mode Case6" 7 "Drive Mode Case7" 8 "Drive Mode Case8" 9 "Drive Mode Case9" 10 "Drive Mode Case10" 11 "Drive Mode Case11" 12 "Drive Mode Case12" 13 "Drive Mode Case13" 14 "Drive Mode Case14" 15 "Drive Mode Case15" ;
VAL_ 3221225472 DMIC_EngFltSta 0 "Not defective" 1 "Defective" 2 "Not used" 3 "Error Indicator" ;
VAL_ 3221225472 DMIC_MdpsFltSta 0 "Not defective" 1 "Defective" 2 "Not used" 3 "Error Indicator" ;
VAL_ 3221225472 DMIC_EcsFltSta 0 "Not defective" 1 "Defective" 2 "Not used" 3 "Error Indicator" ;
VAL_ 3221225472 DMIC_AwdFltSta 0 "Not defective" 1 "Defective" 2 "Not used" 3 "Error Indicator" ;
VAL_ 3221225472 DMIC_BrkFltSta 0 "Not defective" 1 "Defective" 2 "Not used" 3 "Error Indicator" ;
VAL_ 3221225472 DMIC_DrvModSta 0 "Individual" 1 "Snow" 2 "Comfort(Normal)" 3 "Comfort+(Comfort)" 4 "ECO" 5 "Sport" 6 "Sport+" 7 "Smart" 8 "Not used" 9 "Not used" 10 "Not used" 11 "Not used" 12 "Not used" 13 "Not used" 14 "Not used" 15 "Error Indicator" ;
VAL_ 3221225472 DMIC_SmtShftModSta 0 "OFF" 1 "ON" 2 "Not used" 3 "Error Indicator" ;
VAL_ 3221225472 DMIC_EngModSta 0 "0FF" 1 "ON" 2 "Comfort(Normal)" 3 "Comfort+(Comfort)" 4 "ECO" 5 "Sport" 6 "Sport+" 7 "Smart" 8 "Not used" 9 "Not used" 10 "Not used" 11 "Not used" 12 "Not used" 13 "Not used" 14 "Not used" 15 "Error Indicator" ;
VAL_ 3221225472 DMIC_IndEngModSta 0 "0FF" 1 "ON" 2 "Comfort(Normal)" 3 "Comfort+(Comfort)" 4 "ECO" 5 "Sport" 6 "Sport+" 7 "Smart" 8 "Not used" 9 "Not used" 10 "Not used" 11 "Not used" 12 "Not used" 13 "Not used" 14 "Not used" 15 "Error Indicator" ;
VAL_ 3221225472 DMIC_MdpsModSta 0 "0FF" 1 "ON" 2 "Comfort(Normal)" 3 "Comfort+(Comfort)" 4 "ECO" 5 "Sport" 6 "Sport+" 7 "Smart" 8 "Not used" 9 "Not used" 10 "Not used" 11 "Not used" 12 "Not used" 13 "Not used" 14 "Not used" 15 "Error Indicator" ;
VAL_ 3221225472 DMIC_IndMdpsModSta 0 "0FF" 1 "ON" 2 "Comfort(Normal)" 3 "Comfort+(Comfort)" 4 "ECO" 5 "Sport" 6 "Sport+" 7 "Smart" 8 "Not used" 9 "Not used" 10 "Not used" 11 "Not used" 12 "Not used" 13 "Not used" 14 "Not used" 15 "Error Indicator" ;
VAL_ 3221225472 DMIC_EcsModSta 0 "0FF" 1 "ON" 2 "Comfort(Normal)" 3 "Comfort+(Comfort)" 4 "ECO" 5 "Sport" 6 "Sport+" 7 "Smart" 8 "Not used" 9 "Not used" 10 "Not used" 11 "Not used" 12 "Not used" 13 "Not used" 14 "Not used" 15 "Error Indicator" ;
VAL_ 3221225472 DMIC_IndEcsModSta 0 "0FF" 1 "ON" 2 "Comfort(Normal)" 3 "Comfort+(Comfort)" 4 "ECO" 5 "Sport" 6 "Sport+" 7 "Smart" 8 "Not used" 9 "Not used" 10 "Not used" 11 "Not used" 12 "Not used" 13 "Not used" 14 "Not used" 15 "Error Indicator" ;
VAL_ 3221225472 DMIC_AwdModSta 0 "0FF" 1 "ON" 2 "Comfort(Normal)" 3 "Comfort+(Comfort)" 4 "ECO" 5 "Sport" 6 "Sport+" 7 "Smart" 8 "Not used" 9 "Not used" 10 "Not used" 11 "Not used" 12 "Not used" 13 "Not used" 14 "Not used" 15 "Error Indicator" ;
VAL_ 3221225472 DMIC_IndAwdModSta 0 "0FF" 1 "ON" 2 "Comfort(Normal)" 3 "Comfort+(Comfort)" 4 "ECO" 5 "Sport" 6 "Sport+" 7 "Smart" 8 "Not used" 9 "Not used" 10 "Not used" 11 "Not used" 12 "Not used" 13 "Not used" 14 "Not used" 15 "Error Indicator" ;
VAL_ 3221225472 Info_RdProfSts 0 "None Option (Default)" 1 "Normal" 2 "Not used" 3 "Error Indicator" ;
VAL_ 3221225472 Info_DistL 0 "0x0x00~0xFF:0~15.9375" 255 "0x0x00~0xFF:0~15.9375" ;
VAL_ 3221225472 Info_HeightL 0 "0x0x000~0x1FF:-160~+159.375" 511 "0x0x000~0x1FF:-160~+159.375" ;
VAL_ 3221225472 Info_LengthL 0 "0x0x00~0x7F:0~7.9375" 127 "0x0x00~0x7F:0~7.9375" ;
VAL_ 3221225472 Info_TypeL 0 "Ground" 1 "Bump" 2 "Hole" 3 "Reserved" ;
VAL_ 3221225472 Info_ConfL 0 "Low Quality~High Quality" 1 "Low Quality~High Quality" 2 "Low Quality~High Quality" 3 "Low Quality~High Quality" 4 "Low Quality~High Quality" 5 "Low Quality~High Quality" 6 "Low Quality~High Quality" 7 "Low Quality~High Quality" 8 "Low Quality~High Quality" 9 "Low Quality~High Quality" 10 "Low Quality~High Quality" 11 "Low Quality~High Quality" 12 "Low Quality~High Quality" 13 "Low Quality~High Quality" 14 "Low Quality~High Quality" 15 "Low Quality~High Quality" ;
VAL_ 3221225472 Info_CyclicCounterL 0 "Cyclic Counter" 1 "Cyclic Counter" 2 "Cyclic Counter" 3 "Cyclic Counter" ;
VAL_ 3221225472 Info_VariL 0 "0x0x0~0x7F:Profile Height Variance" 127 "0x0x0~0x7F:Profile Height Variance" ;
VAL_ 3221225472 Info_DistR 0 "0x0x00~0xFF:0~15.9375" 255 "0x0x00~0xFF:0~15.9375" ;
VAL_ 3221225472 Info_HeightR 0 "0x0x000~0x1FF:-160~+159.375" 511 "0x0x000~0x1FF:-160~+159.375" ;
VAL_ 3221225472 Info_LengthR 0 "0x0x00~0x7F:0~7.9375" 127 "0x0x00~0x7F:0~7.9375" ;
VAL_ 3221225472 Info_TypeR 0 "Ground" 1 "Bump" 2 "Hole" 3 "Reserved" ;
VAL_ 3221225472 Info_ConfR 0 "Low Quality~High Quality" 1 "Low Quality~High Quality" 2 "Low Quality~High Quality" 3 "Low Quality~High Quality" 4 "Low Quality~High Quality" 5 "Low Quality~High Quality" 6 "Low Quality~High Quality" 7 "Low Quality~High Quality" 8 "Low Quality~High Quality" 9 "Low Quality~High Quality" 10 "Low Quality~High Quality" 11 "Low Quality~High Quality" 12 "Low Quality~High Quality" 13 "Low Quality~High Quality" 14 "Low Quality~High Quality" 15 "Low Quality~High Quality" ;
VAL_ 3221225472 Info_CyclicCounterR 0 "Cyclic Counter" 1 "Cyclic Counter" 2 "Cyclic Counter" 3 "Cyclic Counter" ;
VAL_ 3221225472 Info_VariR 0 "0x0x0~0x7F:Profile Height Variance" 127 "0x0x0~0x7F:Profile Height Variance" ;
VAL_ 3221225472 MCU_Mg2MainRlyCutOffReq 0 "-" 1 "Relay Cut-off request by Mg2 MCU" 2 "Not used" 3 "Error Indicator" ;
VAL_ 3221225472 MCU_Mg2MainRlyCutOffDelayReq 0 "-" 1 "Relay Cut-off request by Mg2 MCU" 2 "Not used" 3 "Error Indicator" ;
VAL_ 3221225472 MCU_Mg2PwmOnSta 0 "PWM Off" 1 "PWM On" 2 "Not Used" 3 "Error Indicator" ;
VAL_ 3221225472 MCU_Mg2HiVoltIntlkReq 0 "Normal" 1 "Detect Interlock Disconnect" 2 "Not used" 3 "Error Indicator" ;
VAL_ 3221225472 MCU_Mg2MilOnReq 0 "MIL Off" 1 "MIL On Request by Mg2 MCU" 2 "Not used" 3 "Error Indicator" ;
VAL_ 3221225472 MCU_Mg2SrvLmpOnReq 0 "Service Lamp Off" 1 "Service Lamp On by Mg2 MCU" 2 "Not used" 3 "Error Indicator" ;
VAL_ 3221225472 MCU_Mg2AnkJrkActvSta 0 "Not Activated" 1 "Activated" 2 "Not used" 3 "Error Indicator" ;
VAL_ 3221225472 MCU_Mg2ActnTestModSta 0 "-" 1 "Actuation Teat Mode" 2 "Not used" 3 "Error Indicator" ;
VAL_ 3221225472 MCU_Mg2PwmRetryStatus 0 "OFF" 1 "ON" 2 "Not Used" 3 "Error Indicator" ;
VAL_ 3221225472 MCU_Mg2TrqCmdStat 0 "1msCmd" 1 "10msCmd" 2 "Not Used" 3 "Error Indicator" ;
VAL_ 3221225472 MCU_Mg2RsvrCalibReq 0 "-" 1 "Mg2 MCU requests collaboration for resolver calibration to HCU(or VCU)" 2 "Not used" 3 "Error Indicator" ;
VAL_ 3221225472 MCU_Mg2RsvrCalibProcSta 0 "Mg2 resolver is calibrated" 1 "Mg2 resolver is not calibrated" 2 "Not used" 3 "Error Indicator" ;
VAL_ 3221225472 MCU_Mg2RsvrCalibSta 0 "Complete" 1 "Error" 2 "Running" 3 "Activated" 4 "Ready" ;
VAL_ 3221225472 MCU_Mg2RadPwmDtyReq 255 "Error Indicator" ;
VAL_ 3221225472 MCU_Mg2ActlRotatSpdRpmVal 32767 "Error Indicator" ;
VAL_ 3221225472 MCU_Mg2InvtRdySta 0 "-" 1 "Mg2 MCU is alive." 2 "Not used" 3 "Error Indicator" ;
VAL_ 3221225472 MCU_Mg2CtrlablSta 0 "-" 1 "MG2 MCU is ready to control Mg2" 2 "Not used" 3 "Error Indicator" ;
VAL_ 3221225472 MCU_Mg2WrngSta 0 "No Warning" 1 "Warning" 2 "Not used" 3 "Error Indicator" ;
VAL_ 3221225472 MCU_Mg2FltSta 0 "No Fault" 1 "Fault" 2 "Not used" 3 "Error Indicator" ;
VAL_ 3221225472 FCA_ESA_CtrlSta 0 "No Control" 1 "FCA 1st Warning" 2 "FCA w/ ESA Driver Initiated Control" 3 "FCA w/ ESA Auto Control Step 1" 4 "FCA w/ ESA Auto Control Step 2" 5 "FCA w/ ESA Auto Control Step 3" 6 "Reserved" 7 "Error Indicator" ;
VAL_ 3221225472 ADAS_Damping_Gain 0 "Reserved" 1 "Reserved" 2 "Reserved" 3 "0x3~0xC8:3 ~ 200%" 200 "0x3~0xC8:3 ~ 200%" 201 "Reserved" 202 "Reserved" 203 "Reserved" 204 "Reserved" 205 "Reserved" 206 "Reserved" 207 "Reserved" 208 "Reserved" 209 "Reserved" 210 "Reserved" 211 "Reserved" 212 "Reserved" 213 "Reserved" 214 "Reserved" 215 "Reserved" 216 "Reserved" 217 "Reserved" 218 "Reserved" 219 "Reserved" 220 "Reserved" 221 "Reserved" 222 "Reserved" 223 "Reserved" 224 "Reserved" 225 "Reserved" 226 "Reserved" 227 "Reserved" 228 "Reserved" 229 "Reserved" 230 "Reserved" 231 "Reserved" 232 "Reserved" 233 "Reserved" 234 "Reserved" 235 "Reserved" 236 "Reserved" 237 "Reserved" 238 "Reserved" 239 "Reserved" 240 "Reserved" 241 "Reserved" 242 "Reserved" 243 "Reserved" 244 "Reserved" 245 "Reserved" 246 "Reserved" 247 "Reserved" 248 "Reserved" 249 "Reserved" 250 "Reserved" 251 "Reserved" 252 "Reserved" 253 "Reserved" 254 "Reserved" 255 "Reserved" ;
VAL_ 3221225472 LKA_OptUsmSta 0 "None LKA/LDW Option (Default)" 1 "LDW" 2 "LKA" 3 "Reserved" 4 "LDW Only (None LKA)" 5 "LDW only OFF (None LKA)" 6 "LDW/LKA OFF" 7 "Invalid" ;
VAL_ 3221225472 LKA_RcgSta 0 "Not Recognized" 1 "Left Lane Recognition" 2 "Right Lane Recognition" 3 "Full Lane Recognition" 4 "Reserved" 5 "Reserved" 6 "Reserved" 7 "Reserved" ;
VAL_ 3221225472 LKA_LHLnWrnSta 0 "No Warning" 1 "Lane Departure Warning" 2 "Reserved" 3 "Reserved" ;
VAL_ 3221225472 LKA_RHLnWrnSta 0 "No Warning" 1 "Lane Departure Warning" 2 "Reserved" 3 "Reserved" ;
VAL_ 3221225472 LKA_HndsoffSnd 0 "Off" 1 "Hands-off Sound Warning" 2 "Reserved" 3 "Reserved" ;
VAL_ 3221225472 LKA_SysIndReq 0 "Off" 1 "Unavailable_(Grey On)" 2 "Lane Recognized_(Green On)" 3 "Lane Departure_(Green Blink)" 4 "System Fail_(Orange On)" 5 "Not Calibrated_(Orange Blink)" 6 "Regulation_(Orange On)" 7 "Reserved" ;
VAL_ 3221225472 ADAS_StrTqReqVal 0 "0x0x000~0x7FD:0~2045" 2045 "0x0x000~0x7FD:0~2045" 2046 "Reserved" 2047 "Invalid" ;
VAL_ 3221225472 ADAS_ActToiSta 0 "De-activate TOI" 1 "Activate TOI" 2 "Reserved" 3 "Error indicator" ;
VAL_ 3221225472 ADAS_ToiFltSta 0 "No Fault" 1 "Fault" 2 "Reserved" 3 "Error indicatorr" ;
VAL_ 3221225472 BCA_Rear_WrnSta 0 "No Warning" 1 "Left Warning" 2 "Right Warning" 3 "Left Control" 4 "Right Control" 5 "Reserved" 6 "Not used" 7 "Error indicator" ;
VAL_ 3221225472 LKA_SysWrn 0 "No Info" 1 "Reserved" 2 "Reserved" 3 "Reserved" 4 "Hands-Off Warning 1" 5 "Hands-Off Warning 2" 6 "Hands-Off Warning 3" 7 "Reserved" 8 "Reserved" 9 "System Automatic off" 10 "Reserved" 11 "Reserved" 12 "Reserved" 13 "Reserved" 14 "Reserved" 15 "System Fail" ;
VAL_ 3221225472 FCA_LO_WrnSta 0 "No Warning" 1 "Left Warning" 2 "Right Warning" 3 "Left Control" 4 "Right Control" 5 "Reserved" 6 "Reserved" 7 "Error indicator" ;
VAL_ 3221225472 FCA_LS_WrnSta 0 "No Warning" 1 "Left Warning" 2 "Right Warning" 3 "Left Control" 4 "Right Control" 5 "Reserved" 6 "Reserved" 7 "Error indicator" ;
VAL_ 3221225472 LKA_UsmMod 0 "NONE" 1 "LKA 1 mode" 2 "LKA 2 mode" 3 "LDW" ;
VAL_ 3221225472 Info_PedtrnDst 0 "15m~(Default)" 1 "10~15m" 2 "5~10m" 3 "0~5m" 4 "Reserved" 5 "Reserved" 6 "Reserved" 7 "Invalid" ;
VAL_ 3221225472 FCA_ESA_WrnSta 0 "No Warning" 1 "Reserved" 2 "Reserved" 3 "Left Control" 4 "Right Control" 5 "Reserved" 6 "Reserved" 7 "Error Indicator" ;
VAL_ 3221225472 Warn_ChaDrSwRrSta 0 "Default" 1 "Close" 2 "Open" 3 "Error Indicator" ;
VAL_ 3221225472 ICU_IGN3On_RequestState 0 "OFF" 1 "VCU On" 2 "AVN On" 3 "OBC On" 4 "IGN1 On" 5 "VCU and OBC On" 6 "VCU and AVN On" 7 "VCU and IGN1 On" 8 "OBC and AVN On" 9 "OBC and IGN1 On" 10 "AVN and IGN1  On" 11 "OBC and AVN and IGN1 On" 12 "AVN and VCU and IGN1 On" 13 "VCU and OBC and AVN On" 14 "VCU and OBC anc IGN1 On" 15 "All Request On" ;
VAL_ 3221225472 Warn_ChaDrSwFrtSta 0 "Default" 1 "Close" 2 "Open" 3 "Error Indicator" ;
VAL_ 3221225472 GATEWAY_MM_STS 0 "Default" 1 "Inactive" 2 "Active" 3 "Bus Off" 4 "Reserved" 5 "Reserved" 6 "Reserved" 7 "Error" ;
VAL_ 3221225472 GATEWAY_HS_B_STS 0 "Default" 1 "Inactive" 2 "Active" 3 "Bus Off" 4 "Reserved" 5 "Reserved" 6 "Reserved" 7 "Error" ;
VAL_ 3221225472 GATEWAY_HS_D_STS 0 "Default" 1 "DiagMsgNotExist" 2 "DiagMsgExist" 3 "Reserved" 4 "Reserved" 5 "Reserved" 6 "Reserved" 7 "Error" ;
VAL_ 3221225472 GATEWAY_HS_I_STS 0 "Default" 1 "Inactive" 2 "Active" 3 "Bus Off" 4 "Reserved" 5 "Reserved" 6 "Reserved" 7 "Error" ;
VAL_ 3221225472 GATEWAY_FD_P_STS 0 "Default" 1 "Inactive" 2 "Active" 3 "Bus Off" 4 "Reserved" 5 "Reserved" 6 "Reserved" 7 "Error" ;
VAL_ 3221225472 GATEWAY_FD_C_STS 0 "Default" 1 "Inactive" 2 "Active" 3 "Bus Off" 4 "Reserved" 5 "Reserved" 6 "Reserved" 7 "Error" ;
VAL_ 3221225472 GATEWAY_FD_V_STS 0 "Default" 1 "Inactive" 2 "Active" 3 "Bus Off" 4 "Reserved" 5 "Reserved" 6 "Reserved" 7 "Error" ;
VAL_ 3221225472 GATEWAY_FD_G_STS 0 "Default" 1 "Inactive" 2 "Active" 3 "Bus Off" 4 "Reserved" 5 "Reserved" 6 "Reserved" 7 "Error" ;
VAL_ 3221225472 GATEWAY_FD_E_STS 0 "Default" 1 "Inactive" 2 "Active" 3 "Bus Off" 4 "Reserved" 5 "Reserved" 6 "Reserved" 7 "Error" ;
VAL_ 3221225472 HeatedSteerWheel_StrWhlHtrSwSta 0 "Off" 1 "On" 2 "Reserved" 3 "Invalid" ;
VAL_ 3221225472 DriveTypeOption 0 "Left Handle Drive Type" 1 "Right Handle Drive Type" 3 "Error Indicator" ;
VAL_ 3221225472 Warn_RrLftSBRMATSwSta 0 "Off (UnSeated)" 1 "On (Seated)" 3 "Error Indicator" ;
VAL_ 3221225472 Warn_RrRhtSBRMATSwSta 0 "Off (UnSeated)" 1 "On (Seated)" 3 "Error Indicator" ;
VAL_ 3221225472 StrWheelAutoHeatSta 0 "Default" 1 "Off" 2 "On" 3 "Invalid" 3 "Error Indicator" ;
VAL_ 3221225472 StrWheelHeatIndSta 0 "OFF" 1 "ON(Step1)" 2 "ON(Step2)" 3 "Error Indicator" ;
VAL_ 3221225472 Warn_LftSEA 0 "SEA Left Warning OFF" 1 "SEA Left Warning ON" 2 "Reserved" 3 "Invalid" ;
VAL_ 3221225472 Warn_RhtSEA 0 "SEA Right Warning OFF" 1 "SEA Right Warning ON" 2 "Reserved" 3 "Invalid" ;
VAL_ 3221225472 Lamp_FootLampOnReq 0 "Off" 1 "On" 2 "Dim Out" 3 "Error Indicator" ;
VAL_ 3221225472 Lamp_MoodLampOnReq 0 "0%" 1 "FadeIn" 2 "MoodBrightPercent" 3 "FadeOut" 4 "100%" ;
VAL_ 3221225472 ICU_PowerAutoCutModSta 0 "Factory Mode (default)" 1 "Dealer Mode" 2 "Customer Mode" 3 "Error Indicator" ;
VAL_ 3221225472 ICU_SoCBattStaMsgReq 0 "Default" 1 "Alert" 2 "Warning" 3 "Invalid" ;
VAL_ 3221225472 C_ICUPowerAutoCutType 0 "Default" 1 "1st" 2 "2nd" 3 "3rd" ;
VAL_ 3221225472 DrvDrLockIND 0 "Off" 1 "On" ;
VAL_ 3221225472 Brake_SwSta_ICU 0 "Off" 1 "On" ;
VAL_ 3221225472 HSWS_SysWrngSta_ICU 0 "Normal" 1 "System Fail" 2 "Reserved" 3 "Invalid" ;
VAL_ 3221225472 DATC_BattChlrVlvSta 0 "Dafault" 1 "Valve Off (OPEN)" 2 "Valve On (CLOSE)" 3 "Error Indicator" ;
VAL_ 3221225472 DATC_AcnECompSpdVal 65534 "Not used" 65535 "Error Indicator" ;
VAL_ 3221225472 DATC_AcnCompSlpModCodVal 0 "Normal" 1 "Thermistor open" 2 "Thermister short" 4 "Over torque stall" 8 "Short circuit current" 16 "Driver voltage" 32 "Current measuring" 64 "Max Temperature Gradient" 128 "Internal Error" 255 "Error" ;
VAL_ 3221225472 DATC_AcnCompWaitCodVal 0 "Normal" 1 "Low_Voltage" 2 "High_Voltage" 4 "Over_Heat_Protection" 8 "Over_Loaded" 16 "Over_Current_Protection" 32 "Abnormal(not receiving)" 64 "Missed_Restart" ;
